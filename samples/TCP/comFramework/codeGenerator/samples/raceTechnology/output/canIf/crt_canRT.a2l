/begin PROJECT MERGED_PROJECT "CAN interface of cluster raceCar"
/begin HEADER "This is an A2L fragment which has to be merged into the main project" VERSION "04.10.2022 13:14:34" /end HEADER
/begin MODULE MERGED_MODULE "CAN interface of cluster raceCar"
/* Measurement point for signal Virtual_3_Vel_NED_E of frame RT_SB_INS_Vpt_3_Vel_NED_1, 9380130 (0x8f2122) */
/begin MEASUREMENT crt_PT_8f2122_Virtual_3_Vel_NED_E "signal Virtual_3_Vel_NED_E of frame RT_SB_INS_Vpt_3_Vel_NED_1, 9380130 (0x8f2122). VELNED E velocity.  This is the velocity vector directly East at the current local Earth surface position." SLONG CONV_crt_PT_8f2122_Virtual_3_Vel_NED_E 1.0E-4 100.0 -838.0 838.0 ECU_ADDRESS 0x0000 /end MEASUREMENT
/begin COMPU_METHOD CONV_crt_PT_8f2122_Virtual_3_Vel_NED_E "Linear scaling, used for variable crt_PT_8f2122_Virtual_3_Vel_NED_E, signal Virtual_3_Vel_NED_E" RAT_FUNC "%12" "m/s" COEFFS 0 1 -0.0 0 0 1.0E-4 /end COMPU_METHOD
/* Measurement point for signal Virtual_3_Offset_X of frame RT_SB_INS_Vpt_3_Offset, 9379874 (0x8f2022) */
/begin MEASUREMENT crt_PT_8f2022_Virtual_3_Offset_X "signal Virtual_3_Offset_X of frame RT_SB_INS_Vpt_3_Offset, 9379874 (0x8f2022). X offset of the virtual point in the vehicle body frame." SWORD CONV_crt_PT_8f2022_Virtual_3_Offset_X 0.001 100.0 -32.768 32.767 ECU_ADDRESS 0x0000 /end MEASUREMENT
/begin COMPU_METHOD CONV_crt_PT_8f2022_Virtual_3_Offset_X "Linear scaling, used for variable crt_PT_8f2022_Virtual_3_Offset_X, signal Virtual_3_Offset_X" RAT_FUNC "%6" "m" COEFFS 0 1 -0.0 0 0 0.001 /end COMPU_METHOD
/* Measurement point for signal Virtual_3_Offset_Y of frame RT_SB_INS_Vpt_3_Offset, 9379874 (0x8f2022) */
/begin MEASUREMENT crt_PT_8f2022_Virtual_3_Offset_Y "signal Virtual_3_Offset_Y of frame RT_SB_INS_Vpt_3_Offset, 9379874 (0x8f2022). Y offset of the virtual point in the vehicle body frame." SWORD CONV_crt_PT_8f2022_Virtual_3_Offset_Y 0.001 100.0 -32.768 32.767 ECU_ADDRESS 0x0000 /end MEASUREMENT
/begin COMPU_METHOD CONV_crt_PT_8f2022_Virtual_3_Offset_Y "Linear scaling, used for variable crt_PT_8f2022_Virtual_3_Offset_Y, signal Virtual_3_Offset_Y" RAT_FUNC "%6" "m" COEFFS 0 1 -0.0 0 0 0.001 /end COMPU_METHOD
/* Measurement point for signal Virtual_3_Offset_Z of frame RT_SB_INS_Vpt_3_Offset, 9379874 (0x8f2022) */
/begin MEASUREMENT crt_PT_8f2022_Virtual_3_Offset_Z "signal Virtual_3_Offset_Z of frame RT_SB_INS_Vpt_3_Offset, 9379874 (0x8f2022). Z offset (+ve downwards) of the virtual point in the vehicle body frame." SWORD CONV_crt_PT_8f2022_Virtual_3_Offset_Z 0.001 100.0 -32.768 32.767 ECU_ADDRESS 0x0000 /end MEASUREMENT
/begin COMPU_METHOD CONV_crt_PT_8f2022_Virtual_3_Offset_Z "Linear scaling, used for variable crt_PT_8f2022_Virtual_3_Offset_Z, signal Virtual_3_Offset_Z" RAT_FUNC "%6" "m" COEFFS 0 1 -0.0 0 0 0.001 /end COMPU_METHOD
/* Measurement point for signal Virtual_2_Vel_NED_D of frame RT_SB_INS_Vpt_2_Vel_NED_2, 9376290 (0x8f1222) */
/begin MEASUREMENT crt_PT_8f1222_Virtual_2_Vel_NED_D "signal Virtual_2_Vel_NED_D of frame RT_SB_INS_Vpt_2_Vel_NED_2, 9376290 (0x8f1222). VELNED D velocity.  This is the velocity vector directly downwards towards the Earth centre at the current local Earth surface position." SLONG CONV_crt_PT_8f1222_Virtual_2_Vel_NED_D 1.0E-4 100.0 -838.0 838.0 ECU_ADDRESS 0x0000 /end MEASUREMENT
/begin COMPU_METHOD CONV_crt_PT_8f1222_Virtual_2_Vel_NED_D "Linear scaling, used for variable crt_PT_8f1222_Virtual_2_Vel_NED_D, signal Virtual_2_Vel_NED_D" RAT_FUNC "%12" "m/s" COEFFS 0 1 -0.0 0 0 1.0E-4 /end COMPU_METHOD
/* Measurement point for signal Virtual_2_Heading of frame RT_SB_INS_Vpt_2_Vel_NED_2, 9376290 (0x8f1222) */
/begin MEASUREMENT crt_PT_8f1222_Virtual_2_Heading "signal Virtual_2_Heading of frame RT_SB_INS_Vpt_2_Vel_NED_2, 9376290 (0x8f1222). This is GPS heading, the direction that the vehicle is travelling in the local horizontal plane." SWORD CONV_crt_PT_8f1222_Virtual_2_Heading 0.01 100.0 -180.0 180.0 ECU_ADDRESS 0x0000 /end MEASUREMENT
/begin COMPU_METHOD CONV_crt_PT_8f1222_Virtual_2_Heading "Linear scaling, used for variable crt_PT_8f1222_Virtual_2_Heading, signal Virtual_2_Heading" RAT_FUNC "%6" "degrees" COEFFS 0 1 -0.0 0 0 0.01 /end COMPU_METHOD
/* Measurement point for signal Virtual_2_Slip of frame RT_SB_INS_Vpt_2_Vel_NED_2, 9376290 (0x8f1222) */
/begin MEASUREMENT crt_PT_8f1222_Virtual_2_Slip "signal Virtual_2_Slip of frame RT_SB_INS_Vpt_2_Vel_NED_2, 9376290 (0x8f1222). Slip is defined as the difference between yaw and heading." SWORD CONV_crt_PT_8f1222_Virtual_2_Slip 0.01 100.0 -180.0 180.0 ECU_ADDRESS 0x0000 /end MEASUREMENT
/begin COMPU_METHOD CONV_crt_PT_8f1222_Virtual_2_Slip "Linear scaling, used for variable crt_PT_8f1222_Virtual_2_Slip, signal Virtual_2_Slip" RAT_FUNC "%6" "degrees" COEFFS 0 1 -0.0 0 0 0.01 /end COMPU_METHOD
/* Measurement point for signal Virtual_2_Vel_NED_N of frame RT_SB_INS_Vpt_2_Vel_NED_1, 9376034 (0x8f1122) */
/begin MEASUREMENT crt_PT_8f1122_Virtual_2_Vel_NED_N "signal Virtual_2_Vel_NED_N of frame RT_SB_INS_Vpt_2_Vel_NED_1, 9376034 (0x8f1122). VELNED N velocity.  This is the velocity vector directly North at the current local Earth surface position." SLONG CONV_crt_PT_8f1122_Virtual_2_Vel_NED_N 1.0E-4 100.0 -838.0 838.0 ECU_ADDRESS 0x0000 /end MEASUREMENT
/begin COMPU_METHOD CONV_crt_PT_8f1122_Virtual_2_Vel_NED_N "Linear scaling, used for variable crt_PT_8f1122_Virtual_2_Vel_NED_N, signal Virtual_2_Vel_NED_N" RAT_FUNC "%12" "m/s" COEFFS 0 1 -0.0 0 0 1.0E-4 /end COMPU_METHOD
/* Measurement point for signal Virtual_2_Vel_NED_E of frame RT_SB_INS_Vpt_2_Vel_NED_1, 9376034 (0x8f1122) */
/begin MEASUREMENT crt_PT_8f1122_Virtual_2_Vel_NED_E "signal Virtual_2_Vel_NED_E of frame RT_SB_INS_Vpt_2_Vel_NED_1, 9376034 (0x8f1122). VELNED E velocity.  This is the velocity vector directly East at the current local Earth surface position." SLONG CONV_crt_PT_8f1122_Virtual_2_Vel_NED_E 1.0E-4 100.0 -838.0 838.0 ECU_ADDRESS 0x0000 /end MEASUREMENT
/begin COMPU_METHOD CONV_crt_PT_8f1122_Virtual_2_Vel_NED_E "Linear scaling, used for variable crt_PT_8f1122_Virtual_2_Vel_NED_E, signal Virtual_2_Vel_NED_E" RAT_FUNC "%12" "m/s" COEFFS 0 1 -0.0 0 0 1.0E-4 /end COMPU_METHOD
/* Measurement point for signal Virtual_2_Offset_X of frame RT_SB_INS_Vpt_2_Offset, 9375778 (0x8f1022) */
/begin MEASUREMENT crt_PT_8f1022_Virtual_2_Offset_X "signal Virtual_2_Offset_X of frame RT_SB_INS_Vpt_2_Offset, 9375778 (0x8f1022). X offset of the virtual point in the vehicle body frame." SWORD CONV_crt_PT_8f1022_Virtual_2_Offset_X 0.001 100.0 -32.768 32.767 ECU_ADDRESS 0x0000 /end MEASUREMENT
/begin COMPU_METHOD CONV_crt_PT_8f1022_Virtual_2_Offset_X "Linear scaling, used for variable crt_PT_8f1022_Virtual_2_Offset_X, signal Virtual_2_Offset_X" RAT_FUNC "%6" "m" COEFFS 0 1 -0.0 0 0 0.001 /end COMPU_METHOD
/* Measurement point for signal Virtual_2_Offset_Y of frame RT_SB_INS_Vpt_2_Offset, 9375778 (0x8f1022) */
/begin MEASUREMENT crt_PT_8f1022_Virtual_2_Offset_Y "signal Virtual_2_Offset_Y of frame RT_SB_INS_Vpt_2_Offset, 9375778 (0x8f1022). Y offset of the virtual point in the vehicle body frame." SWORD CONV_crt_PT_8f1022_Virtual_2_Offset_Y 0.001 100.0 -32.768 32.767 ECU_ADDRESS 0x0000 /end MEASUREMENT
/begin COMPU_METHOD CONV_crt_PT_8f1022_Virtual_2_Offset_Y "Linear scaling, used for variable crt_PT_8f1022_Virtual_2_Offset_Y, signal Virtual_2_Offset_Y" RAT_FUNC "%6" "m" COEFFS 0 1 -0.0 0 0 0.001 /end COMPU_METHOD
/* Measurement point for signal Virtual_2_Offset_Z of frame RT_SB_INS_Vpt_2_Offset, 9375778 (0x8f1022) */
/begin MEASUREMENT crt_PT_8f1022_Virtual_2_Offset_Z "signal Virtual_2_Offset_Z of frame RT_SB_INS_Vpt_2_Offset, 9375778 (0x8f1022). Z offset (+ve downwards) of the virtual point in the vehicle body frame." SWORD CONV_crt_PT_8f1022_Virtual_2_Offset_Z 0.001 100.0 -32.768 32.767 ECU_ADDRESS 0x0000 /end MEASUREMENT
/begin COMPU_METHOD CONV_crt_PT_8f1022_Virtual_2_Offset_Z "Linear scaling, used for variable crt_PT_8f1022_Virtual_2_Offset_Z, signal Virtual_2_Offset_Z" RAT_FUNC "%6" "m" COEFFS 0 1 -0.0 0 0 0.001 /end COMPU_METHOD
/* Measurement point for signal Virtual_1_Vel_NED_D of frame RT_SB_INS_Vpt_1_Vel_NED_2, 9372194 (0x8f0222) */
/begin MEASUREMENT crt_PT_8f0222_Virtual_1_Vel_NED_D "signal Virtual_1_Vel_NED_D of frame RT_SB_INS_Vpt_1_Vel_NED_2, 9372194 (0x8f0222). VELNED D velocity.  This is the velocity vector directly downwards towards the Earth centre at the current local Earth surface position." SLONG CONV_crt_PT_8f0222_Virtual_1_Vel_NED_D 1.0E-4 100.0 -838.0 838.0 ECU_ADDRESS 0x0000 /end MEASUREMENT
/begin COMPU_METHOD CONV_crt_PT_8f0222_Virtual_1_Vel_NED_D "Linear scaling, used for variable crt_PT_8f0222_Virtual_1_Vel_NED_D, signal Virtual_1_Vel_NED_D" RAT_FUNC "%12" "m/s" COEFFS 0 1 -0.0 0 0 1.0E-4 /end COMPU_METHOD
/* Measurement point for signal Virtual_1_Heading of frame RT_SB_INS_Vpt_1_Vel_NED_2, 9372194 (0x8f0222) */
/begin MEASUREMENT crt_PT_8f0222_Virtual_1_Heading "signal Virtual_1_Heading of frame RT_SB_INS_Vpt_1_Vel_NED_2, 9372194 (0x8f0222). This is GPS heading, the direction that the vehicle is travelling in the local horizontal plane." SWORD CONV_crt_PT_8f0222_Virtual_1_Heading 0.01 100.0 -180.0 180.0 ECU_ADDRESS 0x0000 /end MEASUREMENT
/begin COMPU_METHOD CONV_crt_PT_8f0222_Virtual_1_Heading "Linear scaling, used for variable crt_PT_8f0222_Virtual_1_Heading, signal Virtual_1_Heading" RAT_FUNC "%6" "degrees" COEFFS 0 1 -0.0 0 0 0.01 /end COMPU_METHOD
/* Measurement point for signal Virtual_1_Slip of frame RT_SB_INS_Vpt_1_Vel_NED_2, 9372194 (0x8f0222) */
/begin MEASUREMENT crt_PT_8f0222_Virtual_1_Slip "signal Virtual_1_Slip of frame RT_SB_INS_Vpt_1_Vel_NED_2, 9372194 (0x8f0222). Slip is defined as the difference between yaw and heading." SWORD CONV_crt_PT_8f0222_Virtual_1_Slip 0.01 100.0 -180.0 180.0 ECU_ADDRESS 0x0000 /end MEASUREMENT
/begin COMPU_METHOD CONV_crt_PT_8f0222_Virtual_1_Slip "Linear scaling, used for variable crt_PT_8f0222_Virtual_1_Slip, signal Virtual_1_Slip" RAT_FUNC "%6" "degrees" COEFFS 0 1 -0.0 0 0 0.01 /end COMPU_METHOD
/* Measurement point for signal Virtual_1_Vel_NED_N of frame RT_SB_INS_Vpt_1_Vel_NED_1, 9371938 (0x8f0122) */
/begin MEASUREMENT crt_PT_8f0122_Virtual_1_Vel_NED_N "signal Virtual_1_Vel_NED_N of frame RT_SB_INS_Vpt_1_Vel_NED_1, 9371938 (0x8f0122). VELNED N velocity.  This is the velocity vector directly North at the current local Earth surface position." SLONG CONV_crt_PT_8f0122_Virtual_1_Vel_NED_N 1.0E-4 100.0 -838.0 838.0 ECU_ADDRESS 0x0000 /end MEASUREMENT
/begin COMPU_METHOD CONV_crt_PT_8f0122_Virtual_1_Vel_NED_N "Linear scaling, used for variable crt_PT_8f0122_Virtual_1_Vel_NED_N, signal Virtual_1_Vel_NED_N" RAT_FUNC "%12" "m/s" COEFFS 0 1 -0.0 0 0 1.0E-4 /end COMPU_METHOD
/* Measurement point for signal Virtual_1_Vel_NED_E of frame RT_SB_INS_Vpt_1_Vel_NED_1, 9371938 (0x8f0122) */
/begin MEASUREMENT crt_PT_8f0122_Virtual_1_Vel_NED_E "signal Virtual_1_Vel_NED_E of frame RT_SB_INS_Vpt_1_Vel_NED_1, 9371938 (0x8f0122). VELNED E velocity.  This is the velocity vector directly East at the current local Earth surface position." SLONG CONV_crt_PT_8f0122_Virtual_1_Vel_NED_E 1.0E-4 100.0 -838.0 838.0 ECU_ADDRESS 0x0000 /end MEASUREMENT
/begin COMPU_METHOD CONV_crt_PT_8f0122_Virtual_1_Vel_NED_E "Linear scaling, used for variable crt_PT_8f0122_Virtual_1_Vel_NED_E, signal Virtual_1_Vel_NED_E" RAT_FUNC "%12" "m/s" COEFFS 0 1 -0.0 0 0 1.0E-4 /end COMPU_METHOD
/* Measurement point for signal Virtual_1_Offset_X of frame RT_SB_INS_Vpt_1_Offset, 9371682 (0x8f0022) */
/begin MEASUREMENT crt_PT_8f0022_Virtual_1_Offset_X "signal Virtual_1_Offset_X of frame RT_SB_INS_Vpt_1_Offset, 9371682 (0x8f0022). X offset of the virtual point in the vehicle body frame." SWORD CONV_crt_PT_8f0022_Virtual_1_Offset_X 0.001 100.0 -32.768 32.767 ECU_ADDRESS 0x0000 /end MEASUREMENT
/begin COMPU_METHOD CONV_crt_PT_8f0022_Virtual_1_Offset_X "Linear scaling, used for variable crt_PT_8f0022_Virtual_1_Offset_X, signal Virtual_1_Offset_X" RAT_FUNC "%6" "m" COEFFS 0 1 -0.0 0 0 0.001 /end COMPU_METHOD
/* Measurement point for signal Virtual_1_Offset_Y of frame RT_SB_INS_Vpt_1_Offset, 9371682 (0x8f0022) */
/begin MEASUREMENT crt_PT_8f0022_Virtual_1_Offset_Y "signal Virtual_1_Offset_Y of frame RT_SB_INS_Vpt_1_Offset, 9371682 (0x8f0022). Y offset of the virtual point in the vehicle body frame." SWORD CONV_crt_PT_8f0022_Virtual_1_Offset_Y 0.001 100.0 -32.768 32.767 ECU_ADDRESS 0x0000 /end MEASUREMENT
/begin COMPU_METHOD CONV_crt_PT_8f0022_Virtual_1_Offset_Y "Linear scaling, used for variable crt_PT_8f0022_Virtual_1_Offset_Y, signal Virtual_1_Offset_Y" RAT_FUNC "%6" "m" COEFFS 0 1 -0.0 0 0 0.001 /end COMPU_METHOD
/* Measurement point for signal Virtual_1_Offset_Z of frame RT_SB_INS_Vpt_1_Offset, 9371682 (0x8f0022) */
/begin MEASUREMENT crt_PT_8f0022_Virtual_1_Offset_Z "signal Virtual_1_Offset_Z of frame RT_SB_INS_Vpt_1_Offset, 9371682 (0x8f0022). Z offset (+ve downwards) of the virtual point in the vehicle body frame." SWORD CONV_crt_PT_8f0022_Virtual_1_Offset_Z 0.001 100.0 -32.768 32.767 ECU_ADDRESS 0x0000 /end MEASUREMENT
/begin COMPU_METHOD CONV_crt_PT_8f0022_Virtual_1_Offset_Z "Linear scaling, used for variable crt_PT_8f0022_Virtual_1_Offset_Z, signal Virtual_1_Offset_Z" RAT_FUNC "%6" "m" COEFFS 0 1 -0.0 0 0 0.001 /end COMPU_METHOD
/* Measurement point for signal Validity_INS_Slip of frame RT_SB_INS_Slip, 9311778 (0x8e1622) */
/begin MEASUREMENT crt_PT_8e1622_Validity_INS_Slip "signal Validity_INS_Slip of frame RT_SB_INS_Slip, 9311778 (0x8e1622)" UBYTE CONV_crt_PT_8e1622_Validity_INS_Slip 1.0 100.0 0 1 ECU_ADDRESS 0x0000 /end MEASUREMENT
/begin COMPU_METHOD CONV_crt_PT_8e1622_Validity_INS_Slip "Linear scaling, used for variable crt_PT_8e1622_Validity_INS_Slip, signal Validity_INS_Slip" RAT_FUNC "%1" "" COEFFS 0 1 0 0 0 1 /end COMPU_METHOD
/* Measurement point for signal Validity_INS_Squat of frame RT_SB_INS_Slip, 9311778 (0x8e1622) */
/begin MEASUREMENT crt_PT_8e1622_Validity_INS_Squat "signal Validity_INS_Squat of frame RT_SB_INS_Slip, 9311778 (0x8e1622)" UBYTE CONV_crt_PT_8e1622_Validity_INS_Squat 1.0 100.0 0 1 ECU_ADDRESS 0x0000 /end MEASUREMENT
/begin COMPU_METHOD CONV_crt_PT_8e1622_Validity_INS_Squat "Linear scaling, used for variable crt_PT_8e1622_Validity_INS_Squat, signal Validity_INS_Squat" RAT_FUNC "%1" "" COEFFS 0 1 0 0 0 1 /end COMPU_METHOD
/* Measurement point for signal Accuracy_INS_Slip of frame RT_SB_INS_Slip, 9311778 (0x8e1622) */
/begin MEASUREMENT crt_PT_8e1622_Accuracy_INS_Slip "signal Accuracy_INS_Slip of frame RT_SB_INS_Slip, 9311778 (0x8e1622). Dimensionless.  Lower values imply but do not guarantee better accuracy than higher values." UBYTE CONV_crt_PT_8e1622_Accuracy_INS_Slip 1.0 100.0 0 255 ECU_ADDRESS 0x0000 /end MEASUREMENT
/begin COMPU_METHOD CONV_crt_PT_8e1622_Accuracy_INS_Slip "Linear scaling, used for variable crt_PT_8e1622_Accuracy_INS_Slip, signal Accuracy_INS_Slip" RAT_FUNC "%4" "" COEFFS 0 1 0 0 0 1 /end COMPU_METHOD
/* Measurement point for signal INS_Slip of frame RT_SB_INS_Slip, 9311778 (0x8e1622) */
/begin MEASUREMENT crt_PT_8e1622_INS_Slip "signal INS_Slip of frame RT_SB_INS_Slip, 9311778 (0x8e1622). Slip is defined as the difference between yaw and heading" SWORD CONV_crt_PT_8e1622_INS_Slip 0.01 100.0 -360.0 360.0 ECU_ADDRESS 0x0000 /end MEASUREMENT
/begin COMPU_METHOD CONV_crt_PT_8e1622_INS_Slip "Linear scaling, used for variable crt_PT_8e1622_INS_Slip, signal INS_Slip" RAT_FUNC "%6" "degrees" COEFFS 0 1 -0.0 0 0 0.01 /end COMPU_METHOD
/* Measurement point for signal Accuracy_INS_Squat of frame RT_SB_INS_Slip, 9311778 (0x8e1622) */
/begin MEASUREMENT crt_PT_8e1622_Accuracy_INS_Squat "signal Accuracy_INS_Squat of frame RT_SB_INS_Slip, 9311778 (0x8e1622). Dimensionless.  Lower values imply but do not guarantee better accuracy than higher values." UBYTE CONV_crt_PT_8e1622_Accuracy_INS_Squat 1.0 100.0 0 255 ECU_ADDRESS 0x0000 /end MEASUREMENT
/begin COMPU_METHOD CONV_crt_PT_8e1622_Accuracy_INS_Squat "Linear scaling, used for variable crt_PT_8e1622_Accuracy_INS_Squat, signal Accuracy_INS_Squat" RAT_FUNC "%4" "" COEFFS 0 1 0 0 0 1 /end COMPU_METHOD
/* Measurement point for signal INS_Squat of frame RT_SB_INS_Slip, 9311778 (0x8e1622) */
/begin MEASUREMENT crt_PT_8e1622_INS_Squat "signal INS_Squat of frame RT_SB_INS_Slip, 9311778 (0x8e1622). Squat is defined as the difference between pitch and gradient" SWORD CONV_crt_PT_8e1622_INS_Squat 0.01 100.0 -360.0 360.0 ECU_ADDRESS 0x0000 /end MEASUREMENT
/begin COMPU_METHOD CONV_crt_PT_8e1622_INS_Squat "Linear scaling, used for variable crt_PT_8e1622_INS_Squat, signal INS_Squat" RAT_FUNC "%6" "degrees" COEFFS 0 1 -0.0 0 0 0.01 /end COMPU_METHOD
/* Measurement point for signal Validity_INS_Vel_ECEF_Y of frame RT_SB_INS_Vel_ECEF_2, 9311010 (0x8e1322) */
/begin MEASUREMENT crt_PT_8e1322_Validity_INS_Vel_ECEF_Y "signal Validity_INS_Vel_ECEF_Y of frame RT_SB_INS_Vel_ECEF_2, 9311010 (0x8e1322). Valid when bit is set, invalid when bit is clear." UBYTE CONV_crt_PT_8e1322_Validity_INS_Vel_ECEF_Y 1.0 100.0 0 1 ECU_ADDRESS 0x0000 /end MEASUREMENT
/begin COMPU_METHOD CONV_crt_PT_8e1322_Validity_INS_Vel_ECEF_Y "Linear scaling, used for variable crt_PT_8e1322_Validity_INS_Vel_ECEF_Y, signal Validity_INS_Vel_ECEF_Y" RAT_FUNC "%1" "" COEFFS 0 1 0 0 0 1 /end COMPU_METHOD
/* Measurement point for signal Validity_INS_Vel_ECEF_Z of frame RT_SB_INS_Vel_ECEF_2, 9311010 (0x8e1322) */
/begin MEASUREMENT crt_PT_8e1322_Validity_INS_Vel_ECEF_Z "signal Validity_INS_Vel_ECEF_Z of frame RT_SB_INS_Vel_ECEF_2, 9311010 (0x8e1322). Valid when bit is set, invalid when bit is clear." UBYTE CONV_crt_PT_8e1322_Validity_INS_Vel_ECEF_Z 1.0 100.0 0 1 ECU_ADDRESS 0x0000 /end MEASUREMENT
/begin COMPU_METHOD CONV_crt_PT_8e1322_Validity_INS_Vel_ECEF_Z "Linear scaling, used for variable crt_PT_8e1322_Validity_INS_Vel_ECEF_Z, signal Validity_INS_Vel_ECEF_Z" RAT_FUNC "%1" "" COEFFS 0 1 0 0 0 1 /end COMPU_METHOD
/* Measurement point for signal INS_Vel_ECEF_Y of frame RT_SB_INS_Vel_ECEF_2, 9311010 (0x8e1322) */
/begin MEASUREMENT crt_PT_8e1322_INS_Vel_ECEF_Y "signal INS_Vel_ECEF_Y of frame RT_SB_INS_Vel_ECEF_2, 9311010 (0x8e1322). ECEF Y velocity.  The ECEF Y axis originates from the Earth centre, and the positive Y axis intersects the Earth surface at zero degrees latittude and 90 degrees longitude." SLONG CONV_crt_PT_8e1322_INS_Vel_ECEF_Y 1.0E-4 100.0 -838.0 838.0 ECU_ADDRESS 0x0000 /end MEASUREMENT
/begin COMPU_METHOD CONV_crt_PT_8e1322_INS_Vel_ECEF_Y "Linear scaling, used for variable crt_PT_8e1322_INS_Vel_ECEF_Y, signal INS_Vel_ECEF_Y" RAT_FUNC "%12" "m/s" COEFFS 0 1 -0.0 0 0 1.0E-4 /end COMPU_METHOD
/* Measurement point for signal INS_Vel_ECEF_Z of frame RT_SB_INS_Vel_ECEF_2, 9311010 (0x8e1322) */
/begin MEASUREMENT crt_PT_8e1322_INS_Vel_ECEF_Z "signal INS_Vel_ECEF_Z of frame RT_SB_INS_Vel_ECEF_2, 9311010 (0x8e1322). ECEF Z velocity.  The ECEF Z axis originates from the Earth centre, and the positive Z axis intersects the Earth surface at the North Pole." SLONG CONV_crt_PT_8e1322_INS_Vel_ECEF_Z 1.0E-4 100.0 -838.0 838.0 ECU_ADDRESS 0x0000 /end MEASUREMENT
/begin COMPU_METHOD CONV_crt_PT_8e1322_INS_Vel_ECEF_Z "Linear scaling, used for variable crt_PT_8e1322_INS_Vel_ECEF_Z, signal INS_Vel_ECEF_Z" RAT_FUNC "%12" "m/s" COEFFS 0 1 -0.0 0 0 1.0E-4 /end COMPU_METHOD
/* Measurement point for signal Validity_INS_Vel_ECEF_X of frame RT_SB_INS_Vel_ECEF_1, 9310754 (0x8e1222) */
/begin MEASUREMENT crt_PT_8e1222_Validity_INS_Vel_ECEF_X "signal Validity_INS_Vel_ECEF_X of frame RT_SB_INS_Vel_ECEF_1, 9310754 (0x8e1222). Valid when bit is set, invalid when bit is clear." UBYTE CONV_crt_PT_8e1222_Validity_INS_Vel_ECEF_X 1.0 100.0 0 1 ECU_ADDRESS 0x0000 /end MEASUREMENT
/begin COMPU_METHOD CONV_crt_PT_8e1222_Validity_INS_Vel_ECEF_X "Linear scaling, used for variable crt_PT_8e1222_Validity_INS_Vel_ECEF_X, signal Validity_INS_Vel_ECEF_X" RAT_FUNC "%1" "" COEFFS 0 1 0 0 0 1 /end COMPU_METHOD
/* Measurement point for signal Accuracy_INS_Vel_ECEF_X of frame RT_SB_INS_Vel_ECEF_1, 9310754 (0x8e1222) */
/begin MEASUREMENT crt_PT_8e1222_Accuracy_INS_Vel_ECEF_X "signal Accuracy_INS_Vel_ECEF_X of frame RT_SB_INS_Vel_ECEF_1, 9310754 (0x8e1222)" UBYTE CONV_crt_PT_8e1222_Accuracy_INS_Vel_ECEF_X 1.0 100.0 0 255 ECU_ADDRESS 0x0000 /end MEASUREMENT
/begin COMPU_METHOD CONV_crt_PT_8e1222_Accuracy_INS_Vel_ECEF_X "Linear scaling, used for variable crt_PT_8e1222_Accuracy_INS_Vel_ECEF_X, signal Accuracy_INS_Vel_ECEF_X" RAT_FUNC "%4" "" COEFFS 0 1 0 0 0 1 /end COMPU_METHOD
/* Measurement point for signal Accuracy_INS_Vel_ECEF_Y of frame RT_SB_INS_Vel_ECEF_1, 9310754 (0x8e1222) */
/begin MEASUREMENT crt_PT_8e1222_Accuracy_INS_Vel_ECEF_Y "signal Accuracy_INS_Vel_ECEF_Y of frame RT_SB_INS_Vel_ECEF_1, 9310754 (0x8e1222)" UBYTE CONV_crt_PT_8e1222_Accuracy_INS_Vel_ECEF_Y 1.0 100.0 0 255 ECU_ADDRESS 0x0000 /end MEASUREMENT
/begin COMPU_METHOD CONV_crt_PT_8e1222_Accuracy_INS_Vel_ECEF_Y "Linear scaling, used for variable crt_PT_8e1222_Accuracy_INS_Vel_ECEF_Y, signal Accuracy_INS_Vel_ECEF_Y" RAT_FUNC "%4" "" COEFFS 0 1 0 0 0 1 /end COMPU_METHOD
/* Measurement point for signal Accuracy_INS_Vel_ECEF_Z of frame RT_SB_INS_Vel_ECEF_1, 9310754 (0x8e1222) */
/begin MEASUREMENT crt_PT_8e1222_Accuracy_INS_Vel_ECEF_Z "signal Accuracy_INS_Vel_ECEF_Z of frame RT_SB_INS_Vel_ECEF_1, 9310754 (0x8e1222)" UBYTE CONV_crt_PT_8e1222_Accuracy_INS_Vel_ECEF_Z 1.0 100.0 0 255 ECU_ADDRESS 0x0000 /end MEASUREMENT
/begin COMPU_METHOD CONV_crt_PT_8e1222_Accuracy_INS_Vel_ECEF_Z "Linear scaling, used for variable crt_PT_8e1222_Accuracy_INS_Vel_ECEF_Z, signal Accuracy_INS_Vel_ECEF_Z" RAT_FUNC "%4" "" COEFFS 0 1 0 0 0 1 /end COMPU_METHOD
/* Measurement point for signal INS_Vel_ECEF_X of frame RT_SB_INS_Vel_ECEF_1, 9310754 (0x8e1222) */
/begin MEASUREMENT crt_PT_8e1222_INS_Vel_ECEF_X "signal INS_Vel_ECEF_X of frame RT_SB_INS_Vel_ECEF_1, 9310754 (0x8e1222). ECEF X velocity.  The ECEF X axis originates from the Earth centre, and the positive X axis intersects the Earth surface at zero degrees latittude and zero degrees longitude (the intersection of the equator and the prime meridian)." SLONG CONV_crt_PT_8e1222_INS_Vel_ECEF_X 1.0E-4 100.0 -838.0 838.0 ECU_ADDRESS 0x0000 /end MEASUREMENT
/begin COMPU_METHOD CONV_crt_PT_8e1222_INS_Vel_ECEF_X "Linear scaling, used for variable crt_PT_8e1222_INS_Vel_ECEF_X, signal INS_Vel_ECEF_X" RAT_FUNC "%12" "m/s" COEFFS 0 1 -0.0 0 0 1.0E-4 /end COMPU_METHOD
/* Measurement point for signal Validity_INS_Vel_NED_D of frame RT_SB_INS_Vel_NED_2, 9310498 (0x8e1122) */
/begin MEASUREMENT crt_PT_8e1122_Validity_INS_Vel_NED_D "signal Validity_INS_Vel_NED_D of frame RT_SB_INS_Vel_NED_2, 9310498 (0x8e1122). Valid when bit is set, invalid when bit is clear." UBYTE CONV_crt_PT_8e1122_Validity_INS_Vel_NED_D 1.0 100.0 0 1 ECU_ADDRESS 0x0000 /end MEASUREMENT
/begin COMPU_METHOD CONV_crt_PT_8e1122_Validity_INS_Vel_NED_D "Linear scaling, used for variable crt_PT_8e1122_Validity_INS_Vel_NED_D, signal Validity_INS_Vel_NED_D" RAT_FUNC "%1" "" COEFFS 0 1 0 0 0 1 /end COMPU_METHOD
/* Measurement point for signal Accuracy_INS_Vel_D of frame RT_SB_INS_Vel_NED_2, 9310498 (0x8e1122) */
/begin MEASUREMENT crt_PT_8e1122_Accuracy_INS_Vel_D "signal Accuracy_INS_Vel_D of frame RT_SB_INS_Vel_NED_2, 9310498 (0x8e1122)" UBYTE CONV_crt_PT_8e1122_Accuracy_INS_Vel_D 1.0 100.0 0 255 ECU_ADDRESS 0x0000 /end MEASUREMENT
/begin COMPU_METHOD CONV_crt_PT_8e1122_Accuracy_INS_Vel_D "Linear scaling, used for variable crt_PT_8e1122_Accuracy_INS_Vel_D, signal Accuracy_INS_Vel_D" RAT_FUNC "%4" "" COEFFS 0 1 0 0 0 1 /end COMPU_METHOD
/* Measurement point for signal INS_Vel_NED_D of frame RT_SB_INS_Vel_NED_2, 9310498 (0x8e1122) */
/begin MEASUREMENT crt_PT_8e1122_INS_Vel_NED_D "signal INS_Vel_NED_D of frame RT_SB_INS_Vel_NED_2, 9310498 (0x8e1122). VELNED D velocity.  This is the velocity vector directly downwards towards the Earth centre at the current local Earth surface position." SLONG CONV_crt_PT_8e1122_INS_Vel_NED_D 1.0E-4 100.0 -838.0 838.0 ECU_ADDRESS 0x0000 /end MEASUREMENT
/begin COMPU_METHOD CONV_crt_PT_8e1122_INS_Vel_NED_D "Linear scaling, used for variable crt_PT_8e1122_INS_Vel_NED_D, signal INS_Vel_NED_D" RAT_FUNC "%12" "m/s" COEFFS 0 1 -0.0 0 0 1.0E-4 /end COMPU_METHOD
/* Measurement point for signal Validity_INS_Vel_NED_N of frame RT_SB_INS_Vel_NED_1, 9310242 (0x8e1022) */
/begin MEASUREMENT crt_PT_8e1022_Validity_INS_Vel_NED_N "signal Validity_INS_Vel_NED_N of frame RT_SB_INS_Vel_NED_1, 9310242 (0x8e1022). Valid when bit is set, invalid when bit is clear." UBYTE CONV_crt_PT_8e1022_Validity_INS_Vel_NED_N 1.0 100.0 0 1 ECU_ADDRESS 0x0000 /end MEASUREMENT
/begin COMPU_METHOD CONV_crt_PT_8e1022_Validity_INS_Vel_NED_N "Linear scaling, used for variable crt_PT_8e1022_Validity_INS_Vel_NED_N, signal Validity_INS_Vel_NED_N" RAT_FUNC "%1" "" COEFFS 0 1 0 0 0 1 /end COMPU_METHOD
/* Measurement point for signal Validity_INS_Vel_NED_E of frame RT_SB_INS_Vel_NED_1, 9310242 (0x8e1022) */
/begin MEASUREMENT crt_PT_8e1022_Validity_INS_Vel_NED_E "signal Validity_INS_Vel_NED_E of frame RT_SB_INS_Vel_NED_1, 9310242 (0x8e1022). Valid when bit is set, invalid when bit is clear." UBYTE CONV_crt_PT_8e1022_Validity_INS_Vel_NED_E 1.0 100.0 0 1 ECU_ADDRESS 0x0000 /end MEASUREMENT
/begin COMPU_METHOD CONV_crt_PT_8e1022_Validity_INS_Vel_NED_E "Linear scaling, used for variable crt_PT_8e1022_Validity_INS_Vel_NED_E, signal Validity_INS_Vel_NED_E" RAT_FUNC "%1" "" COEFFS 0 1 0 0 0 1 /end COMPU_METHOD
/* Measurement point for signal Accuracy_INS_Vel_NE of frame RT_SB_INS_Vel_NED_1, 9310242 (0x8e1022) */
/begin MEASUREMENT crt_PT_8e1022_Accuracy_INS_Vel_NE "signal Accuracy_INS_Vel_NE of frame RT_SB_INS_Vel_NED_1, 9310242 (0x8e1022)" UBYTE CONV_crt_PT_8e1022_Accuracy_INS_Vel_NE 1.0 100.0 0 255 ECU_ADDRESS 0x0000 /end MEASUREMENT
/begin COMPU_METHOD CONV_crt_PT_8e1022_Accuracy_INS_Vel_NE "Linear scaling, used for variable crt_PT_8e1022_Accuracy_INS_Vel_NE, signal Accuracy_INS_Vel_NE" RAT_FUNC "%4" "" COEFFS 0 1 0 0 0 1 /end COMPU_METHOD
/* Measurement point for signal INS_Vel_NED_N of frame RT_SB_INS_Vel_NED_1, 9310242 (0x8e1022) */
/begin MEASUREMENT crt_PT_8e1022_INS_Vel_NED_N "signal INS_Vel_NED_N of frame RT_SB_INS_Vel_NED_1, 9310242 (0x8e1022). VELNED N velocity.  This is the velocity vector directly North at the current local Earth surface position." SLONG CONV_crt_PT_8e1022_INS_Vel_NED_N 1.0E-4 100.0 -838.0 838.0 ECU_ADDRESS 0x0000 /end MEASUREMENT
/begin COMPU_METHOD CONV_crt_PT_8e1022_INS_Vel_NED_N "Linear scaling, used for variable crt_PT_8e1022_INS_Vel_NED_N, signal INS_Vel_NED_N" RAT_FUNC "%12" "m/s" COEFFS 0 1 -0.0 0 0 1.0E-4 /end COMPU_METHOD
/* Measurement point for signal INS_Vel_NED_E of frame RT_SB_INS_Vel_NED_1, 9310242 (0x8e1022) */
/begin MEASUREMENT crt_PT_8e1022_INS_Vel_NED_E "signal INS_Vel_NED_E of frame RT_SB_INS_Vel_NED_1, 9310242 (0x8e1022). VELNED E velocity.  This is the velocity vector directly East at the current local Earth surface position." SLONG CONV_crt_PT_8e1022_INS_Vel_NED_E 1.0E-4 100.0 -838.0 838.0 ECU_ADDRESS 0x0000 /end MEASUREMENT
/begin COMPU_METHOD CONV_crt_PT_8e1022_INS_Vel_NED_E "Linear scaling, used for variable crt_PT_8e1022_INS_Vel_NED_E, signal INS_Vel_NED_E" RAT_FUNC "%12" "m/s" COEFFS 0 1 -0.0 0 0 1.0E-4 /end COMPU_METHOD
/* Measurement point for signal INS_Pos_ECEF_Y of frame RT_SB_INS_Pos_ECEF_2, 9307426 (0x8e0522) */
/begin MEASUREMENT crt_PT_8e0522_INS_Pos_ECEF_Y "signal INS_Pos_ECEF_Y of frame RT_SB_INS_Pos_ECEF_2, 9307426 (0x8e0522). ECEF Y position.  The ECEF Y axis originates from the Earth centre, and the positive Y axis intersects the Earth surface at zero degrees latittude and 90 degrees longitude." SLONG CONV_crt_PT_8e0522_INS_Pos_ECEF_Y 0.01 100.0 -1.0E7 1.0E7 ECU_ADDRESS 0x0000 /end MEASUREMENT
/begin COMPU_METHOD CONV_crt_PT_8e0522_INS_Pos_ECEF_Y "Linear scaling, used for variable crt_PT_8e0522_INS_Pos_ECEF_Y, signal INS_Pos_ECEF_Y" RAT_FUNC "%12" "m" COEFFS 0 1 -0.0 0 0 0.01 /end COMPU_METHOD
/* Measurement point for signal INS_Pos_ECEF_Z of frame RT_SB_INS_Pos_ECEF_2, 9307426 (0x8e0522) */
/begin MEASUREMENT crt_PT_8e0522_INS_Pos_ECEF_Z "signal INS_Pos_ECEF_Z of frame RT_SB_INS_Pos_ECEF_2, 9307426 (0x8e0522). ECEF Z position.  The ECEF Z axis originates from the Earth centre, and the positive Z axis intersects the Earth surface at the North Pole." SLONG CONV_crt_PT_8e0522_INS_Pos_ECEF_Z 0.01 100.0 -1.0E7 1.0E7 ECU_ADDRESS 0x0000 /end MEASUREMENT
/begin COMPU_METHOD CONV_crt_PT_8e0522_INS_Pos_ECEF_Z "Linear scaling, used for variable crt_PT_8e0522_INS_Pos_ECEF_Z, signal INS_Pos_ECEF_Z" RAT_FUNC "%12" "m" COEFFS 0 1 -0.0 0 0 0.01 /end COMPU_METHOD
/* Measurement point for signal Validity_INS_Pos_ECEF_X of frame RT_SB_INS_Pos_ECEF_1, 9307170 (0x8e0422) */
/begin MEASUREMENT crt_PT_8e0422_Validity_INS_Pos_ECEF_X "signal Validity_INS_Pos_ECEF_X of frame RT_SB_INS_Pos_ECEF_1, 9307170 (0x8e0422). Valid when bit is set, invalid when bit is clear." UBYTE CONV_crt_PT_8e0422_Validity_INS_Pos_ECEF_X 1.0 100.0 0 1 ECU_ADDRESS 0x0000 /end MEASUREMENT
/begin COMPU_METHOD CONV_crt_PT_8e0422_Validity_INS_Pos_ECEF_X "Linear scaling, used for variable crt_PT_8e0422_Validity_INS_Pos_ECEF_X, signal Validity_INS_Pos_ECEF_X" RAT_FUNC "%1" "" COEFFS 0 1 0 0 0 1 /end COMPU_METHOD
/* Measurement point for signal Validity_INS_Pos_ECEF_Y of frame RT_SB_INS_Pos_ECEF_1, 9307170 (0x8e0422) */
/begin MEASUREMENT crt_PT_8e0422_Validity_INS_Pos_ECEF_Y "signal Validity_INS_Pos_ECEF_Y of frame RT_SB_INS_Pos_ECEF_1, 9307170 (0x8e0422). Valid when bit is set, invalid when bit is clear." UBYTE CONV_crt_PT_8e0422_Validity_INS_Pos_ECEF_Y 1.0 100.0 0 1 ECU_ADDRESS 0x0000 /end MEASUREMENT
/begin COMPU_METHOD CONV_crt_PT_8e0422_Validity_INS_Pos_ECEF_Y "Linear scaling, used for variable crt_PT_8e0422_Validity_INS_Pos_ECEF_Y, signal Validity_INS_Pos_ECEF_Y" RAT_FUNC "%1" "" COEFFS 0 1 0 0 0 1 /end COMPU_METHOD
/* Measurement point for signal Validity_INS_Pos_ECEF_Z of frame RT_SB_INS_Pos_ECEF_1, 9307170 (0x8e0422) */
/begin MEASUREMENT crt_PT_8e0422_Validity_INS_Pos_ECEF_Z "signal Validity_INS_Pos_ECEF_Z of frame RT_SB_INS_Pos_ECEF_1, 9307170 (0x8e0422). Valid when bit is set, invalid when bit is clear." UBYTE CONV_crt_PT_8e0422_Validity_INS_Pos_ECEF_Z 1.0 100.0 0 1 ECU_ADDRESS 0x0000 /end MEASUREMENT
/begin COMPU_METHOD CONV_crt_PT_8e0422_Validity_INS_Pos_ECEF_Z "Linear scaling, used for variable crt_PT_8e0422_Validity_INS_Pos_ECEF_Z, signal Validity_INS_Pos_ECEF_Z" RAT_FUNC "%1" "" COEFFS 0 1 0 0 0 1 /end COMPU_METHOD
/* Measurement point for signal Accuracy_INS_Pos_ECEF_X of frame RT_SB_INS_Pos_ECEF_1, 9307170 (0x8e0422) */
/begin MEASUREMENT crt_PT_8e0422_Accuracy_INS_Pos_ECEF_X "signal Accuracy_INS_Pos_ECEF_X of frame RT_SB_INS_Pos_ECEF_1, 9307170 (0x8e0422). Dimensionless.  Lower values imply but do not guarantee better accuracy than higher values." UBYTE CONV_crt_PT_8e0422_Accuracy_INS_Pos_ECEF_X 1.0 100.0 0 255 ECU_ADDRESS 0x0000 /end MEASUREMENT
/begin COMPU_METHOD CONV_crt_PT_8e0422_Accuracy_INS_Pos_ECEF_X "Linear scaling, used for variable crt_PT_8e0422_Accuracy_INS_Pos_ECEF_X, signal Accuracy_INS_Pos_ECEF_X" RAT_FUNC "%4" "" COEFFS 0 1 0 0 0 1 /end COMPU_METHOD
/* Measurement point for signal Accuracy_INS_Pos_ECEF_Y of frame RT_SB_INS_Pos_ECEF_1, 9307170 (0x8e0422) */
/begin MEASUREMENT crt_PT_8e0422_Accuracy_INS_Pos_ECEF_Y "signal Accuracy_INS_Pos_ECEF_Y of frame RT_SB_INS_Pos_ECEF_1, 9307170 (0x8e0422). Dimensionless.  Lower values imply but do not guarantee better accuracy than higher values." UBYTE CONV_crt_PT_8e0422_Accuracy_INS_Pos_ECEF_Y 1.0 100.0 0 255 ECU_ADDRESS 0x0000 /end MEASUREMENT
/begin COMPU_METHOD CONV_crt_PT_8e0422_Accuracy_INS_Pos_ECEF_Y "Linear scaling, used for variable crt_PT_8e0422_Accuracy_INS_Pos_ECEF_Y, signal Accuracy_INS_Pos_ECEF_Y" RAT_FUNC "%4" "" COEFFS 0 1 0 0 0 1 /end COMPU_METHOD
/* Measurement point for signal Accuracy_INS_Pos_ECEF_Z of frame RT_SB_INS_Pos_ECEF_1, 9307170 (0x8e0422) */
/begin MEASUREMENT crt_PT_8e0422_Accuracy_INS_Pos_ECEF_Z "signal Accuracy_INS_Pos_ECEF_Z of frame RT_SB_INS_Pos_ECEF_1, 9307170 (0x8e0422). Dimensionless.  Lower values imply but do not guarantee better accuracy than higher values." UBYTE CONV_crt_PT_8e0422_Accuracy_INS_Pos_ECEF_Z 1.0 100.0 0 255 ECU_ADDRESS 0x0000 /end MEASUREMENT
/begin COMPU_METHOD CONV_crt_PT_8e0422_Accuracy_INS_Pos_ECEF_Z "Linear scaling, used for variable crt_PT_8e0422_Accuracy_INS_Pos_ECEF_Z, signal Accuracy_INS_Pos_ECEF_Z" RAT_FUNC "%4" "" COEFFS 0 1 0 0 0 1 /end COMPU_METHOD
/* Measurement point for signal INS_Pos_ECEF_X of frame RT_SB_INS_Pos_ECEF_1, 9307170 (0x8e0422) */
/begin MEASUREMENT crt_PT_8e0422_INS_Pos_ECEF_X "signal INS_Pos_ECEF_X of frame RT_SB_INS_Pos_ECEF_1, 9307170 (0x8e0422). ECEF X position.  The ECEF X axis originates from the Earth centre, and the positive X axis intersects the Earth surface at zero degrees latittude and zero degrees longitude (the intersection of the equator and the prime meridian)." SLONG CONV_crt_PT_8e0422_INS_Pos_ECEF_X 0.01 100.0 -1.0E7 1.0E7 ECU_ADDRESS 0x0000 /end MEASUREMENT
/begin COMPU_METHOD CONV_crt_PT_8e0422_INS_Pos_ECEF_X "Linear scaling, used for variable crt_PT_8e0422_INS_Pos_ECEF_X, signal INS_Pos_ECEF_X" RAT_FUNC "%12" "m" COEFFS 0 1 -0.0 0 0 0.01 /end COMPU_METHOD
/* Measurement point for signal INS_Pos_LLH_Longitude of frame RT_SB_INS_Pos_LLH_2, 9306914 (0x8e0322) */
/begin MEASUREMENT crt_PT_8e0322_INS_Pos_LLH_Longitude "signal INS_Pos_LLH_Longitude of frame RT_SB_INS_Pos_LLH_2, 9306914 (0x8e0322)" SLONG CONV_crt_PT_8e0322_INS_Pos_LLH_Longitude 1.0E-7 100.0 -180.0 180.0 ECU_ADDRESS 0x0000 /end MEASUREMENT
/begin COMPU_METHOD CONV_crt_PT_8e0322_INS_Pos_LLH_Longitude "Linear scaling, used for variable crt_PT_8e0322_INS_Pos_LLH_Longitude, signal INS_Pos_LLH_Longitude" RAT_FUNC "%12" "degrees" COEFFS 0 1 -0.0 0 0 1.0E-7 /end COMPU_METHOD
/* Measurement point for signal INS_Pos_LLH_Altitude of frame RT_SB_INS_Pos_LLH_2, 9306914 (0x8e0322) */
/begin MEASUREMENT crt_PT_8e0322_INS_Pos_LLH_Altitude "signal INS_Pos_LLH_Altitude of frame RT_SB_INS_Pos_LLH_2, 9306914 (0x8e0322)" SLONG CONV_crt_PT_8e0322_INS_Pos_LLH_Altitude 0.001 100.0 -1000.0 100000.0 ECU_ADDRESS 0x0000 /end MEASUREMENT
/begin COMPU_METHOD CONV_crt_PT_8e0322_INS_Pos_LLH_Altitude "Linear scaling, used for variable crt_PT_8e0322_INS_Pos_LLH_Altitude, signal INS_Pos_LLH_Altitude" RAT_FUNC "%12" "m" COEFFS 0 1 -0.0 0 0 0.001 /end COMPU_METHOD
/* Measurement point for signal Validity_INS_Pos_LLH_Latitude of frame RT_SB_INS_Pos_LLH_1, 9306658 (0x8e0222) */
/begin MEASUREMENT crt_PT_8e0222_Validity_INS_Pos_LLH_Latitude "signal Validity_INS_Pos_LLH_Latitude of frame RT_SB_INS_Pos_LLH_1, 9306658 (0x8e0222). Valid when bit is set, invalid when bit is clear." UBYTE CONV_crt_PT_8e0222_Validity_INS_Pos_LLH_Latitude 1.0 100.0 0 1 ECU_ADDRESS 0x0000 /end MEASUREMENT
/begin COMPU_METHOD CONV_crt_PT_8e0222_Validity_INS_Pos_LLH_Latitude "Linear scaling, used for variable crt_PT_8e0222_Validity_INS_Pos_LLH_Latitude, signal Validity_INS_Pos_LLH_Latitude" RAT_FUNC "%1" "" COEFFS 0 1 0 0 0 1 /end COMPU_METHOD
/* Measurement point for signal Validity_INS_Pos_LLH_Longitude of frame RT_SB_INS_Pos_LLH_1, 9306658 (0x8e0222) */
/begin MEASUREMENT crt_PT_8e0222_Validity_INS_Pos_LLH_Longitude "signal Validity_INS_Pos_LLH_Longitude of frame RT_SB_INS_Pos_LLH_1, 9306658 (0x8e0222). Valid when bit is set, invalid when bit is clear." UBYTE CONV_crt_PT_8e0222_Validity_INS_Pos_LLH_Longitude 1.0 100.0 0 1 ECU_ADDRESS 0x0000 /end MEASUREMENT
/begin COMPU_METHOD CONV_crt_PT_8e0222_Validity_INS_Pos_LLH_Longitude "Linear scaling, used for variable crt_PT_8e0222_Validity_INS_Pos_LLH_Longitude, signal Validity_INS_Pos_LLH_Longitude" RAT_FUNC "%1" "" COEFFS 0 1 0 0 0 1 /end COMPU_METHOD
/* Measurement point for signal Validity_INS_Pos_LLH_Altitude of frame RT_SB_INS_Pos_LLH_1, 9306658 (0x8e0222) */
/begin MEASUREMENT crt_PT_8e0222_Validity_INS_Pos_LLH_Altitude "signal Validity_INS_Pos_LLH_Altitude of frame RT_SB_INS_Pos_LLH_1, 9306658 (0x8e0222). Valid when bit is set, invalid when bit is clear." UBYTE CONV_crt_PT_8e0222_Validity_INS_Pos_LLH_Altitude 1.0 100.0 0 1 ECU_ADDRESS 0x0000 /end MEASUREMENT
/begin COMPU_METHOD CONV_crt_PT_8e0222_Validity_INS_Pos_LLH_Altitude "Linear scaling, used for variable crt_PT_8e0222_Validity_INS_Pos_LLH_Altitude, signal Validity_INS_Pos_LLH_Altitude" RAT_FUNC "%1" "" COEFFS 0 1 0 0 0 1 /end COMPU_METHOD
/* Measurement point for signal Accuracy_INS_Pos_LLH_Latitude of frame RT_SB_INS_Pos_LLH_1, 9306658 (0x8e0222) */
/begin MEASUREMENT crt_PT_8e0222_Accuracy_INS_Pos_LLH_Latitude "signal Accuracy_INS_Pos_LLH_Latitude of frame RT_SB_INS_Pos_LLH_1, 9306658 (0x8e0222). This accuracy value applies to both 2D and 3D GPS speed." UBYTE CONV_crt_PT_8e0222_Accuracy_INS_Pos_LLH_Latitude 1.0 100.0 0 255 ECU_ADDRESS 0x0000 /end MEASUREMENT
/begin COMPU_METHOD CONV_crt_PT_8e0222_Accuracy_INS_Pos_LLH_Latitude "Linear scaling, used for variable crt_PT_8e0222_Accuracy_INS_Pos_LLH_Latitude, signal Accuracy_INS_Pos_LLH_Latitude" RAT_FUNC "%4" "" COEFFS 0 1 0 0 0 1 /end COMPU_METHOD
/* Measurement point for signal Accuracy_INS_Pos_LLH_Longitude of frame RT_SB_INS_Pos_LLH_1, 9306658 (0x8e0222) */
/begin MEASUREMENT crt_PT_8e0222_Accuracy_INS_Pos_LLH_Longitude "signal Accuracy_INS_Pos_LLH_Longitude of frame RT_SB_INS_Pos_LLH_1, 9306658 (0x8e0222). This accuracy value applies to both 2D and 3D GPS speed." UBYTE CONV_crt_PT_8e0222_Accuracy_INS_Pos_LLH_Longitude 1.0 100.0 0 255 ECU_ADDRESS 0x0000 /end MEASUREMENT
/begin COMPU_METHOD CONV_crt_PT_8e0222_Accuracy_INS_Pos_LLH_Longitude "Linear scaling, used for variable crt_PT_8e0222_Accuracy_INS_Pos_LLH_Longitude, signal Accuracy_INS_Pos_LLH_Longitude" RAT_FUNC "%4" "" COEFFS 0 1 0 0 0 1 /end COMPU_METHOD
/* Measurement point for signal Accuracy_INS_Pos_LLH_Altitude of frame RT_SB_INS_Pos_LLH_1, 9306658 (0x8e0222) */
/begin MEASUREMENT crt_PT_8e0222_Accuracy_INS_Pos_LLH_Altitude "signal Accuracy_INS_Pos_LLH_Altitude of frame RT_SB_INS_Pos_LLH_1, 9306658 (0x8e0222). This accuracy value applies to both 2D and 3D GPS speed." UBYTE CONV_crt_PT_8e0222_Accuracy_INS_Pos_LLH_Altitude 1.0 100.0 0 255 ECU_ADDRESS 0x0000 /end MEASUREMENT
/begin COMPU_METHOD CONV_crt_PT_8e0222_Accuracy_INS_Pos_LLH_Altitude "Linear scaling, used for variable crt_PT_8e0222_Accuracy_INS_Pos_LLH_Altitude, signal Accuracy_INS_Pos_LLH_Altitude" RAT_FUNC "%4" "" COEFFS 0 1 0 0 0 1 /end COMPU_METHOD
/* Measurement point for signal INS_Pos_LLH_Latitude of frame RT_SB_INS_Pos_LLH_1, 9306658 (0x8e0222) */
/begin MEASUREMENT crt_PT_8e0222_INS_Pos_LLH_Latitude "signal INS_Pos_LLH_Latitude of frame RT_SB_INS_Pos_LLH_1, 9306658 (0x8e0222)" SLONG CONV_crt_PT_8e0222_INS_Pos_LLH_Latitude 1.0E-7 100.0 -90.0 90.0 ECU_ADDRESS 0x0000 /end MEASUREMENT
/begin COMPU_METHOD CONV_crt_PT_8e0222_INS_Pos_LLH_Latitude "Linear scaling, used for variable crt_PT_8e0222_INS_Pos_LLH_Latitude, signal INS_Pos_LLH_Latitude" RAT_FUNC "%12" "degrees" COEFFS 0 1 -0.0 0 0 1.0E-7 /end COMPU_METHOD
/* Measurement point for signal Validity_INS_Heading of frame RT_SB_INS_Heading_Gradient_2, 9311522 (0x8e1522) */
/begin MEASUREMENT crt_PT_8e1522_Validity_INS_Heading "signal Validity_INS_Heading of frame RT_SB_INS_Heading_Gradient_2, 9311522 (0x8e1522). Valid when bit is set, invalid when bit is clear." UBYTE CONV_crt_PT_8e1522_Validity_INS_Heading 1.0 100.0 0 1 ECU_ADDRESS 0x0000 /end MEASUREMENT
/begin COMPU_METHOD CONV_crt_PT_8e1522_Validity_INS_Heading "Linear scaling, used for variable crt_PT_8e1522_Validity_INS_Heading, signal Validity_INS_Heading" RAT_FUNC "%1" "" COEFFS 0 1 0 0 0 1 /end COMPU_METHOD
/* Measurement point for signal Validity_INS_Gradient of frame RT_SB_INS_Heading_Gradient_2, 9311522 (0x8e1522) */
/begin MEASUREMENT crt_PT_8e1522_Validity_INS_Gradient "signal Validity_INS_Gradient of frame RT_SB_INS_Heading_Gradient_2, 9311522 (0x8e1522). Valid when bit is set, invalid when bit is clear." UBYTE CONV_crt_PT_8e1522_Validity_INS_Gradient 1.0 100.0 0 1 ECU_ADDRESS 0x0000 /end MEASUREMENT
/begin COMPU_METHOD CONV_crt_PT_8e1522_Validity_INS_Gradient "Linear scaling, used for variable crt_PT_8e1522_Validity_INS_Gradient, signal Validity_INS_Gradient" RAT_FUNC "%1" "" COEFFS 0 1 0 0 0 1 /end COMPU_METHOD
/* Measurement point for signal Accuracy_INS_Heading of frame RT_SB_INS_Heading_Gradient_2, 9311522 (0x8e1522) */
/begin MEASUREMENT crt_PT_8e1522_Accuracy_INS_Heading "signal Accuracy_INS_Heading of frame RT_SB_INS_Heading_Gradient_2, 9311522 (0x8e1522). Dimensionless.  Lower values imply but do not guarantee better accuracy than higher values." UBYTE CONV_crt_PT_8e1522_Accuracy_INS_Heading 1.0 100.0 0 255 ECU_ADDRESS 0x0000 /end MEASUREMENT
/begin COMPU_METHOD CONV_crt_PT_8e1522_Accuracy_INS_Heading "Linear scaling, used for variable crt_PT_8e1522_Accuracy_INS_Heading, signal Accuracy_INS_Heading" RAT_FUNC "%4" "" COEFFS 0 1 0 0 0 1 /end COMPU_METHOD
/* Measurement point for signal INS_Heading_2 of frame RT_SB_INS_Heading_Gradient_2, 9311522 (0x8e1522) */
/begin MEASUREMENT crt_PT_8e1522_INS_Heading_2 "signal INS_Heading_2 of frame RT_SB_INS_Heading_Gradient_2, 9311522 (0x8e1522). This is GPS heading in the range 0 - 360., the direction that the vehicle is travelling in the local horizontal plane." UWORD CONV_crt_PT_8e1522_INS_Heading_2 0.01 100.0 0.0 360.0 ECU_ADDRESS 0x0000 /end MEASUREMENT
/begin COMPU_METHOD CONV_crt_PT_8e1522_INS_Heading_2 "Linear scaling, used for variable crt_PT_8e1522_INS_Heading_2, signal INS_Heading_2" RAT_FUNC "%6" "degrees" COEFFS 0 1 -0.0 0 0 0.01 /end COMPU_METHOD
/* Measurement point for signal Accuracy_INS_Gradient of frame RT_SB_INS_Heading_Gradient_2, 9311522 (0x8e1522) */
/begin MEASUREMENT crt_PT_8e1522_Accuracy_INS_Gradient "signal Accuracy_INS_Gradient of frame RT_SB_INS_Heading_Gradient_2, 9311522 (0x8e1522). Dimensionless.  Lower values imply but do not guarantee better accuracy than higher values." UBYTE CONV_crt_PT_8e1522_Accuracy_INS_Gradient 1.0 100.0 0 255 ECU_ADDRESS 0x0000 /end MEASUREMENT
/begin COMPU_METHOD CONV_crt_PT_8e1522_Accuracy_INS_Gradient "Linear scaling, used for variable crt_PT_8e1522_Accuracy_INS_Gradient, signal Accuracy_INS_Gradient" RAT_FUNC "%4" "" COEFFS 0 1 0 0 0 1 /end COMPU_METHOD
/* Measurement point for signal INS_Gradient of frame RT_SB_INS_Heading_Gradient_2, 9311522 (0x8e1522) */
/begin MEASUREMENT crt_PT_8e1522_INS_Gradient "signal INS_Gradient of frame RT_SB_INS_Heading_Gradient_2, 9311522 (0x8e1522). This is GPS gradient, i.e. the vertical direction that the vehicle is travelling, NOT pointing (pitch)." SWORD CONV_crt_PT_8e1522_INS_Gradient 0.01 100.0 -90.0 90.0 ECU_ADDRESS 0x0000 /end MEASUREMENT
/begin COMPU_METHOD CONV_crt_PT_8e1522_INS_Gradient "Linear scaling, used for variable crt_PT_8e1522_INS_Gradient, signal INS_Gradient" RAT_FUNC "%6" "degrees" COEFFS 0 1 -0.0 0 0 0.01 /end COMPU_METHOD
/* Measurement point for signal Validity_INS_Heading of frame RT_SB_INS_Heading_Gradient, 9311266 (0x8e1422) */
/begin MEASUREMENT crt_PT_8e1422_Validity_INS_Heading "signal Validity_INS_Heading of frame RT_SB_INS_Heading_Gradient, 9311266 (0x8e1422). Valid when bit is set, invalid when bit is clear." UBYTE CONV_crt_PT_8e1422_Validity_INS_Heading 1.0 100.0 0 1 ECU_ADDRESS 0x0000 /end MEASUREMENT
/begin COMPU_METHOD CONV_crt_PT_8e1422_Validity_INS_Heading "Linear scaling, used for variable crt_PT_8e1422_Validity_INS_Heading, signal Validity_INS_Heading" RAT_FUNC "%1" "" COEFFS 0 1 0 0 0 1 /end COMPU_METHOD
/* Measurement point for signal Validity_INS_Gradient of frame RT_SB_INS_Heading_Gradient, 9311266 (0x8e1422) */
/begin MEASUREMENT crt_PT_8e1422_Validity_INS_Gradient "signal Validity_INS_Gradient of frame RT_SB_INS_Heading_Gradient, 9311266 (0x8e1422). Valid when bit is set, invalid when bit is clear." UBYTE CONV_crt_PT_8e1422_Validity_INS_Gradient 1.0 100.0 0 1 ECU_ADDRESS 0x0000 /end MEASUREMENT
/begin COMPU_METHOD CONV_crt_PT_8e1422_Validity_INS_Gradient "Linear scaling, used for variable crt_PT_8e1422_Validity_INS_Gradient, signal Validity_INS_Gradient" RAT_FUNC "%1" "" COEFFS 0 1 0 0 0 1 /end COMPU_METHOD
/* Measurement point for signal Accuracy_INS_Heading of frame RT_SB_INS_Heading_Gradient, 9311266 (0x8e1422) */
/begin MEASUREMENT crt_PT_8e1422_Accuracy_INS_Heading "signal Accuracy_INS_Heading of frame RT_SB_INS_Heading_Gradient, 9311266 (0x8e1422). Dimensionless.  Lower values imply but do not guarantee better accuracy than higher values." UBYTE CONV_crt_PT_8e1422_Accuracy_INS_Heading 1.0 100.0 0 255 ECU_ADDRESS 0x0000 /end MEASUREMENT
/begin COMPU_METHOD CONV_crt_PT_8e1422_Accuracy_INS_Heading "Linear scaling, used for variable crt_PT_8e1422_Accuracy_INS_Heading, signal Accuracy_INS_Heading" RAT_FUNC "%4" "" COEFFS 0 1 0 0 0 1 /end COMPU_METHOD
/* Measurement point for signal INS_Heading of frame RT_SB_INS_Heading_Gradient, 9311266 (0x8e1422) */
/begin MEASUREMENT crt_PT_8e1422_INS_Heading "signal INS_Heading of frame RT_SB_INS_Heading_Gradient, 9311266 (0x8e1422). This is GPS heading, the direction that the vehicle is travelling in the local horizontal plane." SWORD CONV_crt_PT_8e1422_INS_Heading 0.01 100.0 -180.0 180.0 ECU_ADDRESS 0x0000 /end MEASUREMENT
/begin COMPU_METHOD CONV_crt_PT_8e1422_INS_Heading "Linear scaling, used for variable crt_PT_8e1422_INS_Heading, signal INS_Heading" RAT_FUNC "%6" "degrees" COEFFS 0 1 -0.0 0 0 0.01 /end COMPU_METHOD
/* Measurement point for signal Accuracy_INS_Gradient of frame RT_SB_INS_Heading_Gradient, 9311266 (0x8e1422) */
/begin MEASUREMENT crt_PT_8e1422_Accuracy_INS_Gradient "signal Accuracy_INS_Gradient of frame RT_SB_INS_Heading_Gradient, 9311266 (0x8e1422). Dimensionless.  Lower values imply but do not guarantee better accuracy than higher values." UBYTE CONV_crt_PT_8e1422_Accuracy_INS_Gradient 1.0 100.0 0 255 ECU_ADDRESS 0x0000 /end MEASUREMENT
/begin COMPU_METHOD CONV_crt_PT_8e1422_Accuracy_INS_Gradient "Linear scaling, used for variable crt_PT_8e1422_Accuracy_INS_Gradient, signal Accuracy_INS_Gradient" RAT_FUNC "%4" "" COEFFS 0 1 0 0 0 1 /end COMPU_METHOD
/* Measurement point for signal INS_Gradient of frame RT_SB_INS_Heading_Gradient, 9311266 (0x8e1422) */
/begin MEASUREMENT crt_PT_8e1422_INS_Gradient "signal INS_Gradient of frame RT_SB_INS_Heading_Gradient, 9311266 (0x8e1422). This is GPS gradient, i.e. the vertical direction that the vehicle is travelling, NOT pointing (pitch)." SWORD CONV_crt_PT_8e1422_INS_Gradient 0.01 100.0 -90.0 90.0 ECU_ADDRESS 0x0000 /end MEASUREMENT
/begin COMPU_METHOD CONV_crt_PT_8e1422_INS_Gradient "Linear scaling, used for variable crt_PT_8e1422_INS_Gradient, signal INS_Gradient" RAT_FUNC "%6" "degrees" COEFFS 0 1 -0.0 0 0 0.01 /end COMPU_METHOD
/* Measurement point for signal INS_Status of frame RT_SB_INS_Status, 9306146 (0x8e0022) */
/begin MEASUREMENT crt_PT_8e0022_INS_Status "signal INS_Status of frame RT_SB_INS_Status, 9306146 (0x8e0022)" UBYTE CONV_crt_PT_8e0022_INS_Status 1.0 100.0 0 255 ECU_ADDRESS 0x0000 /end MEASUREMENT
/begin COMPU_METHOD CONV_crt_PT_8e0022_INS_Status "Linear scaling, used for variable crt_PT_8e0022_INS_Status, signal INS_Status" RAT_FUNC "%4" "" COEFFS 0 1 0 0 0 1 /end COMPU_METHOD
/* Measurement point for signal Validity_Yaw of frame RT_SB_INS_Attitude, 9306402 (0x8e0122) */
/begin MEASUREMENT crt_PT_8e0122_Validity_Yaw "signal Validity_Yaw of frame RT_SB_INS_Attitude, 9306402 (0x8e0122)" UBYTE CONV_crt_PT_8e0122_Validity_Yaw 1.0 100.0 0 1 ECU_ADDRESS 0x0000 /end MEASUREMENT
/begin COMPU_METHOD CONV_crt_PT_8e0122_Validity_Yaw "Linear scaling, used for variable crt_PT_8e0122_Validity_Yaw, signal Validity_Yaw" RAT_FUNC "%1" "" COEFFS 0 1 0 0 0 1 /end COMPU_METHOD
/* Measurement point for signal Validity_Pitch of frame RT_SB_INS_Attitude, 9306402 (0x8e0122) */
/begin MEASUREMENT crt_PT_8e0122_Validity_Pitch "signal Validity_Pitch of frame RT_SB_INS_Attitude, 9306402 (0x8e0122)" UBYTE CONV_crt_PT_8e0122_Validity_Pitch 1.0 100.0 0 1 ECU_ADDRESS 0x0000 /end MEASUREMENT
/begin COMPU_METHOD CONV_crt_PT_8e0122_Validity_Pitch "Linear scaling, used for variable crt_PT_8e0122_Validity_Pitch, signal Validity_Pitch" RAT_FUNC "%1" "" COEFFS 0 1 0 0 0 1 /end COMPU_METHOD
/* Measurement point for signal Validity_Roll of frame RT_SB_INS_Attitude, 9306402 (0x8e0122) */
/begin MEASUREMENT crt_PT_8e0122_Validity_Roll "signal Validity_Roll of frame RT_SB_INS_Attitude, 9306402 (0x8e0122)" UBYTE CONV_crt_PT_8e0122_Validity_Roll 1.0 100.0 0 1 ECU_ADDRESS 0x0000 /end MEASUREMENT
/begin COMPU_METHOD CONV_crt_PT_8e0122_Validity_Roll "Linear scaling, used for variable crt_PT_8e0122_Validity_Roll, signal Validity_Roll" RAT_FUNC "%1" "" COEFFS 0 1 0 0 0 1 /end COMPU_METHOD
/* Measurement point for signal Accuracy_Attitude of frame RT_SB_INS_Attitude, 9306402 (0x8e0122) */
/begin MEASUREMENT crt_PT_8e0122_Accuracy_Attitude "signal Accuracy_Attitude of frame RT_SB_INS_Attitude, 9306402 (0x8e0122)" UBYTE CONV_crt_PT_8e0122_Accuracy_Attitude 1.0 100.0 0 255 ECU_ADDRESS 0x0000 /end MEASUREMENT
/begin COMPU_METHOD CONV_crt_PT_8e0122_Accuracy_Attitude "Linear scaling, used for variable crt_PT_8e0122_Accuracy_Attitude, signal Accuracy_Attitude" RAT_FUNC "%4" "" COEFFS 0 1 0 0 0 1 /end COMPU_METHOD
/* Measurement point for signal Attitude_Yaw of frame RT_SB_INS_Attitude, 9306402 (0x8e0122) */
/begin MEASUREMENT crt_PT_8e0122_Attitude_Yaw "signal Attitude_Yaw of frame RT_SB_INS_Attitude, 9306402 (0x8e0122)" SWORD CONV_crt_PT_8e0122_Attitude_Yaw 0.01 100.0 -360.0 360.0 ECU_ADDRESS 0x0000 /end MEASUREMENT
/begin COMPU_METHOD CONV_crt_PT_8e0122_Attitude_Yaw "Linear scaling, used for variable crt_PT_8e0122_Attitude_Yaw, signal Attitude_Yaw" RAT_FUNC "%6" "degrees" COEFFS 0 1 -0.0 0 0 0.01 /end COMPU_METHOD
/* Measurement point for signal Attitude_Pitch of frame RT_SB_INS_Attitude, 9306402 (0x8e0122) */
/begin MEASUREMENT crt_PT_8e0122_Attitude_Pitch "signal Attitude_Pitch of frame RT_SB_INS_Attitude, 9306402 (0x8e0122)" SWORD CONV_crt_PT_8e0122_Attitude_Pitch 0.01 100.0 -360.0 360.0 ECU_ADDRESS 0x0000 /end MEASUREMENT
/begin COMPU_METHOD CONV_crt_PT_8e0122_Attitude_Pitch "Linear scaling, used for variable crt_PT_8e0122_Attitude_Pitch, signal Attitude_Pitch" RAT_FUNC "%6" "degrees" COEFFS 0 1 -0.0 0 0 0.01 /end COMPU_METHOD
/* Measurement point for signal Attitude_Roll of frame RT_SB_INS_Attitude, 9306402 (0x8e0122) */
/begin MEASUREMENT crt_PT_8e0122_Attitude_Roll "signal Attitude_Roll of frame RT_SB_INS_Attitude, 9306402 (0x8e0122)" SWORD CONV_crt_PT_8e0122_Attitude_Roll 0.01 100.0 -360.0 360.0 ECU_ADDRESS 0x0000 /end MEASUREMENT
/begin COMPU_METHOD CONV_crt_PT_8e0122_Attitude_Roll "Linear scaling, used for variable crt_PT_8e0122_Attitude_Roll, signal Attitude_Roll" RAT_FUNC "%6" "degrees" COEFFS 0 1 -0.0 0 0 0.01 /end COMPU_METHOD
/* Measurement point for signal Validity_Status_Timestamp of frame RT_SB_Output_Status, 9240866 (0x8d0122) */
/begin MEASUREMENT crt_PT_8d0122_Validity_Status_Timestamp "signal Validity_Status_Timestamp of frame RT_SB_Output_Status, 9240866 (0x8d0122). Valid when bit is set, invalid when bit is clear." UBYTE CONV_crt_PT_8d0122_Validity_Status_Timestamp 1.0 100.0 0 1 ECU_ADDRESS 0x0000 /end MEASUREMENT
/begin COMPU_METHOD CONV_crt_PT_8d0122_Validity_Status_Timestamp "Linear scaling, used for variable crt_PT_8d0122_Validity_Status_Timestamp, signal Validity_Status_Timestamp" RAT_FUNC "%1" "" COEFFS 0 1 0 0 0 1 /end COMPU_METHOD
/* Measurement point for signal Status_Analogue_1 of frame RT_SB_Output_Status, 9240866 (0x8d0122) */
/begin MEASUREMENT crt_PT_8d0122_Status_Analogue_1 "signal Status_Analogue_1 of frame RT_SB_Output_Status, 9240866 (0x8d0122). Analogue output status for channel 1." UBYTE CONV_crt_PT_8d0122_Status_Analogue_1 1.0 100.0 0 1 ECU_ADDRESS 0x0000 /end MEASUREMENT
/begin COMPU_METHOD CONV_crt_PT_8d0122_Status_Analogue_1 "Linear scaling, used for variable crt_PT_8d0122_Status_Analogue_1, signal Status_Analogue_1" RAT_FUNC "%1" "" COEFFS 0 1 0 0 0 1 /end COMPU_METHOD
/* Measurement point for signal Status_Analogue_2 of frame RT_SB_Output_Status, 9240866 (0x8d0122) */
/begin MEASUREMENT crt_PT_8d0122_Status_Analogue_2 "signal Status_Analogue_2 of frame RT_SB_Output_Status, 9240866 (0x8d0122). Analogue output status for channel 1." UBYTE CONV_crt_PT_8d0122_Status_Analogue_2 1.0 100.0 0 1 ECU_ADDRESS 0x0000 /end MEASUREMENT
/begin COMPU_METHOD CONV_crt_PT_8d0122_Status_Analogue_2 "Linear scaling, used for variable crt_PT_8d0122_Status_Analogue_2, signal Status_Analogue_2" RAT_FUNC "%1" "" COEFFS 0 1 0 0 0 1 /end COMPU_METHOD
/* Measurement point for signal Status_Analogue_3 of frame RT_SB_Output_Status, 9240866 (0x8d0122) */
/begin MEASUREMENT crt_PT_8d0122_Status_Analogue_3 "signal Status_Analogue_3 of frame RT_SB_Output_Status, 9240866 (0x8d0122). Analogue output status for channel 3." UBYTE CONV_crt_PT_8d0122_Status_Analogue_3 1.0 100.0 0 1 ECU_ADDRESS 0x0000 /end MEASUREMENT
/begin COMPU_METHOD CONV_crt_PT_8d0122_Status_Analogue_3 "Linear scaling, used for variable crt_PT_8d0122_Status_Analogue_3, signal Status_Analogue_3" RAT_FUNC "%1" "" COEFFS 0 1 0 0 0 1 /end COMPU_METHOD
/* Measurement point for signal Status_Analogue_4 of frame RT_SB_Output_Status, 9240866 (0x8d0122) */
/begin MEASUREMENT crt_PT_8d0122_Status_Analogue_4 "signal Status_Analogue_4 of frame RT_SB_Output_Status, 9240866 (0x8d0122). Analogue output status for channel 4." UBYTE CONV_crt_PT_8d0122_Status_Analogue_4 1.0 100.0 0 1 ECU_ADDRESS 0x0000 /end MEASUREMENT
/begin COMPU_METHOD CONV_crt_PT_8d0122_Status_Analogue_4 "Linear scaling, used for variable crt_PT_8d0122_Status_Analogue_4, signal Status_Analogue_4" RAT_FUNC "%1" "" COEFFS 0 1 0 0 0 1 /end COMPU_METHOD
/* Measurement point for signal Status_Pulse_Output of frame RT_SB_Output_Status, 9240866 (0x8d0122) */
/begin MEASUREMENT crt_PT_8d0122_Status_Pulse_Output "signal Status_Pulse_Output of frame RT_SB_Output_Status, 9240866 (0x8d0122). Pulse output activity status" UBYTE CONV_crt_PT_8d0122_Status_Pulse_Output 1.0 100.0 0 1 ECU_ADDRESS 0x0000 /end MEASUREMENT
/begin COMPU_METHOD CONV_crt_PT_8d0122_Status_Pulse_Output "Linear scaling, used for variable crt_PT_8d0122_Status_Pulse_Output, signal Status_Pulse_Output" RAT_FUNC "%1" "" COEFFS 0 1 0 0 0 1 /end COMPU_METHOD
/* Measurement point for signal Status_Serial_Output_1 of frame RT_SB_Output_Status, 9240866 (0x8d0122) */
/begin MEASUREMENT crt_PT_8d0122_Status_Serial_Output_1 "signal Status_Serial_Output_1 of frame RT_SB_Output_Status, 9240866 (0x8d0122). Status output of serial port 1" UBYTE CONV_crt_PT_8d0122_Status_Serial_Output_1 1.0 100.0 0 1 ECU_ADDRESS 0x0000 /end MEASUREMENT
/begin COMPU_METHOD CONV_crt_PT_8d0122_Status_Serial_Output_1 "Linear scaling, used for variable crt_PT_8d0122_Status_Serial_Output_1, signal Status_Serial_Output_1" RAT_FUNC "%1" "" COEFFS 0 1 0 0 0 1 /end COMPU_METHOD
/* Measurement point for signal Status_Serial_Output_2 of frame RT_SB_Output_Status, 9240866 (0x8d0122) */
/begin MEASUREMENT crt_PT_8d0122_Status_Serial_Output_2 "signal Status_Serial_Output_2 of frame RT_SB_Output_Status, 9240866 (0x8d0122). Status output of serial port 1" UBYTE CONV_crt_PT_8d0122_Status_Serial_Output_2 1.0 100.0 0 1 ECU_ADDRESS 0x0000 /end MEASUREMENT
/begin COMPU_METHOD CONV_crt_PT_8d0122_Status_Serial_Output_2 "Linear scaling, used for variable crt_PT_8d0122_Status_Serial_Output_2, signal Status_Serial_Output_2" RAT_FUNC "%1" "" COEFFS 0 1 0 0 0 1 /end COMPU_METHOD
/* Measurement point for signal Status_Trigger of frame RT_SB_Output_Status, 9240866 (0x8d0122) */
/begin MEASUREMENT crt_PT_8d0122_Status_Trigger "signal Status_Trigger of frame RT_SB_Output_Status, 9240866 (0x8d0122). Status of the trigger input" UBYTE CONV_crt_PT_8d0122_Status_Trigger 1.0 100.0 0 1 ECU_ADDRESS 0x0000 /end MEASUREMENT
/begin COMPU_METHOD CONV_crt_PT_8d0122_Status_Trigger "Linear scaling, used for variable crt_PT_8d0122_Status_Trigger, signal Status_Trigger" RAT_FUNC "%1" "" COEFFS 0 1 0 0 0 1 /end COMPU_METHOD
/* Measurement point for signal GPS_Time of frame RT_SB_Output_Status, 9240866 (0x8d0122) */
/begin MEASUREMENT crt_PT_8d0122_GPS_Time "signal GPS_Time of frame RT_SB_Output_Status, 9240866 (0x8d0122). GPS time is the time in seconds since midnight GMT on Saturday night." ULONG CONV_crt_PT_8d0122_GPS_Time 0.001 100.0 0.0 604800.0 ECU_ADDRESS 0x0000 /end MEASUREMENT
/begin COMPU_METHOD CONV_crt_PT_8d0122_GPS_Time "Linear scaling, used for variable crt_PT_8d0122_GPS_Time, signal GPS_Time" RAT_FUNC "%12" "s" COEFFS 0 1 -0.0 0 0 0.001 /end COMPU_METHOD
/* Measurement point for signal Validity_GPS_Heading of frame RT_SB_GPS_Heading_Gradient_2, 9180706 (0x8c1622) */
/begin MEASUREMENT crt_PT_8c1622_Validity_GPS_Heading "signal Validity_GPS_Heading of frame RT_SB_GPS_Heading_Gradient_2, 9180706 (0x8c1622). Valid when bit is set, invalid when bit is clear." UBYTE CONV_crt_PT_8c1622_Validity_GPS_Heading 1.0 100.0 0 1 ECU_ADDRESS 0x0000 /end MEASUREMENT
/begin COMPU_METHOD CONV_crt_PT_8c1622_Validity_GPS_Heading "Linear scaling, used for variable crt_PT_8c1622_Validity_GPS_Heading, signal Validity_GPS_Heading" RAT_FUNC "%1" "" COEFFS 0 1 0 0 0 1 /end COMPU_METHOD
/* Measurement point for signal Validity_GPS_Gradient of frame RT_SB_GPS_Heading_Gradient_2, 9180706 (0x8c1622) */
/begin MEASUREMENT crt_PT_8c1622_Validity_GPS_Gradient "signal Validity_GPS_Gradient of frame RT_SB_GPS_Heading_Gradient_2, 9180706 (0x8c1622). Valid when bit is set, invalid when bit is clear." UBYTE CONV_crt_PT_8c1622_Validity_GPS_Gradient 1.0 100.0 0 1 ECU_ADDRESS 0x0000 /end MEASUREMENT
/begin COMPU_METHOD CONV_crt_PT_8c1622_Validity_GPS_Gradient "Linear scaling, used for variable crt_PT_8c1622_Validity_GPS_Gradient, signal Validity_GPS_Gradient" RAT_FUNC "%1" "" COEFFS 0 1 0 0 0 1 /end COMPU_METHOD
/* Measurement point for signal Accuracy_GPS_Heading of frame RT_SB_GPS_Heading_Gradient_2, 9180706 (0x8c1622) */
/begin MEASUREMENT crt_PT_8c1622_Accuracy_GPS_Heading "signal Accuracy_GPS_Heading of frame RT_SB_GPS_Heading_Gradient_2, 9180706 (0x8c1622). Dimensionless.  Lower values imply but do not guarantee better accuracy than higher values." UBYTE CONV_crt_PT_8c1622_Accuracy_GPS_Heading 1.0 100.0 0 255 ECU_ADDRESS 0x0000 /end MEASUREMENT
/begin COMPU_METHOD CONV_crt_PT_8c1622_Accuracy_GPS_Heading "Linear scaling, used for variable crt_PT_8c1622_Accuracy_GPS_Heading, signal Accuracy_GPS_Heading" RAT_FUNC "%4" "" COEFFS 0 1 0 0 0 1 /end COMPU_METHOD
/* Measurement point for signal GPS_Heading_2 of frame RT_SB_GPS_Heading_Gradient_2, 9180706 (0x8c1622) */
/begin MEASUREMENT crt_PT_8c1622_GPS_Heading_2 "signal GPS_Heading_2 of frame RT_SB_GPS_Heading_Gradient_2, 9180706 (0x8c1622). This is GPS heading in the range 0 - 360., the direction that the vehicle is travelling in the local horizontal plane." UWORD CONV_crt_PT_8c1622_GPS_Heading_2 0.01 100.0 0.0 360.0 ECU_ADDRESS 0x0000 /end MEASUREMENT
/begin COMPU_METHOD CONV_crt_PT_8c1622_GPS_Heading_2 "Linear scaling, used for variable crt_PT_8c1622_GPS_Heading_2, signal GPS_Heading_2" RAT_FUNC "%6" "degrees" COEFFS 0 1 -0.0 0 0 0.01 /end COMPU_METHOD
/* Measurement point for signal Accuracy_GPS_Gradient of frame RT_SB_GPS_Heading_Gradient_2, 9180706 (0x8c1622) */
/begin MEASUREMENT crt_PT_8c1622_Accuracy_GPS_Gradient "signal Accuracy_GPS_Gradient of frame RT_SB_GPS_Heading_Gradient_2, 9180706 (0x8c1622). Dimensionless.  Lower values imply but do not guarantee better accuracy than higher values." UBYTE CONV_crt_PT_8c1622_Accuracy_GPS_Gradient 1.0 100.0 0 255 ECU_ADDRESS 0x0000 /end MEASUREMENT
/begin COMPU_METHOD CONV_crt_PT_8c1622_Accuracy_GPS_Gradient "Linear scaling, used for variable crt_PT_8c1622_Accuracy_GPS_Gradient, signal Accuracy_GPS_Gradient" RAT_FUNC "%4" "" COEFFS 0 1 0 0 0 1 /end COMPU_METHOD
/* Measurement point for signal GPS_Gradient of frame RT_SB_GPS_Heading_Gradient_2, 9180706 (0x8c1622) */
/begin MEASUREMENT crt_PT_8c1622_GPS_Gradient "signal GPS_Gradient of frame RT_SB_GPS_Heading_Gradient_2, 9180706 (0x8c1622). This is GPS gradient, i.e. the vertical direction that the vehicle is travelling, NOT pointing (pitch)." SWORD CONV_crt_PT_8c1622_GPS_Gradient 0.01 100.0 -90.0 90.0 ECU_ADDRESS 0x0000 /end MEASUREMENT
/begin COMPU_METHOD CONV_crt_PT_8c1622_GPS_Gradient "Linear scaling, used for variable crt_PT_8c1622_GPS_Gradient, signal GPS_Gradient" RAT_FUNC "%6" "degrees" COEFFS 0 1 -0.0 0 0 0.01 /end COMPU_METHOD
/* Measurement point for signal Validity_Cumulative_Time of frame RT_SB_Cumulative_Distance_2, 8397090 (0x802122) */
/begin MEASUREMENT crt_PT_802122_Validity_Cumulative_Time "signal Validity_Cumulative_Time of frame RT_SB_Cumulative_Distance_2, 8397090 (0x802122). Valid when bit is set, invalid when bit is clear." UBYTE CONV_crt_PT_802122_Validity_Cumulative_Time 1.0 100.0 0 1 ECU_ADDRESS 0x0000 /end MEASUREMENT
/begin COMPU_METHOD CONV_crt_PT_802122_Validity_Cumulative_Time "Linear scaling, used for variable crt_PT_802122_Validity_Cumulative_Time, signal Validity_Cumulative_Time" RAT_FUNC "%1" "" COEFFS 0 1 0 0 0 1 /end COMPU_METHOD
/* Measurement point for signal Validity_Cumulative_Distance of frame RT_SB_Cumulative_Distance_2, 8397090 (0x802122) */
/begin MEASUREMENT crt_PT_802122_Validity_Cumulative_Distance "signal Validity_Cumulative_Distance of frame RT_SB_Cumulative_Distance_2, 8397090 (0x802122). Valid when bit is set, invalid when bit is clear." UBYTE CONV_crt_PT_802122_Validity_Cumulative_Distance 1.0 100.0 0 1 ECU_ADDRESS 0x0000 /end MEASUREMENT
/begin COMPU_METHOD CONV_crt_PT_802122_Validity_Cumulative_Distance "Linear scaling, used for variable crt_PT_802122_Validity_Cumulative_Distance, signal Validity_Cumulative_Distance" RAT_FUNC "%1" "" COEFFS 0 1 0 0 0 1 /end COMPU_METHOD
/* Measurement point for signal Cumulative_Time of frame RT_SB_Cumulative_Distance_2, 8397090 (0x802122) */
/begin MEASUREMENT crt_PT_802122_Cumulative_Time "signal Cumulative_Time of frame RT_SB_Cumulative_Distance_2, 8397090 (0x802122)" ULONG CONV_crt_PT_802122_Cumulative_Time 0.01 100.0 0.0 167772.0 ECU_ADDRESS 0x0000 /end MEASUREMENT
/begin COMPU_METHOD CONV_crt_PT_802122_Cumulative_Time "Linear scaling, used for variable crt_PT_802122_Cumulative_Time, signal Cumulative_Time" RAT_FUNC "%12" "s" COEFFS 0 1 -0.0 0 0 0.01 /end COMPU_METHOD
/* Measurement point for signal Cumulative_Distance of frame RT_SB_Cumulative_Distance_2, 8397090 (0x802122) */
/begin MEASUREMENT crt_PT_802122_Cumulative_Distance "signal Cumulative_Distance of frame RT_SB_Cumulative_Distance_2, 8397090 (0x802122)" ULONG CONV_crt_PT_802122_Cumulative_Distance 0.001 100.0 0.0 4294970.0 ECU_ADDRESS 0x0000 /end MEASUREMENT
/begin COMPU_METHOD CONV_crt_PT_802122_Cumulative_Distance "Linear scaling, used for variable crt_PT_802122_Cumulative_Distance, signal Cumulative_Distance" RAT_FUNC "%12" "m" COEFFS 0 1 -0.0 0 0 0.001 /end COMPU_METHOD
/* Measurement point for signal Validity_Cumulative_Time of frame RT_SB_Cumulative_Distance_1, 8396834 (0x802022) */
/begin MEASUREMENT crt_PT_802022_Validity_Cumulative_Time "signal Validity_Cumulative_Time of frame RT_SB_Cumulative_Distance_1, 8396834 (0x802022). Valid when bit is set, invalid when bit is clear." UBYTE CONV_crt_PT_802022_Validity_Cumulative_Time 1.0 100.0 0 1 ECU_ADDRESS 0x0000 /end MEASUREMENT
/begin COMPU_METHOD CONV_crt_PT_802022_Validity_Cumulative_Time "Linear scaling, used for variable crt_PT_802022_Validity_Cumulative_Time, signal Validity_Cumulative_Time" RAT_FUNC "%1" "" COEFFS 0 1 0 0 0 1 /end COMPU_METHOD
/* Measurement point for signal Validity_Cumulative_Distance of frame RT_SB_Cumulative_Distance_1, 8396834 (0x802022) */
/begin MEASUREMENT crt_PT_802022_Validity_Cumulative_Distance "signal Validity_Cumulative_Distance of frame RT_SB_Cumulative_Distance_1, 8396834 (0x802022). Valid when bit is set, invalid when bit is clear." UBYTE CONV_crt_PT_802022_Validity_Cumulative_Distance 1.0 100.0 0 1 ECU_ADDRESS 0x0000 /end MEASUREMENT
/begin COMPU_METHOD CONV_crt_PT_802022_Validity_Cumulative_Distance "Linear scaling, used for variable crt_PT_802022_Validity_Cumulative_Distance, signal Validity_Cumulative_Distance" RAT_FUNC "%1" "" COEFFS 0 1 0 0 0 1 /end COMPU_METHOD
/* Measurement point for signal Cumulative_Time of frame RT_SB_Cumulative_Distance_1, 8396834 (0x802022) */
/begin MEASUREMENT crt_PT_802022_Cumulative_Time "signal Cumulative_Time of frame RT_SB_Cumulative_Distance_1, 8396834 (0x802022)" ULONG CONV_crt_PT_802022_Cumulative_Time 0.01 100.0 0.0 167772.0 ECU_ADDRESS 0x0000 /end MEASUREMENT
/begin COMPU_METHOD CONV_crt_PT_802022_Cumulative_Time "Linear scaling, used for variable crt_PT_802022_Cumulative_Time, signal Cumulative_Time" RAT_FUNC "%12" "s" COEFFS 0 1 -0.0 0 0 0.01 /end COMPU_METHOD
/* Measurement point for signal Cumulative_Distance of frame RT_SB_Cumulative_Distance_1, 8396834 (0x802022) */
/begin MEASUREMENT crt_PT_802022_Cumulative_Distance "signal Cumulative_Distance of frame RT_SB_Cumulative_Distance_1, 8396834 (0x802022)" ULONG CONV_crt_PT_802022_Cumulative_Distance 0.001 100.0 0.0 4294970.0 ECU_ADDRESS 0x0000 /end MEASUREMENT
/begin COMPU_METHOD CONV_crt_PT_802022_Cumulative_Distance "Linear scaling, used for variable crt_PT_802022_Cumulative_Distance, signal Cumulative_Distance" RAT_FUNC "%12" "m" COEFFS 0 1 -0.0 0 0 0.001 /end COMPU_METHOD
/* Measurement point for signal Validity_Trigger_Timestamp of frame RT_SB_Trigger_Timestamp, 9240610 (0x8d0022) */
/begin MEASUREMENT crt_PT_8d0022_Validity_Trigger_Timestamp "signal Validity_Trigger_Timestamp of frame RT_SB_Trigger_Timestamp, 9240610 (0x8d0022). Valid when bit is set, invalid when bit is clear." UBYTE CONV_crt_PT_8d0022_Validity_Trigger_Timestamp 1.0 100.0 0 1 ECU_ADDRESS 0x0000 /end MEASUREMENT
/begin COMPU_METHOD CONV_crt_PT_8d0022_Validity_Trigger_Timestamp "Linear scaling, used for variable crt_PT_8d0022_Validity_Trigger_Timestamp, signal Validity_Trigger_Timestamp" RAT_FUNC "%1" "" COEFFS 0 1 0 0 0 1 /end COMPU_METHOD
/* Measurement point for signal Accuracy_Trigger_Timestamp of frame RT_SB_Trigger_Timestamp, 9240610 (0x8d0022) */
/begin MEASUREMENT crt_PT_8d0022_Accuracy_Trigger_Timestamp "signal Accuracy_Trigger_Timestamp of frame RT_SB_Trigger_Timestamp, 9240610 (0x8d0022). Dimensionless.  Lower values imply but do not guarantee better accuracy than higher values." UBYTE CONV_crt_PT_8d0022_Accuracy_Trigger_Timestamp 1.0 100.0 0 255 ECU_ADDRESS 0x0000 /end MEASUREMENT
/begin COMPU_METHOD CONV_crt_PT_8d0022_Accuracy_Trigger_Timestamp "Linear scaling, used for variable crt_PT_8d0022_Accuracy_Trigger_Timestamp, signal Accuracy_Trigger_Timestamp" RAT_FUNC "%4" "" COEFFS 0 1 0 0 0 1 /end COMPU_METHOD
/* Measurement point for signal Trigger_Number of frame RT_SB_Trigger_Timestamp, 9240610 (0x8d0022) */
/begin MEASUREMENT crt_PT_8d0022_Trigger_Number "signal Trigger_Number of frame RT_SB_Trigger_Timestamp, 9240610 (0x8d0022). This is the ID of the trigger that generated the event, as marked on the case of the logger" UBYTE CONV_crt_PT_8d0022_Trigger_Number 1.0 100.0 0.0 128.0 ECU_ADDRESS 0x0000 /end MEASUREMENT
/begin COMPU_METHOD CONV_crt_PT_8d0022_Trigger_Number "Linear scaling, used for variable crt_PT_8d0022_Trigger_Number, signal Trigger_Number" RAT_FUNC "%4" "" COEFFS 0 1 -1.0 0 0 1.0 /end COMPU_METHOD
/* Measurement point for signal Trigger_Timestamp_Type of frame RT_SB_Trigger_Timestamp, 9240610 (0x8d0022) */
/begin MEASUREMENT crt_PT_8d0022_Trigger_Timestamp_Type "signal Trigger_Timestamp_Type of frame RT_SB_Trigger_Timestamp, 9240610 (0x8d0022)" UBYTE CONV_crt_PT_8d0022_Trigger_Timestamp_Type 1.0 100.0 0 1 ECU_ADDRESS 0x0000 /end MEASUREMENT
/begin COMPU_METHOD CONV_crt_PT_8d0022_Trigger_Timestamp_Type "Linear scaling, used for variable crt_PT_8d0022_Trigger_Timestamp_Type, signal Trigger_Timestamp_Type" RAT_FUNC "%1" "" COEFFS 0 1 0 0 0 1 /end COMPU_METHOD
/* Measurement point for signal GPS_High_Resolution_Time of frame RT_SB_Trigger_Timestamp, 9240610 (0x8d0022) */
/begin MEASUREMENT crt_PT_8d0022_GPS_High_Resolution_Time "signal GPS_High_Resolution_Time of frame RT_SB_Trigger_Timestamp, 9240610 (0x8d0022). GPS time of week to micro-second resolution." A_UINT64 CONV_crt_PT_8d0022_GPS_High_Resolution_Time 1.0E-6 100.0 0.0 604800.0 ECU_ADDRESS 0x0000 /end MEASUREMENT
/begin COMPU_METHOD CONV_crt_PT_8d0022_GPS_High_Resolution_Time "Linear scaling, used for variable crt_PT_8d0022_GPS_High_Resolution_Time, signal GPS_High_Resolution_Time" RAT_FUNC "%24" "s" COEFFS 0 1 -0.0 0 0 1.0E-6 /end COMPU_METHOD
/* Measurement point for signal Validity_Gyro_Rate_Yaw of frame RT_IMU06_Gyro_Rates, 8388897 (0x800121) */
/begin MEASUREMENT crt_PT_800121_Validity_Gyro_Rate_Yaw "signal Validity_Gyro_Rate_Yaw of frame RT_IMU06_Gyro_Rates, 8388897 (0x800121). Valid when bit is set, invalid when bit is clear." UBYTE CONV_crt_PT_800121_Validity_Gyro_Rate_Yaw 1.0 100.0 0 1 ECU_ADDRESS 0x0000 /end MEASUREMENT
/begin COMPU_METHOD CONV_crt_PT_800121_Validity_Gyro_Rate_Yaw "Linear scaling, used for variable crt_PT_800121_Validity_Gyro_Rate_Yaw, signal Validity_Gyro_Rate_Yaw" RAT_FUNC "%1" "" COEFFS 0 1 0 0 0 1 /end COMPU_METHOD
/* Measurement point for signal Validity_Gyro_Rate_Pitch of frame RT_IMU06_Gyro_Rates, 8388897 (0x800121) */
/begin MEASUREMENT crt_PT_800121_Validity_Gyro_Rate_Pitch "signal Validity_Gyro_Rate_Pitch of frame RT_IMU06_Gyro_Rates, 8388897 (0x800121). Valid when bit is set, invalid when bit is clear." UBYTE CONV_crt_PT_800121_Validity_Gyro_Rate_Pitch 1.0 100.0 0 1 ECU_ADDRESS 0x0000 /end MEASUREMENT
/begin COMPU_METHOD CONV_crt_PT_800121_Validity_Gyro_Rate_Pitch "Linear scaling, used for variable crt_PT_800121_Validity_Gyro_Rate_Pitch, signal Validity_Gyro_Rate_Pitch" RAT_FUNC "%1" "" COEFFS 0 1 0 0 0 1 /end COMPU_METHOD
/* Measurement point for signal Validity_Gyro_Rate_Roll of frame RT_IMU06_Gyro_Rates, 8388897 (0x800121) */
/begin MEASUREMENT crt_PT_800121_Validity_Gyro_Rate_Roll "signal Validity_Gyro_Rate_Roll of frame RT_IMU06_Gyro_Rates, 8388897 (0x800121). Valid when bit is set, invalid when bit is clear." UBYTE CONV_crt_PT_800121_Validity_Gyro_Rate_Roll 1.0 100.0 0 1 ECU_ADDRESS 0x0000 /end MEASUREMENT
/begin COMPU_METHOD CONV_crt_PT_800121_Validity_Gyro_Rate_Roll "Linear scaling, used for variable crt_PT_800121_Validity_Gyro_Rate_Roll, signal Validity_Gyro_Rate_Roll" RAT_FUNC "%1" "" COEFFS 0 1 0 0 0 1 /end COMPU_METHOD
/* Measurement point for signal Accuracy_Gyro_Rates of frame RT_IMU06_Gyro_Rates, 8388897 (0x800121) */
/begin MEASUREMENT crt_PT_800121_Accuracy_Gyro_Rates "signal Accuracy_Gyro_Rates of frame RT_IMU06_Gyro_Rates, 8388897 (0x800121). Dimensionless.  Lower values imply but do not guarantee better accuracy than higher values." UBYTE CONV_crt_PT_800121_Accuracy_Gyro_Rates 1.0 100.0 0 0 ECU_ADDRESS 0x0000 /end MEASUREMENT
/begin COMPU_METHOD CONV_crt_PT_800121_Accuracy_Gyro_Rates "Linear scaling, used for variable crt_PT_800121_Accuracy_Gyro_Rates, signal Accuracy_Gyro_Rates" RAT_FUNC "%4" "" COEFFS 0 1 0 0 0 1 /end COMPU_METHOD
/* Measurement point for signal Gyro_Rate_Yaw of frame RT_IMU06_Gyro_Rates, 8388897 (0x800121) */
/begin MEASUREMENT crt_PT_800121_Gyro_Rate_Yaw "signal Gyro_Rate_Yaw of frame RT_IMU06_Gyro_Rates, 8388897 (0x800121). Yaw rate is positive for clockwise rotation when looking down on the vehicle from above." SWORD CONV_crt_PT_800121_Gyro_Rate_Yaw 0.01 100.0 -327.0 327.0 ECU_ADDRESS 0x0000 /end MEASUREMENT
/begin COMPU_METHOD CONV_crt_PT_800121_Gyro_Rate_Yaw "Linear scaling, used for variable crt_PT_800121_Gyro_Rate_Yaw, signal Gyro_Rate_Yaw" RAT_FUNC "%6" "degrees/s" COEFFS 0 1 -0.0 0 0 0.01 /end COMPU_METHOD
/* Measurement point for signal Gyro_Rate_Pitch of frame RT_IMU06_Gyro_Rates, 8388897 (0x800121) */
/begin MEASUREMENT crt_PT_800121_Gyro_Rate_Pitch "signal Gyro_Rate_Pitch of frame RT_IMU06_Gyro_Rates, 8388897 (0x800121). Pitch rate is positive for clockwise rotation when looking at the left hand side of the vehicle from the left of the vehicle." SWORD CONV_crt_PT_800121_Gyro_Rate_Pitch 0.01 100.0 -327.0 327.0 ECU_ADDRESS 0x0000 /end MEASUREMENT
/begin COMPU_METHOD CONV_crt_PT_800121_Gyro_Rate_Pitch "Linear scaling, used for variable crt_PT_800121_Gyro_Rate_Pitch, signal Gyro_Rate_Pitch" RAT_FUNC "%6" "degrees/s" COEFFS 0 1 -0.0 0 0 0.01 /end COMPU_METHOD
/* Measurement point for signal Gyro_Rate_Roll of frame RT_IMU06_Gyro_Rates, 8388897 (0x800121) */
/begin MEASUREMENT crt_PT_800121_Gyro_Rate_Roll "signal Gyro_Rate_Roll of frame RT_IMU06_Gyro_Rates, 8388897 (0x800121). Roll rate is positive for clockwise rotation when looking at the rear of the vehicle from behind the vehicle." SWORD CONV_crt_PT_800121_Gyro_Rate_Roll 0.01 100.0 -327.0 327.0 ECU_ADDRESS 0x0000 /end MEASUREMENT
/begin COMPU_METHOD CONV_crt_PT_800121_Gyro_Rate_Roll "Linear scaling, used for variable crt_PT_800121_Gyro_Rate_Roll, signal Gyro_Rate_Roll" RAT_FUNC "%6" "degrees/s" COEFFS 0 1 -0.0 0 0 0.01 /end COMPU_METHOD
/* Measurement point for signal Validity_Accel_Longitudinal of frame RT_IMU06_Accel, 8388641 (0x800021) */
/begin MEASUREMENT crt_PT_800021_Validity_Accel_Longitudinal "signal Validity_Accel_Longitudinal of frame RT_IMU06_Accel, 8388641 (0x800021). Valid when bit is set, invalid when bit is clear." UBYTE CONV_crt_PT_800021_Validity_Accel_Longitudinal 1.0 100.0 0 1 ECU_ADDRESS 0x0000 /end MEASUREMENT
/begin COMPU_METHOD CONV_crt_PT_800021_Validity_Accel_Longitudinal "Linear scaling, used for variable crt_PT_800021_Validity_Accel_Longitudinal, signal Validity_Accel_Longitudinal" RAT_FUNC "%1" "" COEFFS 0 1 0 0 0 1 /end COMPU_METHOD
/* Measurement point for signal Validity_Accel_Lateral of frame RT_IMU06_Accel, 8388641 (0x800021) */
/begin MEASUREMENT crt_PT_800021_Validity_Accel_Lateral "signal Validity_Accel_Lateral of frame RT_IMU06_Accel, 8388641 (0x800021). Valid when bit is set, invalid when bit is clear." UBYTE CONV_crt_PT_800021_Validity_Accel_Lateral 1.0 100.0 0 1 ECU_ADDRESS 0x0000 /end MEASUREMENT
/begin COMPU_METHOD CONV_crt_PT_800021_Validity_Accel_Lateral "Linear scaling, used for variable crt_PT_800021_Validity_Accel_Lateral, signal Validity_Accel_Lateral" RAT_FUNC "%1" "" COEFFS 0 1 0 0 0 1 /end COMPU_METHOD
/* Measurement point for signal Validity_Accel_Vertical of frame RT_IMU06_Accel, 8388641 (0x800021) */
/begin MEASUREMENT crt_PT_800021_Validity_Accel_Vertical "signal Validity_Accel_Vertical of frame RT_IMU06_Accel, 8388641 (0x800021). Valid when bit is set, invalid when bit is clear." UBYTE CONV_crt_PT_800021_Validity_Accel_Vertical 1.0 100.0 0 1 ECU_ADDRESS 0x0000 /end MEASUREMENT
/begin COMPU_METHOD CONV_crt_PT_800021_Validity_Accel_Vertical "Linear scaling, used for variable crt_PT_800021_Validity_Accel_Vertical, signal Validity_Accel_Vertical" RAT_FUNC "%1" "" COEFFS 0 1 0 0 0 1 /end COMPU_METHOD
/* Measurement point for signal Accuracy_Accel of frame RT_IMU06_Accel, 8388641 (0x800021) */
/begin MEASUREMENT crt_PT_800021_Accuracy_Accel "signal Accuracy_Accel of frame RT_IMU06_Accel, 8388641 (0x800021). Dimensionless.  Lower values imply but do not guarantee better accuracy than higher values." UBYTE CONV_crt_PT_800021_Accuracy_Accel 1.0 100.0 0 255 ECU_ADDRESS 0x0000 /end MEASUREMENT
/begin COMPU_METHOD CONV_crt_PT_800021_Accuracy_Accel "Linear scaling, used for variable crt_PT_800021_Accuracy_Accel, signal Accuracy_Accel" RAT_FUNC "%4" "" COEFFS 0 1 0 0 0 1 /end COMPU_METHOD
/* Measurement point for signal Accel_Longitudinal of frame RT_IMU06_Accel, 8388641 (0x800021) */
/begin MEASUREMENT crt_PT_800021_Accel_Longitudinal "signal Accel_Longitudinal of frame RT_IMU06_Accel, 8388641 (0x800021). Longitudinal acceleration.  This is positive when the vehicle accelerates in a forwards direction." SWORD CONV_crt_PT_800021_Accel_Longitudinal 0.001 100.0 -65.0 65.0 ECU_ADDRESS 0x0000 /end MEASUREMENT
/begin COMPU_METHOD CONV_crt_PT_800021_Accel_Longitudinal "Linear scaling, used for variable crt_PT_800021_Accel_Longitudinal, signal Accel_Longitudinal" RAT_FUNC "%6" "g" COEFFS 0 1 -0.0 0 0 0.001 /end COMPU_METHOD
/* Measurement point for signal Accel_Lateral of frame RT_IMU06_Accel, 8388641 (0x800021) */
/begin MEASUREMENT crt_PT_800021_Accel_Lateral "signal Accel_Lateral of frame RT_IMU06_Accel, 8388641 (0x800021). Lateral acceleration.  This is positive when the vehicle accelerates towards the right, e.g. when cornering around a right-hand bend." SWORD CONV_crt_PT_800021_Accel_Lateral 0.001 100.0 -65.0 65.0 ECU_ADDRESS 0x0000 /end MEASUREMENT
/begin COMPU_METHOD CONV_crt_PT_800021_Accel_Lateral "Linear scaling, used for variable crt_PT_800021_Accel_Lateral, signal Accel_Lateral" RAT_FUNC "%6" "g" COEFFS 0 1 -0.0 0 0 0.001 /end COMPU_METHOD
/* Measurement point for signal Accel_Vertical of frame RT_IMU06_Accel, 8388641 (0x800021) */
/begin MEASUREMENT crt_PT_800021_Accel_Vertical "signal Accel_Vertical of frame RT_IMU06_Accel, 8388641 (0x800021). Vertical acceleration.  This is positive when the vehicle accelerates in an upwards direction, e.g. when travelling through a dip." SWORD CONV_crt_PT_800021_Accel_Vertical 0.001 100.0 -65.0 65.0 ECU_ADDRESS 0x0000 /end MEASUREMENT
/begin COMPU_METHOD CONV_crt_PT_800021_Accel_Vertical "Linear scaling, used for variable crt_PT_800021_Accel_Vertical, signal Accel_Vertical" RAT_FUNC "%6" "g" COEFFS 0 1 -0.0 0 0 0.001 /end COMPU_METHOD
/* Measurement point for signal Validity_Speed of frame RT_SB_Speed, 8392738 (0x801022) */
/begin MEASUREMENT crt_PT_801022_Validity_Speed "signal Validity_Speed of frame RT_SB_Speed, 8392738 (0x801022). Valid when bit is set, invalid when bit is clear." UBYTE CONV_crt_PT_801022_Validity_Speed 1.0 100.0 0 1 ECU_ADDRESS 0x0000 /end MEASUREMENT
/begin COMPU_METHOD CONV_crt_PT_801022_Validity_Speed "Linear scaling, used for variable crt_PT_801022_Validity_Speed, signal Validity_Speed" RAT_FUNC "%1" "" COEFFS 0 1 0 0 0 1 /end COMPU_METHOD
/* Measurement point for signal Accuracy_Speed of frame RT_SB_Speed, 8392738 (0x801022) */
/begin MEASUREMENT crt_PT_801022_Accuracy_Speed "signal Accuracy_Speed of frame RT_SB_Speed, 8392738 (0x801022). Dimensionless.  Lower values imply but do not guarantee better accuracy than higher values." UBYTE CONV_crt_PT_801022_Accuracy_Speed 1.0 100.0 0 255 ECU_ADDRESS 0x0000 /end MEASUREMENT
/begin COMPU_METHOD CONV_crt_PT_801022_Accuracy_Speed "Linear scaling, used for variable crt_PT_801022_Accuracy_Speed, signal Accuracy_Speed" RAT_FUNC "%4" "" COEFFS 0 1 0 0 0 1 /end COMPU_METHOD
/* Measurement point for signal Speed of frame RT_SB_Speed, 8392738 (0x801022) */
/begin MEASUREMENT crt_PT_801022_Speed "signal Speed of frame RT_SB_Speed, 8392738 (0x801022)" SLONG CONV_crt_PT_801022_Speed 1.0E-5 100.0 -20000.0 20000.0 ECU_ADDRESS 0x0000 /end MEASUREMENT
/begin COMPU_METHOD CONV_crt_PT_801022_Speed "Linear scaling, used for variable crt_PT_801022_Speed, signal Speed" RAT_FUNC "%12" "m/s" COEFFS 0 1 -0.0 0 0 1.0E-5 /end COMPU_METHOD
/* Measurement point for signal Validity_RTK_Slip of frame RT_SB_RTK_Slip, 9183522 (0x8c2122) */
/begin MEASUREMENT crt_PT_8c2122_Validity_RTK_Slip "signal Validity_RTK_Slip of frame RT_SB_RTK_Slip, 9183522 (0x8c2122). Valid when bit is set, invalid when bit is clear." UBYTE CONV_crt_PT_8c2122_Validity_RTK_Slip 1.0 100.0 0 1 ECU_ADDRESS 0x0000 /end MEASUREMENT
/begin COMPU_METHOD CONV_crt_PT_8c2122_Validity_RTK_Slip "Linear scaling, used for variable crt_PT_8c2122_Validity_RTK_Slip, signal Validity_RTK_Slip" RAT_FUNC "%1" "" COEFFS 0 1 0 0 0 1 /end COMPU_METHOD
/* Measurement point for signal Validity_RTK_Squat of frame RT_SB_RTK_Slip, 9183522 (0x8c2122) */
/begin MEASUREMENT crt_PT_8c2122_Validity_RTK_Squat "signal Validity_RTK_Squat of frame RT_SB_RTK_Slip, 9183522 (0x8c2122). Valid when bit is set, invalid when bit is clear." UBYTE CONV_crt_PT_8c2122_Validity_RTK_Squat 1.0 100.0 0 1 ECU_ADDRESS 0x0000 /end MEASUREMENT
/begin COMPU_METHOD CONV_crt_PT_8c2122_Validity_RTK_Squat "Linear scaling, used for variable crt_PT_8c2122_Validity_RTK_Squat, signal Validity_RTK_Squat" RAT_FUNC "%1" "" COEFFS 0 1 0 0 0 1 /end COMPU_METHOD
/* Measurement point for signal Validity_RTK_Baseline of frame RT_SB_RTK_Slip, 9183522 (0x8c2122) */
/begin MEASUREMENT crt_PT_8c2122_Validity_RTK_Baseline "signal Validity_RTK_Baseline of frame RT_SB_RTK_Slip, 9183522 (0x8c2122). Valid when bit is set, invalid when bit is clear." UBYTE CONV_crt_PT_8c2122_Validity_RTK_Baseline 1.0 100.0 0 1 ECU_ADDRESS 0x0000 /end MEASUREMENT
/begin COMPU_METHOD CONV_crt_PT_8c2122_Validity_RTK_Baseline "Linear scaling, used for variable crt_PT_8c2122_Validity_RTK_Baseline, signal Validity_RTK_Baseline" RAT_FUNC "%1" "" COEFFS 0 1 0 0 0 1 /end COMPU_METHOD
/* Measurement point for signal Accuracy_RTK_Baseline of frame RT_SB_RTK_Slip, 9183522 (0x8c2122) */
/begin MEASUREMENT crt_PT_8c2122_Accuracy_RTK_Baseline "signal Accuracy_RTK_Baseline of frame RT_SB_RTK_Slip, 9183522 (0x8c2122)" UBYTE CONV_crt_PT_8c2122_Accuracy_RTK_Baseline 1.0 100.0 0 255 ECU_ADDRESS 0x0000 /end MEASUREMENT
/begin COMPU_METHOD CONV_crt_PT_8c2122_Accuracy_RTK_Baseline "Linear scaling, used for variable crt_PT_8c2122_Accuracy_RTK_Baseline, signal Accuracy_RTK_Baseline" RAT_FUNC "%4" "" COEFFS 0 1 0 0 0 1 /end COMPU_METHOD
/* Measurement point for signal RTK_Slip of frame RT_SB_RTK_Slip, 9183522 (0x8c2122) */
/begin MEASUREMENT crt_PT_8c2122_RTK_Slip "signal RTK_Slip of frame RT_SB_RTK_Slip, 9183522 (0x8c2122). Slip is defined as the difference between yaw and heading." SWORD CONV_crt_PT_8c2122_RTK_Slip 0.01 100.0 -360.0 360.0 ECU_ADDRESS 0x0000 /end MEASUREMENT
/begin COMPU_METHOD CONV_crt_PT_8c2122_RTK_Slip "Linear scaling, used for variable crt_PT_8c2122_RTK_Slip, signal RTK_Slip" RAT_FUNC "%6" "degrees" COEFFS 0 1 -0.0 0 0 0.01 /end COMPU_METHOD
/* Measurement point for signal RTK_Squat of frame RT_SB_RTK_Slip, 9183522 (0x8c2122) */
/begin MEASUREMENT crt_PT_8c2122_RTK_Squat "signal RTK_Squat of frame RT_SB_RTK_Slip, 9183522 (0x8c2122). Squat is defined as the difference between pitch and gradient." SWORD CONV_crt_PT_8c2122_RTK_Squat 0.01 100.0 -360.0 360.0 ECU_ADDRESS 0x0000 /end MEASUREMENT
/begin COMPU_METHOD CONV_crt_PT_8c2122_RTK_Squat "Linear scaling, used for variable crt_PT_8c2122_RTK_Squat, signal RTK_Squat" RAT_FUNC "%6" "degrees" COEFFS 0 1 -0.0 0 0 0.01 /end COMPU_METHOD
/* Measurement point for signal RTK_Baseline of frame RT_SB_RTK_Slip, 9183522 (0x8c2122) */
/begin MEASUREMENT crt_PT_8c2122_RTK_Baseline "signal RTK_Baseline of frame RT_SB_RTK_Slip, 9183522 (0x8c2122). This is the estimated baseline length calculated by the RTK solution." UWORD CONV_crt_PT_8c2122_RTK_Baseline 1.0 100.0 0 65535 ECU_ADDRESS 0x0000 /end MEASUREMENT
/begin COMPU_METHOD CONV_crt_PT_8c2122_RTK_Baseline "Linear scaling, used for variable crt_PT_8c2122_RTK_Baseline, signal RTK_Baseline" RAT_FUNC "%6" "mm" COEFFS 0 1 0 0 0 1 /end COMPU_METHOD
/* Measurement point for signal Validity_RTK_Yaw of frame RT_SB_RTK_Attitude, 9183266 (0x8c2022) */
/begin MEASUREMENT crt_PT_8c2022_Validity_RTK_Yaw "signal Validity_RTK_Yaw of frame RT_SB_RTK_Attitude, 9183266 (0x8c2022). Valid when bit is set, invalid when bit is clear." UBYTE CONV_crt_PT_8c2022_Validity_RTK_Yaw 1.0 100.0 0 1 ECU_ADDRESS 0x0000 /end MEASUREMENT
/begin COMPU_METHOD CONV_crt_PT_8c2022_Validity_RTK_Yaw "Linear scaling, used for variable crt_PT_8c2022_Validity_RTK_Yaw, signal Validity_RTK_Yaw" RAT_FUNC "%1" "" COEFFS 0 1 0 0 0 1 /end COMPU_METHOD
/* Measurement point for signal Validity_RTK_Pitch of frame RT_SB_RTK_Attitude, 9183266 (0x8c2022) */
/begin MEASUREMENT crt_PT_8c2022_Validity_RTK_Pitch "signal Validity_RTK_Pitch of frame RT_SB_RTK_Attitude, 9183266 (0x8c2022). Valid when bit is set, invalid when bit is clear." UBYTE CONV_crt_PT_8c2022_Validity_RTK_Pitch 1.0 100.0 0 1 ECU_ADDRESS 0x0000 /end MEASUREMENT
/begin COMPU_METHOD CONV_crt_PT_8c2022_Validity_RTK_Pitch "Linear scaling, used for variable crt_PT_8c2022_Validity_RTK_Pitch, signal Validity_RTK_Pitch" RAT_FUNC "%1" "" COEFFS 0 1 0 0 0 1 /end COMPU_METHOD
/* Measurement point for signal Validity_RTK_Roll of frame RT_SB_RTK_Attitude, 9183266 (0x8c2022) */
/begin MEASUREMENT crt_PT_8c2022_Validity_RTK_Roll "signal Validity_RTK_Roll of frame RT_SB_RTK_Attitude, 9183266 (0x8c2022). Valid when bit is set, invalid when bit is clear." UBYTE CONV_crt_PT_8c2022_Validity_RTK_Roll 1.0 100.0 0 1 ECU_ADDRESS 0x0000 /end MEASUREMENT
/begin COMPU_METHOD CONV_crt_PT_8c2022_Validity_RTK_Roll "Linear scaling, used for variable crt_PT_8c2022_Validity_RTK_Roll, signal Validity_RTK_Roll" RAT_FUNC "%1" "" COEFFS 0 1 0 0 0 1 /end COMPU_METHOD
/* Measurement point for signal Accuracy_RTK_Attitude of frame RT_SB_RTK_Attitude, 9183266 (0x8c2022) */
/begin MEASUREMENT crt_PT_8c2022_Accuracy_RTK_Attitude "signal Accuracy_RTK_Attitude of frame RT_SB_RTK_Attitude, 9183266 (0x8c2022). Note that RTK yaw is typically up to about 4 times more accurate than RTK pitch or roll." UBYTE CONV_crt_PT_8c2022_Accuracy_RTK_Attitude 1.0 100.0 0 255 ECU_ADDRESS 0x0000 /end MEASUREMENT
/begin COMPU_METHOD CONV_crt_PT_8c2022_Accuracy_RTK_Attitude "Linear scaling, used for variable crt_PT_8c2022_Accuracy_RTK_Attitude, signal Accuracy_RTK_Attitude" RAT_FUNC "%4" "" COEFFS 0 1 0 0 0 1 /end COMPU_METHOD
/* Measurement point for signal RTK_Attitude_Yaw of frame RT_SB_RTK_Attitude, 9183266 (0x8c2022) */
/begin MEASUREMENT crt_PT_8c2022_RTK_Attitude_Yaw "signal RTK_Attitude_Yaw of frame RT_SB_RTK_Attitude, 9183266 (0x8c2022). RTK attitude is determined from the MB-RTK solution only.  Yaw is positive for a clockwise rotational displacement from due North, looking down on the vehicle from above." SWORD CONV_crt_PT_8c2022_RTK_Attitude_Yaw 0.01 100.0 -360.0 360.0 ECU_ADDRESS 0x0000 /end MEASUREMENT
/begin COMPU_METHOD CONV_crt_PT_8c2022_RTK_Attitude_Yaw "Linear scaling, used for variable crt_PT_8c2022_RTK_Attitude_Yaw, signal RTK_Attitude_Yaw" RAT_FUNC "%6" "degrees" COEFFS 0 1 -0.0 0 0 0.01 /end COMPU_METHOD
/* Measurement point for signal RTK_Attitude_Pitch of frame RT_SB_RTK_Attitude, 9183266 (0x8c2022) */
/begin MEASUREMENT crt_PT_8c2022_RTK_Attitude_Pitch "signal RTK_Attitude_Pitch of frame RT_SB_RTK_Attitude, 9183266 (0x8c2022). RTK attitude is determined from the MB-RTK solution only.  Pitch is positive for a clockwise rotational displacement from the local horizontal plane when looking at the vehicle from the left hand side of it." SWORD CONV_crt_PT_8c2022_RTK_Attitude_Pitch 0.01 100.0 -90.0 90.0 ECU_ADDRESS 0x0000 /end MEASUREMENT
/begin COMPU_METHOD CONV_crt_PT_8c2022_RTK_Attitude_Pitch "Linear scaling, used for variable crt_PT_8c2022_RTK_Attitude_Pitch, signal RTK_Attitude_Pitch" RAT_FUNC "%6" "degrees" COEFFS 0 1 -0.0 0 0 0.01 /end COMPU_METHOD
/* Measurement point for signal RTK_Attitude_Roll of frame RT_SB_RTK_Attitude, 9183266 (0x8c2022) */
/begin MEASUREMENT crt_PT_8c2022_RTK_Attitude_Roll "signal RTK_Attitude_Roll of frame RT_SB_RTK_Attitude, 9183266 (0x8c2022). RTK attitude is determined from the MB-RTK solution only.  Roll is positive for a clockwise rotational displacement relative to the local horizontal plane when looking at the vehicle from the rear of it." SWORD CONV_crt_PT_8c2022_RTK_Attitude_Roll 0.01 100.0 -90.0 90.0 ECU_ADDRESS 0x0000 /end MEASUREMENT
/begin COMPU_METHOD CONV_crt_PT_8c2022_RTK_Attitude_Roll "Linear scaling, used for variable crt_PT_8c2022_RTK_Attitude_Roll, signal RTK_Attitude_Roll" RAT_FUNC "%6" "degrees" COEFFS 0 1 -0.0 0 0 0.01 /end COMPU_METHOD
/* Measurement point for signal Validity_GPS_Lateral_Accel of frame RT_SB_GPS_Mcycle_Lean, 9187362 (0x8c3022) */
/begin MEASUREMENT crt_PT_8c3022_Validity_GPS_Lateral_Accel "signal Validity_GPS_Lateral_Accel of frame RT_SB_GPS_Mcycle_Lean, 9187362 (0x8c3022). Valid when bit is set, invalid when bit is clear." UBYTE CONV_crt_PT_8c3022_Validity_GPS_Lateral_Accel 1.0 100.0 0 1 ECU_ADDRESS 0x0000 /end MEASUREMENT
/begin COMPU_METHOD CONV_crt_PT_8c3022_Validity_GPS_Lateral_Accel "Linear scaling, used for variable crt_PT_8c3022_Validity_GPS_Lateral_Accel, signal Validity_GPS_Lateral_Accel" RAT_FUNC "%1" "" COEFFS 0 1 0 0 0 1 /end COMPU_METHOD
/* Measurement point for signal Validity_GPS_Mcycle_Lean of frame RT_SB_GPS_Mcycle_Lean, 9187362 (0x8c3022) */
/begin MEASUREMENT crt_PT_8c3022_Validity_GPS_Mcycle_Lean "signal Validity_GPS_Mcycle_Lean of frame RT_SB_GPS_Mcycle_Lean, 9187362 (0x8c3022). Valid when bit is set, invalid when bit is clear." UBYTE CONV_crt_PT_8c3022_Validity_GPS_Mcycle_Lean 1.0 100.0 0 1 ECU_ADDRESS 0x0000 /end MEASUREMENT
/begin COMPU_METHOD CONV_crt_PT_8c3022_Validity_GPS_Mcycle_Lean "Linear scaling, used for variable crt_PT_8c3022_Validity_GPS_Mcycle_Lean, signal Validity_GPS_Mcycle_Lean" RAT_FUNC "%1" "" COEFFS 0 1 0 0 0 1 /end COMPU_METHOD
/* Measurement point for signal Accuracy_GPS_Lateral_Accel of frame RT_SB_GPS_Mcycle_Lean, 9187362 (0x8c3022) */
/begin MEASUREMENT crt_PT_8c3022_Accuracy_GPS_Lateral_Accel "signal Accuracy_GPS_Lateral_Accel of frame RT_SB_GPS_Mcycle_Lean, 9187362 (0x8c3022). This accuracy value applies to both GPS-derived lateral acceleration and motorcycle lean angle, since both are derived from the rate of change of GPS heading." UBYTE CONV_crt_PT_8c3022_Accuracy_GPS_Lateral_Accel 1.0 100.0 0 255 ECU_ADDRESS 0x0000 /end MEASUREMENT
/begin COMPU_METHOD CONV_crt_PT_8c3022_Accuracy_GPS_Lateral_Accel "Linear scaling, used for variable crt_PT_8c3022_Accuracy_GPS_Lateral_Accel, signal Accuracy_GPS_Lateral_Accel" RAT_FUNC "%4" "" COEFFS 0 1 0 0 0 1 /end COMPU_METHOD
/* Measurement point for signal GPS_Lateral_Accel of frame RT_SB_GPS_Mcycle_Lean, 9187362 (0x8c3022) */
/begin MEASUREMENT crt_PT_8c3022_GPS_Lateral_Accel "signal GPS_Lateral_Accel of frame RT_SB_GPS_Mcycle_Lean, 9187362 (0x8c3022). GPS-derived lateral acceleration.  This is derived by differentiating GPS heading - it is much more noisy than lateral accel from the accelerometers, but useful for m/cycle applications." SWORD CONV_crt_PT_8c3022_GPS_Lateral_Accel 0.001 100.0 -65.0 65.0 ECU_ADDRESS 0x0000 /end MEASUREMENT
/begin COMPU_METHOD CONV_crt_PT_8c3022_GPS_Lateral_Accel "Linear scaling, used for variable crt_PT_8c3022_GPS_Lateral_Accel, signal GPS_Lateral_Accel" RAT_FUNC "%6" "g" COEFFS 0 1 -0.0 0 0 0.001 /end COMPU_METHOD
/* Measurement point for signal GPS_Mcycle_Lean_Angle of frame RT_SB_GPS_Mcycle_Lean, 9187362 (0x8c3022) */
/begin MEASUREMENT crt_PT_8c3022_GPS_Mcycle_Lean_Angle "signal GPS_Mcycle_Lean_Angle of frame RT_SB_GPS_Mcycle_Lean, 9187362 (0x8c3022). Motorcycle lean angle, derived from rate of change of heading from GPS.  This is the lean angle of the centre of mass of the combined bike + rider." SWORD CONV_crt_PT_8c3022_GPS_Mcycle_Lean_Angle 0.01 100.0 -90.0 90.0 ECU_ADDRESS 0x0000 /end MEASUREMENT
/begin COMPU_METHOD CONV_crt_PT_8c3022_GPS_Mcycle_Lean_Angle "Linear scaling, used for variable crt_PT_8c3022_GPS_Mcycle_Lean_Angle, signal GPS_Mcycle_Lean_Angle" RAT_FUNC "%6" "degrees" COEFFS 0 1 -0.0 0 0 0.01 /end COMPU_METHOD
/* Measurement point for signal GPS_Status of frame RT_SB_GPS_Status, 9175074 (0x8c0022) */
/begin MEASUREMENT crt_PT_8c0022_GPS_Status "signal GPS_Status of frame RT_SB_GPS_Status, 9175074 (0x8c0022)" UBYTE CONV_crt_PT_8c0022_GPS_Status 1.0 100.0 0 255 ECU_ADDRESS 0x0000 /end MEASUREMENT
/begin COMPU_METHOD CONV_crt_PT_8c0022_GPS_Status "Linear scaling, used for variable crt_PT_8c0022_GPS_Status, signal GPS_Status" RAT_FUNC "%4" "" COEFFS 0 1 0 0 0 1 /end COMPU_METHOD
/* Measurement point for signal Firmware_Version_Major of frame RT_SB_GPS_Status, 9175074 (0x8c0022) */
/begin MEASUREMENT crt_PT_8c0022_Firmware_Version_Major "signal Firmware_Version_Major of frame RT_SB_GPS_Status, 9175074 (0x8c0022)" UBYTE CONV_crt_PT_8c0022_Firmware_Version_Major 1.0 100.0 0 255 ECU_ADDRESS 0x0000 /end MEASUREMENT
/begin COMPU_METHOD CONV_crt_PT_8c0022_Firmware_Version_Major "Linear scaling, used for variable crt_PT_8c0022_Firmware_Version_Major, signal Firmware_Version_Major" RAT_FUNC "%4" "" COEFFS 0 1 0 0 0 1 /end COMPU_METHOD
/* Measurement point for signal Firmware_Version_Intermediate of frame RT_SB_GPS_Status, 9175074 (0x8c0022) */
/begin MEASUREMENT crt_PT_8c0022_Firmware_Version_Intermediate "signal Firmware_Version_Intermediate of frame RT_SB_GPS_Status, 9175074 (0x8c0022)" UBYTE CONV_crt_PT_8c0022_Firmware_Version_Intermediate 1.0 100.0 0 255 ECU_ADDRESS 0x0000 /end MEASUREMENT
/begin COMPU_METHOD CONV_crt_PT_8c0022_Firmware_Version_Intermediate "Linear scaling, used for variable crt_PT_8c0022_Firmware_Version_Intermediate, signal Firmware_Version_Intermediate" RAT_FUNC "%4" "" COEFFS 0 1 0 0 0 1 /end COMPU_METHOD
/* Measurement point for signal Firmware_Version_Minor of frame RT_SB_GPS_Status, 9175074 (0x8c0022) */
/begin MEASUREMENT crt_PT_8c0022_Firmware_Version_Minor "signal Firmware_Version_Minor of frame RT_SB_GPS_Status, 9175074 (0x8c0022)" UBYTE CONV_crt_PT_8c0022_Firmware_Version_Minor 1.0 100.0 0 255 ECU_ADDRESS 0x0000 /end MEASUREMENT
/begin COMPU_METHOD CONV_crt_PT_8c0022_Firmware_Version_Minor "Linear scaling, used for variable crt_PT_8c0022_Firmware_Version_Minor, signal Firmware_Version_Minor" RAT_FUNC "%4" "" COEFFS 0 1 0 0 0 1 /end COMPU_METHOD
/* Measurement point for signal GPS_nSv of frame RT_SB_GPS_Status, 9175074 (0x8c0022) */
/begin MEASUREMENT crt_PT_8c0022_GPS_nSv "signal GPS_nSv of frame RT_SB_GPS_Status, 9175074 (0x8c0022). Number of satellites used in GPS solution" UBYTE CONV_crt_PT_8c0022_GPS_nSv 1.0 100.0 0 16 ECU_ADDRESS 0x0000 /end MEASUREMENT
/begin COMPU_METHOD CONV_crt_PT_8c0022_GPS_nSv "Linear scaling, used for variable crt_PT_8c0022_GPS_nSv, signal GPS_nSv" RAT_FUNC "%4" "" COEFFS 0 1 0 0 0 1 /end COMPU_METHOD
/* Measurement point for signal GPS_nSv_2 of frame RT_SB_GPS_Status, 9175074 (0x8c0022) */
/begin MEASUREMENT crt_PT_8c0022_GPS_nSv_2 "signal GPS_nSv_2 of frame RT_SB_GPS_Status, 9175074 (0x8c0022). Number of satellites used in GPS solution by module 2 on RTK units..." UBYTE CONV_crt_PT_8c0022_GPS_nSv_2 1.0 100.0 0 16 ECU_ADDRESS 0x0000 /end MEASUREMENT
/begin COMPU_METHOD CONV_crt_PT_8c0022_GPS_nSv_2 "Linear scaling, used for variable crt_PT_8c0022_GPS_nSv_2, signal GPS_nSv_2" RAT_FUNC "%4" "" COEFFS 0 1 0 0 0 1 /end COMPU_METHOD
/* Measurement point for signal GPS_nSv_RTK of frame RT_SB_GPS_Status, 9175074 (0x8c0022) */
/begin MEASUREMENT crt_PT_8c0022_GPS_nSv_RTK "signal GPS_nSv_RTK of frame RT_SB_GPS_Status, 9175074 (0x8c0022). Number of common satellites available to RTK solution" UBYTE CONV_crt_PT_8c0022_GPS_nSv_RTK 1.0 100.0 0 16 ECU_ADDRESS 0x0000 /end MEASUREMENT
/begin COMPU_METHOD CONV_crt_PT_8c0022_GPS_nSv_RTK "Linear scaling, used for variable crt_PT_8c0022_GPS_nSv_RTK, signal GPS_nSv_RTK" RAT_FUNC "%4" "" COEFFS 0 1 0 0 0 1 /end COMPU_METHOD
/* Measurement point for signal RTK_Status of frame RT_SB_GPS_Status, 9175074 (0x8c0022) */
/begin MEASUREMENT crt_PT_8c0022_RTK_Status "signal RTK_Status of frame RT_SB_GPS_Status, 9175074 (0x8c0022)" UBYTE CONV_crt_PT_8c0022_RTK_Status 1.0 100.0 0 255 ECU_ADDRESS 0x0000 /end MEASUREMENT
/begin COMPU_METHOD CONV_crt_PT_8c0022_RTK_Status "Linear scaling, used for variable crt_PT_8c0022_RTK_Status, signal RTK_Status" RAT_FUNC "%4" "" COEFFS 0 1 0 0 0 1 /end COMPU_METHOD
/* Measurement point for signal GPS_Pos_ECEF_Y of frame RT_SB_GPS_Pos_ECEF_2, 9176354 (0x8c0522) */
/begin MEASUREMENT crt_PT_8c0522_GPS_Pos_ECEF_Y "signal GPS_Pos_ECEF_Y of frame RT_SB_GPS_Pos_ECEF_2, 9176354 (0x8c0522). ECEF Y position.  The ECEF Y axis originates from the Earth centre, and the positive Y axis intersects the Earth surface at zero degrees latittude and 90 degrees longitude." SLONG CONV_crt_PT_8c0522_GPS_Pos_ECEF_Y 0.01 100.0 -1.0E7 1.0E7 ECU_ADDRESS 0x0000 /end MEASUREMENT
/begin COMPU_METHOD CONV_crt_PT_8c0522_GPS_Pos_ECEF_Y "Linear scaling, used for variable crt_PT_8c0522_GPS_Pos_ECEF_Y, signal GPS_Pos_ECEF_Y" RAT_FUNC "%12" "m" COEFFS 0 1 -0.0 0 0 0.01 /end COMPU_METHOD
/* Measurement point for signal GPS_Pos_ECEF_Z of frame RT_SB_GPS_Pos_ECEF_2, 9176354 (0x8c0522) */
/begin MEASUREMENT crt_PT_8c0522_GPS_Pos_ECEF_Z "signal GPS_Pos_ECEF_Z of frame RT_SB_GPS_Pos_ECEF_2, 9176354 (0x8c0522). ECEF Z position.  The ECEF Z axis originates from the Earth centre, and the positive Z axis intersects the Earth surface at the North Pole." SLONG CONV_crt_PT_8c0522_GPS_Pos_ECEF_Z 0.01 100.0 -1.0E7 1.0E7 ECU_ADDRESS 0x0000 /end MEASUREMENT
/begin COMPU_METHOD CONV_crt_PT_8c0522_GPS_Pos_ECEF_Z "Linear scaling, used for variable crt_PT_8c0522_GPS_Pos_ECEF_Z, signal GPS_Pos_ECEF_Z" RAT_FUNC "%12" "m" COEFFS 0 1 -0.0 0 0 0.01 /end COMPU_METHOD
/* Measurement point for signal Validity_GPS_Pos_ECEF_X of frame RT_SB_GPS_Pos_ECEF_1, 9176098 (0x8c0422) */
/begin MEASUREMENT crt_PT_8c0422_Validity_GPS_Pos_ECEF_X "signal Validity_GPS_Pos_ECEF_X of frame RT_SB_GPS_Pos_ECEF_1, 9176098 (0x8c0422). Valid when bit is set, invalid when bit is clear." UBYTE CONV_crt_PT_8c0422_Validity_GPS_Pos_ECEF_X 1.0 100.0 0 1 ECU_ADDRESS 0x0000 /end MEASUREMENT
/begin COMPU_METHOD CONV_crt_PT_8c0422_Validity_GPS_Pos_ECEF_X "Linear scaling, used for variable crt_PT_8c0422_Validity_GPS_Pos_ECEF_X, signal Validity_GPS_Pos_ECEF_X" RAT_FUNC "%1" "" COEFFS 0 1 0 0 0 1 /end COMPU_METHOD
/* Measurement point for signal Validity_GPS_Pos_ECEF_Y of frame RT_SB_GPS_Pos_ECEF_1, 9176098 (0x8c0422) */
/begin MEASUREMENT crt_PT_8c0422_Validity_GPS_Pos_ECEF_Y "signal Validity_GPS_Pos_ECEF_Y of frame RT_SB_GPS_Pos_ECEF_1, 9176098 (0x8c0422). Valid when bit is set, invalid when bit is clear." UBYTE CONV_crt_PT_8c0422_Validity_GPS_Pos_ECEF_Y 1.0 100.0 0 1 ECU_ADDRESS 0x0000 /end MEASUREMENT
/begin COMPU_METHOD CONV_crt_PT_8c0422_Validity_GPS_Pos_ECEF_Y "Linear scaling, used for variable crt_PT_8c0422_Validity_GPS_Pos_ECEF_Y, signal Validity_GPS_Pos_ECEF_Y" RAT_FUNC "%1" "" COEFFS 0 1 0 0 0 1 /end COMPU_METHOD
/* Measurement point for signal Validity_GPS_Pos_ECEF_Z of frame RT_SB_GPS_Pos_ECEF_1, 9176098 (0x8c0422) */
/begin MEASUREMENT crt_PT_8c0422_Validity_GPS_Pos_ECEF_Z "signal Validity_GPS_Pos_ECEF_Z of frame RT_SB_GPS_Pos_ECEF_1, 9176098 (0x8c0422). Valid when bit is set, invalid when bit is clear." UBYTE CONV_crt_PT_8c0422_Validity_GPS_Pos_ECEF_Z 1.0 100.0 0 1 ECU_ADDRESS 0x0000 /end MEASUREMENT
/begin COMPU_METHOD CONV_crt_PT_8c0422_Validity_GPS_Pos_ECEF_Z "Linear scaling, used for variable crt_PT_8c0422_Validity_GPS_Pos_ECEF_Z, signal Validity_GPS_Pos_ECEF_Z" RAT_FUNC "%1" "" COEFFS 0 1 0 0 0 1 /end COMPU_METHOD
/* Measurement point for signal Accuracy_GPS_Pos_ECEF_X of frame RT_SB_GPS_Pos_ECEF_1, 9176098 (0x8c0422) */
/begin MEASUREMENT crt_PT_8c0422_Accuracy_GPS_Pos_ECEF_X "signal Accuracy_GPS_Pos_ECEF_X of frame RT_SB_GPS_Pos_ECEF_1, 9176098 (0x8c0422). Dimensionless.  Lower values imply but do not guarantee better accuracy than higher values." UBYTE CONV_crt_PT_8c0422_Accuracy_GPS_Pos_ECEF_X 1.0 100.0 0 255 ECU_ADDRESS 0x0000 /end MEASUREMENT
/begin COMPU_METHOD CONV_crt_PT_8c0422_Accuracy_GPS_Pos_ECEF_X "Linear scaling, used for variable crt_PT_8c0422_Accuracy_GPS_Pos_ECEF_X, signal Accuracy_GPS_Pos_ECEF_X" RAT_FUNC "%4" "" COEFFS 0 1 0 0 0 1 /end COMPU_METHOD
/* Measurement point for signal Accuracy_GPS_Pos_ECEF_Y of frame RT_SB_GPS_Pos_ECEF_1, 9176098 (0x8c0422) */
/begin MEASUREMENT crt_PT_8c0422_Accuracy_GPS_Pos_ECEF_Y "signal Accuracy_GPS_Pos_ECEF_Y of frame RT_SB_GPS_Pos_ECEF_1, 9176098 (0x8c0422). Dimensionless.  Lower values imply but do not guarantee better accuracy than higher values." UBYTE CONV_crt_PT_8c0422_Accuracy_GPS_Pos_ECEF_Y 1.0 100.0 0 255 ECU_ADDRESS 0x0000 /end MEASUREMENT
/begin COMPU_METHOD CONV_crt_PT_8c0422_Accuracy_GPS_Pos_ECEF_Y "Linear scaling, used for variable crt_PT_8c0422_Accuracy_GPS_Pos_ECEF_Y, signal Accuracy_GPS_Pos_ECEF_Y" RAT_FUNC "%4" "" COEFFS 0 1 0 0 0 1 /end COMPU_METHOD
/* Measurement point for signal Accuracy_GPS_Pos_ECEF_Z of frame RT_SB_GPS_Pos_ECEF_1, 9176098 (0x8c0422) */
/begin MEASUREMENT crt_PT_8c0422_Accuracy_GPS_Pos_ECEF_Z "signal Accuracy_GPS_Pos_ECEF_Z of frame RT_SB_GPS_Pos_ECEF_1, 9176098 (0x8c0422). Dimensionless.  Lower values imply but do not guarantee better accuracy than higher values." UBYTE CONV_crt_PT_8c0422_Accuracy_GPS_Pos_ECEF_Z 1.0 100.0 0 255 ECU_ADDRESS 0x0000 /end MEASUREMENT
/begin COMPU_METHOD CONV_crt_PT_8c0422_Accuracy_GPS_Pos_ECEF_Z "Linear scaling, used for variable crt_PT_8c0422_Accuracy_GPS_Pos_ECEF_Z, signal Accuracy_GPS_Pos_ECEF_Z" RAT_FUNC "%4" "" COEFFS 0 1 0 0 0 1 /end COMPU_METHOD
/* Measurement point for signal GPS_Pos_ECEF_X of frame RT_SB_GPS_Pos_ECEF_1, 9176098 (0x8c0422) */
/begin MEASUREMENT crt_PT_8c0422_GPS_Pos_ECEF_X "signal GPS_Pos_ECEF_X of frame RT_SB_GPS_Pos_ECEF_1, 9176098 (0x8c0422). ECEF X position.  The ECEF X axis originates from the Earth centre, and the positive X axis intersects the Earth surface at zero degrees latittude and zero degrees longitude (the intersection of the equator and the prime meridian)." SLONG CONV_crt_PT_8c0422_GPS_Pos_ECEF_X 0.01 100.0 -1.0E7 1.0E7 ECU_ADDRESS 0x0000 /end MEASUREMENT
/begin COMPU_METHOD CONV_crt_PT_8c0422_GPS_Pos_ECEF_X "Linear scaling, used for variable crt_PT_8c0422_GPS_Pos_ECEF_X, signal GPS_Pos_ECEF_X" RAT_FUNC "%12" "m" COEFFS 0 1 -0.0 0 0 0.01 /end COMPU_METHOD
/* Measurement point for signal GPS_Pos_LLH_Longitude of frame RT_SB_GPS_Pos_LLH_2, 9175842 (0x8c0322) */
/begin MEASUREMENT crt_PT_8c0322_GPS_Pos_LLH_Longitude "signal GPS_Pos_LLH_Longitude of frame RT_SB_GPS_Pos_LLH_2, 9175842 (0x8c0322)" SLONG CONV_crt_PT_8c0322_GPS_Pos_LLH_Longitude 1.0E-7 100.0 -180.0 180.0 ECU_ADDRESS 0x0000 /end MEASUREMENT
/begin COMPU_METHOD CONV_crt_PT_8c0322_GPS_Pos_LLH_Longitude "Linear scaling, used for variable crt_PT_8c0322_GPS_Pos_LLH_Longitude, signal GPS_Pos_LLH_Longitude" RAT_FUNC "%12" "degrees" COEFFS 0 1 -0.0 0 0 1.0E-7 /end COMPU_METHOD
/* Measurement point for signal GPS_Pos_LLH_Altitude of frame RT_SB_GPS_Pos_LLH_2, 9175842 (0x8c0322) */
/begin MEASUREMENT crt_PT_8c0322_GPS_Pos_LLH_Altitude "signal GPS_Pos_LLH_Altitude of frame RT_SB_GPS_Pos_LLH_2, 9175842 (0x8c0322)" SLONG CONV_crt_PT_8c0322_GPS_Pos_LLH_Altitude 0.001 100.0 -1000.0 100000.0 ECU_ADDRESS 0x0000 /end MEASUREMENT
/begin COMPU_METHOD CONV_crt_PT_8c0322_GPS_Pos_LLH_Altitude "Linear scaling, used for variable crt_PT_8c0322_GPS_Pos_LLH_Altitude, signal GPS_Pos_LLH_Altitude" RAT_FUNC "%12" "m" COEFFS 0 1 -0.0 0 0 0.001 /end COMPU_METHOD
/* Measurement point for signal Validity_GPS_Pos_LLH_Latitude of frame RT_SB_GPS_Pos_LLH_1, 9175586 (0x8c0222) */
/begin MEASUREMENT crt_PT_8c0222_Validity_GPS_Pos_LLH_Latitude "signal Validity_GPS_Pos_LLH_Latitude of frame RT_SB_GPS_Pos_LLH_1, 9175586 (0x8c0222). Valid when bit is set, invalid when bit is clear." UBYTE CONV_crt_PT_8c0222_Validity_GPS_Pos_LLH_Latitude 1.0 100.0 0 1 ECU_ADDRESS 0x0000 /end MEASUREMENT
/begin COMPU_METHOD CONV_crt_PT_8c0222_Validity_GPS_Pos_LLH_Latitude "Linear scaling, used for variable crt_PT_8c0222_Validity_GPS_Pos_LLH_Latitude, signal Validity_GPS_Pos_LLH_Latitude" RAT_FUNC "%1" "" COEFFS 0 1 0 0 0 1 /end COMPU_METHOD
/* Measurement point for signal Validity_GPS_Pos_LLH_Longitude of frame RT_SB_GPS_Pos_LLH_1, 9175586 (0x8c0222) */
/begin MEASUREMENT crt_PT_8c0222_Validity_GPS_Pos_LLH_Longitude "signal Validity_GPS_Pos_LLH_Longitude of frame RT_SB_GPS_Pos_LLH_1, 9175586 (0x8c0222). Valid when bit is set, invalid when bit is clear." UBYTE CONV_crt_PT_8c0222_Validity_GPS_Pos_LLH_Longitude 1.0 100.0 0 1 ECU_ADDRESS 0x0000 /end MEASUREMENT
/begin COMPU_METHOD CONV_crt_PT_8c0222_Validity_GPS_Pos_LLH_Longitude "Linear scaling, used for variable crt_PT_8c0222_Validity_GPS_Pos_LLH_Longitude, signal Validity_GPS_Pos_LLH_Longitude" RAT_FUNC "%1" "" COEFFS 0 1 0 0 0 1 /end COMPU_METHOD
/* Measurement point for signal Validity_GPS_Pos_LLH_Altitude of frame RT_SB_GPS_Pos_LLH_1, 9175586 (0x8c0222) */
/begin MEASUREMENT crt_PT_8c0222_Validity_GPS_Pos_LLH_Altitude "signal Validity_GPS_Pos_LLH_Altitude of frame RT_SB_GPS_Pos_LLH_1, 9175586 (0x8c0222). Valid when bit is set, invalid when bit is clear." UBYTE CONV_crt_PT_8c0222_Validity_GPS_Pos_LLH_Altitude 1.0 100.0 0 1 ECU_ADDRESS 0x0000 /end MEASUREMENT
/begin COMPU_METHOD CONV_crt_PT_8c0222_Validity_GPS_Pos_LLH_Altitude "Linear scaling, used for variable crt_PT_8c0222_Validity_GPS_Pos_LLH_Altitude, signal Validity_GPS_Pos_LLH_Altitude" RAT_FUNC "%1" "" COEFFS 0 1 0 0 0 1 /end COMPU_METHOD
/* Measurement point for signal Accuracy_GPS_Pos_LLH_Latitude of frame RT_SB_GPS_Pos_LLH_1, 9175586 (0x8c0222) */
/begin MEASUREMENT crt_PT_8c0222_Accuracy_GPS_Pos_LLH_Latitude "signal Accuracy_GPS_Pos_LLH_Latitude of frame RT_SB_GPS_Pos_LLH_1, 9175586 (0x8c0222). This accuracy value applies to both 2D and 3D GPS speed." UBYTE CONV_crt_PT_8c0222_Accuracy_GPS_Pos_LLH_Latitude 1.0 100.0 0 255 ECU_ADDRESS 0x0000 /end MEASUREMENT
/begin COMPU_METHOD CONV_crt_PT_8c0222_Accuracy_GPS_Pos_LLH_Latitude "Linear scaling, used for variable crt_PT_8c0222_Accuracy_GPS_Pos_LLH_Latitude, signal Accuracy_GPS_Pos_LLH_Latitude" RAT_FUNC "%4" "" COEFFS 0 1 0 0 0 1 /end COMPU_METHOD
/* Measurement point for signal Accuracy_GPS_Pos_LLH_Longitude of frame RT_SB_GPS_Pos_LLH_1, 9175586 (0x8c0222) */
/begin MEASUREMENT crt_PT_8c0222_Accuracy_GPS_Pos_LLH_Longitude "signal Accuracy_GPS_Pos_LLH_Longitude of frame RT_SB_GPS_Pos_LLH_1, 9175586 (0x8c0222). This accuracy value applies to both 2D and 3D GPS speed." UBYTE CONV_crt_PT_8c0222_Accuracy_GPS_Pos_LLH_Longitude 1.0 100.0 0 255 ECU_ADDRESS 0x0000 /end MEASUREMENT
/begin COMPU_METHOD CONV_crt_PT_8c0222_Accuracy_GPS_Pos_LLH_Longitude "Linear scaling, used for variable crt_PT_8c0222_Accuracy_GPS_Pos_LLH_Longitude, signal Accuracy_GPS_Pos_LLH_Longitude" RAT_FUNC "%4" "" COEFFS 0 1 0 0 0 1 /end COMPU_METHOD
/* Measurement point for signal Accuracy_GPS_Pos_LLH_Altitude of frame RT_SB_GPS_Pos_LLH_1, 9175586 (0x8c0222) */
/begin MEASUREMENT crt_PT_8c0222_Accuracy_GPS_Pos_LLH_Altitude "signal Accuracy_GPS_Pos_LLH_Altitude of frame RT_SB_GPS_Pos_LLH_1, 9175586 (0x8c0222). This accuracy value applies to both 2D and 3D GPS speed." UBYTE CONV_crt_PT_8c0222_Accuracy_GPS_Pos_LLH_Altitude 1.0 100.0 0 255 ECU_ADDRESS 0x0000 /end MEASUREMENT
/begin COMPU_METHOD CONV_crt_PT_8c0222_Accuracy_GPS_Pos_LLH_Altitude "Linear scaling, used for variable crt_PT_8c0222_Accuracy_GPS_Pos_LLH_Altitude, signal Accuracy_GPS_Pos_LLH_Altitude" RAT_FUNC "%4" "" COEFFS 0 1 0 0 0 1 /end COMPU_METHOD
/* Measurement point for signal GPS_Pos_LLH_Latitude of frame RT_SB_GPS_Pos_LLH_1, 9175586 (0x8c0222) */
/begin MEASUREMENT crt_PT_8c0222_GPS_Pos_LLH_Latitude "signal GPS_Pos_LLH_Latitude of frame RT_SB_GPS_Pos_LLH_1, 9175586 (0x8c0222)" SLONG CONV_crt_PT_8c0222_GPS_Pos_LLH_Latitude 1.0E-7 100.0 -90.0 90.0 ECU_ADDRESS 0x0000 /end MEASUREMENT
/begin COMPU_METHOD CONV_crt_PT_8c0222_GPS_Pos_LLH_Latitude "Linear scaling, used for variable crt_PT_8c0222_GPS_Pos_LLH_Latitude, signal GPS_Pos_LLH_Latitude" RAT_FUNC "%12" "degrees" COEFFS 0 1 -0.0 0 0 1.0E-7 /end COMPU_METHOD
/* Measurement point for signal Validity_GPS_Heading of frame RT_SB_GPS_Heading_Gradient, 9180450 (0x8c1522) */
/begin MEASUREMENT crt_PT_8c1522_Validity_GPS_Heading "signal Validity_GPS_Heading of frame RT_SB_GPS_Heading_Gradient, 9180450 (0x8c1522). Valid when bit is set, invalid when bit is clear." UBYTE CONV_crt_PT_8c1522_Validity_GPS_Heading 1.0 100.0 0 1 ECU_ADDRESS 0x0000 /end MEASUREMENT
/begin COMPU_METHOD CONV_crt_PT_8c1522_Validity_GPS_Heading "Linear scaling, used for variable crt_PT_8c1522_Validity_GPS_Heading, signal Validity_GPS_Heading" RAT_FUNC "%1" "" COEFFS 0 1 0 0 0 1 /end COMPU_METHOD
/* Measurement point for signal Validity_GPS_Gradient of frame RT_SB_GPS_Heading_Gradient, 9180450 (0x8c1522) */
/begin MEASUREMENT crt_PT_8c1522_Validity_GPS_Gradient "signal Validity_GPS_Gradient of frame RT_SB_GPS_Heading_Gradient, 9180450 (0x8c1522). Valid when bit is set, invalid when bit is clear." UBYTE CONV_crt_PT_8c1522_Validity_GPS_Gradient 1.0 100.0 0 1 ECU_ADDRESS 0x0000 /end MEASUREMENT
/begin COMPU_METHOD CONV_crt_PT_8c1522_Validity_GPS_Gradient "Linear scaling, used for variable crt_PT_8c1522_Validity_GPS_Gradient, signal Validity_GPS_Gradient" RAT_FUNC "%1" "" COEFFS 0 1 0 0 0 1 /end COMPU_METHOD
/* Measurement point for signal Accuracy_GPS_Heading of frame RT_SB_GPS_Heading_Gradient, 9180450 (0x8c1522) */
/begin MEASUREMENT crt_PT_8c1522_Accuracy_GPS_Heading "signal Accuracy_GPS_Heading of frame RT_SB_GPS_Heading_Gradient, 9180450 (0x8c1522). Dimensionless.  Lower values imply but do not guarantee better accuracy than higher values." UBYTE CONV_crt_PT_8c1522_Accuracy_GPS_Heading 1.0 100.0 0 255 ECU_ADDRESS 0x0000 /end MEASUREMENT
/begin COMPU_METHOD CONV_crt_PT_8c1522_Accuracy_GPS_Heading "Linear scaling, used for variable crt_PT_8c1522_Accuracy_GPS_Heading, signal Accuracy_GPS_Heading" RAT_FUNC "%4" "" COEFFS 0 1 0 0 0 1 /end COMPU_METHOD
/* Measurement point for signal GPS_Heading of frame RT_SB_GPS_Heading_Gradient, 9180450 (0x8c1522) */
/begin MEASUREMENT crt_PT_8c1522_GPS_Heading "signal GPS_Heading of frame RT_SB_GPS_Heading_Gradient, 9180450 (0x8c1522). This is GPS heading, the direction that the vehicle is travelling in the local horizontal plane." SWORD CONV_crt_PT_8c1522_GPS_Heading 0.01 100.0 -180.0 180.0 ECU_ADDRESS 0x0000 /end MEASUREMENT
/begin COMPU_METHOD CONV_crt_PT_8c1522_GPS_Heading "Linear scaling, used for variable crt_PT_8c1522_GPS_Heading, signal GPS_Heading" RAT_FUNC "%6" "degrees" COEFFS 0 1 -0.0 0 0 0.01 /end COMPU_METHOD
/* Measurement point for signal Accuracy_GPS_Gradient of frame RT_SB_GPS_Heading_Gradient, 9180450 (0x8c1522) */
/begin MEASUREMENT crt_PT_8c1522_Accuracy_GPS_Gradient "signal Accuracy_GPS_Gradient of frame RT_SB_GPS_Heading_Gradient, 9180450 (0x8c1522). Dimensionless.  Lower values imply but do not guarantee better accuracy than higher values." UBYTE CONV_crt_PT_8c1522_Accuracy_GPS_Gradient 1.0 100.0 0 255 ECU_ADDRESS 0x0000 /end MEASUREMENT
/begin COMPU_METHOD CONV_crt_PT_8c1522_Accuracy_GPS_Gradient "Linear scaling, used for variable crt_PT_8c1522_Accuracy_GPS_Gradient, signal Accuracy_GPS_Gradient" RAT_FUNC "%4" "" COEFFS 0 1 0 0 0 1 /end COMPU_METHOD
/* Measurement point for signal GPS_Gradient of frame RT_SB_GPS_Heading_Gradient, 9180450 (0x8c1522) */
/begin MEASUREMENT crt_PT_8c1522_GPS_Gradient "signal GPS_Gradient of frame RT_SB_GPS_Heading_Gradient, 9180450 (0x8c1522). This is GPS gradient, i.e. the vertical direction that the vehicle is travelling, NOT pointing (pitch)." SWORD CONV_crt_PT_8c1522_GPS_Gradient 0.01 100.0 -90.0 90.0 ECU_ADDRESS 0x0000 /end MEASUREMENT
/begin COMPU_METHOD CONV_crt_PT_8c1522_GPS_Gradient "Linear scaling, used for variable crt_PT_8c1522_GPS_Gradient, signal GPS_Gradient" RAT_FUNC "%6" "degrees" COEFFS 0 1 -0.0 0 0 0.01 /end COMPU_METHOD
/* Measurement point for signal Validity_GPS_Vel_ECEF_Y of frame RT_SB_GPS_Vel_ECEF_2, 9180194 (0x8c1422) */
/begin MEASUREMENT crt_PT_8c1422_Validity_GPS_Vel_ECEF_Y "signal Validity_GPS_Vel_ECEF_Y of frame RT_SB_GPS_Vel_ECEF_2, 9180194 (0x8c1422). Valid when bit is set, invalid when bit is clear." UBYTE CONV_crt_PT_8c1422_Validity_GPS_Vel_ECEF_Y 1.0 100.0 0 1 ECU_ADDRESS 0x0000 /end MEASUREMENT
/begin COMPU_METHOD CONV_crt_PT_8c1422_Validity_GPS_Vel_ECEF_Y "Linear scaling, used for variable crt_PT_8c1422_Validity_GPS_Vel_ECEF_Y, signal Validity_GPS_Vel_ECEF_Y" RAT_FUNC "%1" "" COEFFS 0 1 0 0 0 1 /end COMPU_METHOD
/* Measurement point for signal Validity_GPS_Vel_ECEF_Z of frame RT_SB_GPS_Vel_ECEF_2, 9180194 (0x8c1422) */
/begin MEASUREMENT crt_PT_8c1422_Validity_GPS_Vel_ECEF_Z "signal Validity_GPS_Vel_ECEF_Z of frame RT_SB_GPS_Vel_ECEF_2, 9180194 (0x8c1422). Valid when bit is set, invalid when bit is clear." UBYTE CONV_crt_PT_8c1422_Validity_GPS_Vel_ECEF_Z 1.0 100.0 0 1 ECU_ADDRESS 0x0000 /end MEASUREMENT
/begin COMPU_METHOD CONV_crt_PT_8c1422_Validity_GPS_Vel_ECEF_Z "Linear scaling, used for variable crt_PT_8c1422_Validity_GPS_Vel_ECEF_Z, signal Validity_GPS_Vel_ECEF_Z" RAT_FUNC "%1" "" COEFFS 0 1 0 0 0 1 /end COMPU_METHOD
/* Measurement point for signal GPS_Vel_ECEF_Y of frame RT_SB_GPS_Vel_ECEF_2, 9180194 (0x8c1422) */
/begin MEASUREMENT crt_PT_8c1422_GPS_Vel_ECEF_Y "signal GPS_Vel_ECEF_Y of frame RT_SB_GPS_Vel_ECEF_2, 9180194 (0x8c1422). ECEF Y velocity.  The ECEF Y axis originates from the Earth centre, and the positive Y axis intersects the Earth surface at zero degrees latittude and 90 degrees longitude." SLONG CONV_crt_PT_8c1422_GPS_Vel_ECEF_Y 1.0E-4 100.0 -838.0 838.0 ECU_ADDRESS 0x0000 /end MEASUREMENT
/begin COMPU_METHOD CONV_crt_PT_8c1422_GPS_Vel_ECEF_Y "Linear scaling, used for variable crt_PT_8c1422_GPS_Vel_ECEF_Y, signal GPS_Vel_ECEF_Y" RAT_FUNC "%12" "m/s" COEFFS 0 1 -0.0 0 0 1.0E-4 /end COMPU_METHOD
/* Measurement point for signal GPS_Vel_ECEF_Z of frame RT_SB_GPS_Vel_ECEF_2, 9180194 (0x8c1422) */
/begin MEASUREMENT crt_PT_8c1422_GPS_Vel_ECEF_Z "signal GPS_Vel_ECEF_Z of frame RT_SB_GPS_Vel_ECEF_2, 9180194 (0x8c1422). ECEF Z velocity.  The ECEF Z axis originates from the Earth centre, and the positive Z axis intersects the Earth surface at the North Pole." SLONG CONV_crt_PT_8c1422_GPS_Vel_ECEF_Z 1.0E-4 100.0 -838.0 838.0 ECU_ADDRESS 0x0000 /end MEASUREMENT
/begin COMPU_METHOD CONV_crt_PT_8c1422_GPS_Vel_ECEF_Z "Linear scaling, used for variable crt_PT_8c1422_GPS_Vel_ECEF_Z, signal GPS_Vel_ECEF_Z" RAT_FUNC "%12" "m/s" COEFFS 0 1 -0.0 0 0 1.0E-4 /end COMPU_METHOD
/* Measurement point for signal Validity_GPS_Vel_ECEF_X of frame RT_SB_GPS_Vel_ECEF_1, 9179938 (0x8c1322) */
/begin MEASUREMENT crt_PT_8c1322_Validity_GPS_Vel_ECEF_X "signal Validity_GPS_Vel_ECEF_X of frame RT_SB_GPS_Vel_ECEF_1, 9179938 (0x8c1322). Valid when bit is set, invalid when bit is clear." UBYTE CONV_crt_PT_8c1322_Validity_GPS_Vel_ECEF_X 1.0 100.0 0 1 ECU_ADDRESS 0x0000 /end MEASUREMENT
/begin COMPU_METHOD CONV_crt_PT_8c1322_Validity_GPS_Vel_ECEF_X "Linear scaling, used for variable crt_PT_8c1322_Validity_GPS_Vel_ECEF_X, signal Validity_GPS_Vel_ECEF_X" RAT_FUNC "%1" "" COEFFS 0 1 0 0 0 1 /end COMPU_METHOD
/* Measurement point for signal Accuracy_GPS_Vel_ECEF_X of frame RT_SB_GPS_Vel_ECEF_1, 9179938 (0x8c1322) */
/begin MEASUREMENT crt_PT_8c1322_Accuracy_GPS_Vel_ECEF_X "signal Accuracy_GPS_Vel_ECEF_X of frame RT_SB_GPS_Vel_ECEF_1, 9179938 (0x8c1322)" UBYTE CONV_crt_PT_8c1322_Accuracy_GPS_Vel_ECEF_X 1.0 100.0 0 255 ECU_ADDRESS 0x0000 /end MEASUREMENT
/begin COMPU_METHOD CONV_crt_PT_8c1322_Accuracy_GPS_Vel_ECEF_X "Linear scaling, used for variable crt_PT_8c1322_Accuracy_GPS_Vel_ECEF_X, signal Accuracy_GPS_Vel_ECEF_X" RAT_FUNC "%4" "" COEFFS 0 1 0 0 0 1 /end COMPU_METHOD
/* Measurement point for signal Accuracy_GPS_Vel_ECEF_Y of frame RT_SB_GPS_Vel_ECEF_1, 9179938 (0x8c1322) */
/begin MEASUREMENT crt_PT_8c1322_Accuracy_GPS_Vel_ECEF_Y "signal Accuracy_GPS_Vel_ECEF_Y of frame RT_SB_GPS_Vel_ECEF_1, 9179938 (0x8c1322)" UBYTE CONV_crt_PT_8c1322_Accuracy_GPS_Vel_ECEF_Y 1.0 100.0 0 255 ECU_ADDRESS 0x0000 /end MEASUREMENT
/begin COMPU_METHOD CONV_crt_PT_8c1322_Accuracy_GPS_Vel_ECEF_Y "Linear scaling, used for variable crt_PT_8c1322_Accuracy_GPS_Vel_ECEF_Y, signal Accuracy_GPS_Vel_ECEF_Y" RAT_FUNC "%4" "" COEFFS 0 1 0 0 0 1 /end COMPU_METHOD
/* Measurement point for signal Accuracy_GPS_Vel_ECEF_Z of frame RT_SB_GPS_Vel_ECEF_1, 9179938 (0x8c1322) */
/begin MEASUREMENT crt_PT_8c1322_Accuracy_GPS_Vel_ECEF_Z "signal Accuracy_GPS_Vel_ECEF_Z of frame RT_SB_GPS_Vel_ECEF_1, 9179938 (0x8c1322)" UBYTE CONV_crt_PT_8c1322_Accuracy_GPS_Vel_ECEF_Z 1.0 100.0 0 255 ECU_ADDRESS 0x0000 /end MEASUREMENT
/begin COMPU_METHOD CONV_crt_PT_8c1322_Accuracy_GPS_Vel_ECEF_Z "Linear scaling, used for variable crt_PT_8c1322_Accuracy_GPS_Vel_ECEF_Z, signal Accuracy_GPS_Vel_ECEF_Z" RAT_FUNC "%4" "" COEFFS 0 1 0 0 0 1 /end COMPU_METHOD
/* Measurement point for signal GPS_Vel_ECEF_X of frame RT_SB_GPS_Vel_ECEF_1, 9179938 (0x8c1322) */
/begin MEASUREMENT crt_PT_8c1322_GPS_Vel_ECEF_X "signal GPS_Vel_ECEF_X of frame RT_SB_GPS_Vel_ECEF_1, 9179938 (0x8c1322). ECEF X velocity.  The ECEF X axis originates from the Earth centre, and the positive X axis intersects the Earth surface at zero degrees latittude and zero degrees longitude (the intersection of the equator and the prime meridian)." SLONG CONV_crt_PT_8c1322_GPS_Vel_ECEF_X 1.0E-4 100.0 -838.0 838.0 ECU_ADDRESS 0x0000 /end MEASUREMENT
/begin COMPU_METHOD CONV_crt_PT_8c1322_GPS_Vel_ECEF_X "Linear scaling, used for variable crt_PT_8c1322_GPS_Vel_ECEF_X, signal GPS_Vel_ECEF_X" RAT_FUNC "%12" "m/s" COEFFS 0 1 -0.0 0 0 1.0E-4 /end COMPU_METHOD
/* Measurement point for signal Validity_GPS_Vel_NED_D of frame RT_SB_GPS_Vel_NED_2, 0 (0x000) */
/begin MEASUREMENT crt_PT_000_Validity_GPS_Vel_NED_D "signal Validity_GPS_Vel_NED_D of frame RT_SB_GPS_Vel_NED_2, 0 (0x000). Valid when bit is set, invalid when bit is clear." UBYTE CONV_crt_PT_000_Validity_GPS_Vel_NED_D 1.0 100.0 0 1 ECU_ADDRESS 0x0000 /end MEASUREMENT
/begin COMPU_METHOD CONV_crt_PT_000_Validity_GPS_Vel_NED_D "Linear scaling, used for variable crt_PT_000_Validity_GPS_Vel_NED_D, signal Validity_GPS_Vel_NED_D" RAT_FUNC "%1" "" COEFFS 0 1 0 0 0 1 /end COMPU_METHOD
/* Measurement point for signal Accuracy_GPS_Vel_D of frame RT_SB_GPS_Vel_NED_2, 0 (0x000) */
/begin MEASUREMENT crt_PT_000_Accuracy_GPS_Vel_D "signal Accuracy_GPS_Vel_D of frame RT_SB_GPS_Vel_NED_2, 0 (0x000)" UBYTE CONV_crt_PT_000_Accuracy_GPS_Vel_D 1.0 100.0 0 255 ECU_ADDRESS 0x0000 /end MEASUREMENT
/begin COMPU_METHOD CONV_crt_PT_000_Accuracy_GPS_Vel_D "Linear scaling, used for variable crt_PT_000_Accuracy_GPS_Vel_D, signal Accuracy_GPS_Vel_D" RAT_FUNC "%4" "" COEFFS 0 1 0 0 0 1 /end COMPU_METHOD
/* Measurement point for signal GPS_Vel_NED_D of frame RT_SB_GPS_Vel_NED_2, 0 (0x000) */
/begin MEASUREMENT crt_PT_000_GPS_Vel_NED_D "signal GPS_Vel_NED_D of frame RT_SB_GPS_Vel_NED_2, 0 (0x000). VELNED D velocity.  This is the velocity vector directly downwards towards the Earth centre at the current local Earth surface position." SLONG CONV_crt_PT_000_GPS_Vel_NED_D 1.0E-4 100.0 -838.0 838.0 ECU_ADDRESS 0x0000 /end MEASUREMENT
/begin COMPU_METHOD CONV_crt_PT_000_GPS_Vel_NED_D "Linear scaling, used for variable crt_PT_000_GPS_Vel_NED_D, signal GPS_Vel_NED_D" RAT_FUNC "%12" "m/s" COEFFS 0 1 -0.0 0 0 1.0E-4 /end COMPU_METHOD
/* Measurement point for signal Validity_GPS_Vel_NED_N of frame RT_SB_GPS_Vel_NED_1, 536870911 (0x1fffffff) */
/begin MEASUREMENT crt_PT_1fffffff_Validity_GPS_Vel_NED_N "signal Validity_GPS_Vel_NED_N of frame RT_SB_GPS_Vel_NED_1, 536870911 (0x1fffffff). Valid when bit is set, invalid when bit is clear." UBYTE CONV_crt_PT_1fffffff_Validity_GPS_Vel_NED_N 1.0 100.0 0 1 ECU_ADDRESS 0x0000 /end MEASUREMENT
/begin COMPU_METHOD CONV_crt_PT_1fffffff_Validity_GPS_Vel_NED_N "Linear scaling, used for variable crt_PT_1fffffff_Validity_GPS_Vel_NED_N, signal Validity_GPS_Vel_NED_N" RAT_FUNC "%1" "" COEFFS 0 1 0 0 0 1 /end COMPU_METHOD
/* Measurement point for signal Validity_GPS_Vel_NED_E of frame RT_SB_GPS_Vel_NED_1, 536870911 (0x1fffffff) */
/begin MEASUREMENT crt_PT_1fffffff_Validity_GPS_Vel_NED_E "signal Validity_GPS_Vel_NED_E of frame RT_SB_GPS_Vel_NED_1, 536870911 (0x1fffffff). Valid when bit is set, invalid when bit is clear." UBYTE CONV_crt_PT_1fffffff_Validity_GPS_Vel_NED_E 1.0 100.0 0 1 ECU_ADDRESS 0x0000 /end MEASUREMENT
/begin COMPU_METHOD CONV_crt_PT_1fffffff_Validity_GPS_Vel_NED_E "Linear scaling, used for variable crt_PT_1fffffff_Validity_GPS_Vel_NED_E, signal Validity_GPS_Vel_NED_E" RAT_FUNC "%1" "" COEFFS 0 1 0 0 0 1 /end COMPU_METHOD
/* Measurement point for signal Accuracy_GPS_Vel_NE of frame RT_SB_GPS_Vel_NED_1, 536870911 (0x1fffffff) */
/begin MEASUREMENT crt_PT_1fffffff_Accuracy_GPS_Vel_NE "signal Accuracy_GPS_Vel_NE of frame RT_SB_GPS_Vel_NED_1, 536870911 (0x1fffffff)" UBYTE CONV_crt_PT_1fffffff_Accuracy_GPS_Vel_NE 1.0 100.0 0 255 ECU_ADDRESS 0x0000 /end MEASUREMENT
/begin COMPU_METHOD CONV_crt_PT_1fffffff_Accuracy_GPS_Vel_NE "Linear scaling, used for variable crt_PT_1fffffff_Accuracy_GPS_Vel_NE, signal Accuracy_GPS_Vel_NE" RAT_FUNC "%4" "" COEFFS 0 1 0 0 0 1 /end COMPU_METHOD
/* Measurement point for signal GPS_Vel_NED_N of frame RT_SB_GPS_Vel_NED_1, 536870911 (0x1fffffff) */
/begin MEASUREMENT crt_PT_1fffffff_GPS_Vel_NED_N "signal GPS_Vel_NED_N of frame RT_SB_GPS_Vel_NED_1, 536870911 (0x1fffffff). VELNED N velocity.  This is the velocity vector directly North at the current local Earth surface position." SLONG CONV_crt_PT_1fffffff_GPS_Vel_NED_N 1.0E-4 100.0 -838.0 838.0 ECU_ADDRESS 0x0000 /end MEASUREMENT
/begin COMPU_METHOD CONV_crt_PT_1fffffff_GPS_Vel_NED_N "Linear scaling, used for variable crt_PT_1fffffff_GPS_Vel_NED_N, signal GPS_Vel_NED_N" RAT_FUNC "%12" "m/s" COEFFS 0 1 -0.0 0 0 1.0E-4 /end COMPU_METHOD
/* Measurement point for signal GPS_Vel_NED_E of frame RT_SB_GPS_Vel_NED_1, 536870911 (0x1fffffff) */
/begin MEASUREMENT crt_PT_1fffffff_GPS_Vel_NED_E "signal GPS_Vel_NED_E of frame RT_SB_GPS_Vel_NED_1, 536870911 (0x1fffffff). VELNED E velocity.  This is the velocity vector directly East at the current local Earth surface position." SLONG CONV_crt_PT_1fffffff_GPS_Vel_NED_E 1.0E-4 100.0 -838.0 838.0 ECU_ADDRESS 0x0000 /end MEASUREMENT
/begin COMPU_METHOD CONV_crt_PT_1fffffff_GPS_Vel_NED_E "Linear scaling, used for variable crt_PT_1fffffff_GPS_Vel_NED_E, signal GPS_Vel_NED_E" RAT_FUNC "%12" "m/s" COEFFS 0 1 -0.0 0 0 1.0E-4 /end COMPU_METHOD
/* Measurement point for signal Validity_GPS_Speed_2D of frame RT_SB_GPS_Speed, 1818 (0x71a) */
/begin MEASUREMENT crt_PT_71a_Validity_GPS_Speed_2D "signal Validity_GPS_Speed_2D of frame RT_SB_GPS_Speed, 1818 (0x71a). Valid when bit is set, invalid when bit is clear." UBYTE CONV_crt_PT_71a_Validity_GPS_Speed_2D 1.0 100.0 0 1 ECU_ADDRESS 0x0000 /end MEASUREMENT
/begin COMPU_METHOD CONV_crt_PT_71a_Validity_GPS_Speed_2D "Linear scaling, used for variable crt_PT_71a_Validity_GPS_Speed_2D, signal Validity_GPS_Speed_2D" RAT_FUNC "%1" "" COEFFS 0 1 0 0 0 1 /end COMPU_METHOD
/* Measurement point for signal Validity_GPS_Speed_3D of frame RT_SB_GPS_Speed, 1818 (0x71a) */
/begin MEASUREMENT crt_PT_71a_Validity_GPS_Speed_3D "signal Validity_GPS_Speed_3D of frame RT_SB_GPS_Speed, 1818 (0x71a). Valid when bit is set, invalid when bit is clear." UBYTE CONV_crt_PT_71a_Validity_GPS_Speed_3D 1.0 100.0 0 1 ECU_ADDRESS 0x0000 /end MEASUREMENT
/begin COMPU_METHOD CONV_crt_PT_71a_Validity_GPS_Speed_3D "Linear scaling, used for variable crt_PT_71a_Validity_GPS_Speed_3D, signal Validity_GPS_Speed_3D" RAT_FUNC "%1" "" COEFFS 0 1 0 0 0 1 /end COMPU_METHOD
/* Measurement point for signal Accuracy_GPS_Speed of frame RT_SB_GPS_Speed, 1818 (0x71a) */
/begin MEASUREMENT crt_PT_71a_Accuracy_GPS_Speed "signal Accuracy_GPS_Speed of frame RT_SB_GPS_Speed, 1818 (0x71a). This accuracy value applies to both 2D and 3D GPS speed." UBYTE CONV_crt_PT_71a_Accuracy_GPS_Speed 1.0 100.0 0 255 ECU_ADDRESS 0x0000 /end MEASUREMENT
/begin COMPU_METHOD CONV_crt_PT_71a_Accuracy_GPS_Speed "Linear scaling, used for variable crt_PT_71a_Accuracy_GPS_Speed, signal Accuracy_GPS_Speed" RAT_FUNC "%4" "" COEFFS 0 1 0 0 0 1 /end COMPU_METHOD
/* Measurement point for signal GPS_Speed_2D of frame RT_SB_GPS_Speed, 1818 (0x71a) */
/begin MEASUREMENT crt_PT_71a_GPS_Speed_2D "signal GPS_Speed_2D of frame RT_SB_GPS_Speed, 1818 (0x71a). This is GPS scalar 2D speed - scalar speed with no local Z axis component included." ULONG CONV_crt_PT_71a_GPS_Speed_2D 1.0E-4 100.0 0.0 1675.0 ECU_ADDRESS 0x0000 /end MEASUREMENT
/begin COMPU_METHOD CONV_crt_PT_71a_GPS_Speed_2D "Linear scaling, used for variable crt_PT_71a_GPS_Speed_2D, signal GPS_Speed_2D" RAT_FUNC "%12" "m/s" COEFFS 0 1 -0.0 0 0 1.0E-4 /end COMPU_METHOD
/* Measurement point for signal GPS_Speed_3D of frame RT_SB_GPS_Speed, 1818 (0x71a) */
/begin MEASUREMENT crt_PT_71a_GPS_Speed_3D "signal GPS_Speed_3D of frame RT_SB_GPS_Speed, 1818 (0x71a). This is GPS scalar 3D speed - scalar speed with the local Z axis component included." ULONG CONV_crt_PT_71a_GPS_Speed_3D 1.0E-4 100.0 0.0 1675.0 ECU_ADDRESS 0x0000 /end MEASUREMENT
/begin COMPU_METHOD CONV_crt_PT_71a_GPS_Speed_3D "Linear scaling, used for variable crt_PT_71a_GPS_Speed_3D, signal GPS_Speed_3D" RAT_FUNC "%12" "m/s" COEFFS 0 1 -0.0 0 0 1.0E-4 /end COMPU_METHOD
/* Measurement point for signal Validity_GPS_Time of frame RT_SB_GPS_Time, 2047 (0x7ff) */
/begin MEASUREMENT crt_PT_7ff_Validity_GPS_Time "signal Validity_GPS_Time of frame RT_SB_GPS_Time, 2047 (0x7ff). Valid when bit is set, invalid when bit is clear." UBYTE CONV_crt_PT_7ff_Validity_GPS_Time 1.0 100.0 0 1 ECU_ADDRESS 0x0000 /end MEASUREMENT
/begin COMPU_METHOD CONV_crt_PT_7ff_Validity_GPS_Time "Linear scaling, used for variable crt_PT_7ff_Validity_GPS_Time, signal Validity_GPS_Time" RAT_FUNC "%1" "" COEFFS 0 1 0 0 0 1 /end COMPU_METHOD
/* Measurement point for signal Validity_GPS_Week of frame RT_SB_GPS_Time, 2047 (0x7ff) */
/begin MEASUREMENT crt_PT_7ff_Validity_GPS_Week "signal Validity_GPS_Week of frame RT_SB_GPS_Time, 2047 (0x7ff). Valid when bit is set, invalid when bit is clear." UBYTE CONV_crt_PT_7ff_Validity_GPS_Week 1.0 100.0 0 1 ECU_ADDRESS 0x0000 /end MEASUREMENT
/begin COMPU_METHOD CONV_crt_PT_7ff_Validity_GPS_Week "Linear scaling, used for variable crt_PT_7ff_Validity_GPS_Week, signal Validity_GPS_Week" RAT_FUNC "%1" "" COEFFS 0 1 0 0 0 1 /end COMPU_METHOD
/* Measurement point for signal Accuracy_GPS_Time of frame RT_SB_GPS_Time, 2047 (0x7ff) */
/begin MEASUREMENT crt_PT_7ff_Accuracy_GPS_Time "signal Accuracy_GPS_Time of frame RT_SB_GPS_Time, 2047 (0x7ff)" UBYTE CONV_crt_PT_7ff_Accuracy_GPS_Time 1.0 100.0 0 255 ECU_ADDRESS 0x0000 /end MEASUREMENT
/begin COMPU_METHOD CONV_crt_PT_7ff_Accuracy_GPS_Time "Linear scaling, used for variable crt_PT_7ff_Accuracy_GPS_Time, signal Accuracy_GPS_Time" RAT_FUNC "%4" "" COEFFS 0 1 0 0 0 1 /end COMPU_METHOD
/* Measurement point for signal GPS_Time of frame RT_SB_GPS_Time, 2047 (0x7ff) */
/begin MEASUREMENT crt_PT_7ff_GPS_Time "signal GPS_Time of frame RT_SB_GPS_Time, 2047 (0x7ff). GPS time is the time in seconds since midnight GMT on Saturday night." ULONG CONV_crt_PT_7ff_GPS_Time 0.001 100.0 0.0 604800.0 ECU_ADDRESS 0x0000 /end MEASUREMENT
/begin COMPU_METHOD CONV_crt_PT_7ff_GPS_Time "Linear scaling, used for variable crt_PT_7ff_GPS_Time, signal GPS_Time" RAT_FUNC "%12" "s" COEFFS 0 1 -0.0 0 0 0.001 /end COMPU_METHOD
/* Measurement point for signal GPS_Week of frame RT_SB_GPS_Time, 2047 (0x7ff) */
/begin MEASUREMENT crt_PT_7ff_GPS_Week "signal GPS_Week of frame RT_SB_GPS_Time, 2047 (0x7ff)" UWORD CONV_crt_PT_7ff_GPS_Week 1.0 100.0 0 65535 ECU_ADDRESS 0x0000 /end MEASUREMENT
/begin COMPU_METHOD CONV_crt_PT_7ff_GPS_Week "Linear scaling, used for variable crt_PT_7ff_GPS_Week, signal GPS_Week" RAT_FUNC "%6" "" COEFFS 0 1 0 0 0 1 /end COMPU_METHOD
/* Measurement point for signal Validity_Accel_Longitudinal of frame RT_SB_Accel, 290 (0x122) */
/begin MEASUREMENT crt_PT_122_Validity_Accel_Longitudinal "signal Validity_Accel_Longitudinal of frame RT_SB_Accel, 290 (0x122). Valid when bit is set, invalid when bit is clear." UBYTE CONV_crt_PT_122_Validity_Accel_Longitudinal 1.0 100.0 0 1 ECU_ADDRESS 0x0000 /end MEASUREMENT
/begin COMPU_METHOD CONV_crt_PT_122_Validity_Accel_Longitudinal "Linear scaling, used for variable crt_PT_122_Validity_Accel_Longitudinal, signal Validity_Accel_Longitudinal" RAT_FUNC "%1" "" COEFFS 0 1 0 0 0 1 /end COMPU_METHOD
/* Measurement point for signal Validity_Accel_Lateral of frame RT_SB_Accel, 290 (0x122) */
/begin MEASUREMENT crt_PT_122_Validity_Accel_Lateral "signal Validity_Accel_Lateral of frame RT_SB_Accel, 290 (0x122). Valid when bit is set, invalid when bit is clear." UBYTE CONV_crt_PT_122_Validity_Accel_Lateral 1.0 100.0 0 1 ECU_ADDRESS 0x0000 /end MEASUREMENT
/begin COMPU_METHOD CONV_crt_PT_122_Validity_Accel_Lateral "Linear scaling, used for variable crt_PT_122_Validity_Accel_Lateral, signal Validity_Accel_Lateral" RAT_FUNC "%1" "" COEFFS 0 1 0 0 0 1 /end COMPU_METHOD
/* Measurement point for signal Validity_Accel_Vertical of frame RT_SB_Accel, 290 (0x122) */
/begin MEASUREMENT crt_PT_122_Validity_Accel_Vertical "signal Validity_Accel_Vertical of frame RT_SB_Accel, 290 (0x122). Valid when bit is set, invalid when bit is clear." UBYTE CONV_crt_PT_122_Validity_Accel_Vertical 1.0 100.0 0 1 ECU_ADDRESS 0x0000 /end MEASUREMENT
/begin COMPU_METHOD CONV_crt_PT_122_Validity_Accel_Vertical "Linear scaling, used for variable crt_PT_122_Validity_Accel_Vertical, signal Validity_Accel_Vertical" RAT_FUNC "%1" "" COEFFS 0 1 0 0 0 1 /end COMPU_METHOD
/* Measurement point for signal Accuracy_Accel of frame RT_SB_Accel, 290 (0x122) */
/begin MEASUREMENT crt_PT_122_Accuracy_Accel "signal Accuracy_Accel of frame RT_SB_Accel, 290 (0x122). Dimensionless.  Lower values imply but do not guarantee better accuracy than higher values." UBYTE CONV_crt_PT_122_Accuracy_Accel 1.0 100.0 0 255 ECU_ADDRESS 0x0000 /end MEASUREMENT
/begin COMPU_METHOD CONV_crt_PT_122_Accuracy_Accel "Linear scaling, used for variable crt_PT_122_Accuracy_Accel, signal Accuracy_Accel" RAT_FUNC "%4" "" COEFFS 0 1 0 0 0 1 /end COMPU_METHOD
/* Measurement point for signal Accel_Longitudinal of frame RT_SB_Accel, 290 (0x122) */
/begin MEASUREMENT crt_PT_122_Accel_Longitudinal "signal Accel_Longitudinal of frame RT_SB_Accel, 290 (0x122). Longitudinal acceleration.  This is positive when the vehicle accelerates in a forwards direction." SWORD CONV_crt_PT_122_Accel_Longitudinal 0.001 100.0 -65.0 65.0 ECU_ADDRESS 0x0000 /end MEASUREMENT
/begin COMPU_METHOD CONV_crt_PT_122_Accel_Longitudinal "Linear scaling, used for variable crt_PT_122_Accel_Longitudinal, signal Accel_Longitudinal" RAT_FUNC "%6" "g" COEFFS 0 1 -0.0 0 0 0.001 /end COMPU_METHOD
/* Measurement point for signal Accel_Lateral of frame RT_SB_Accel, 290 (0x122) */
/begin MEASUREMENT crt_PT_122_Accel_Lateral "signal Accel_Lateral of frame RT_SB_Accel, 290 (0x122). Lateral acceleration.  This is positive when the vehicle accelerates towards the right, e.g. when cornering around a right-hand bend." SWORD CONV_crt_PT_122_Accel_Lateral 0.001 100.0 -65.0 65.0 ECU_ADDRESS 0x0000 /end MEASUREMENT
/begin COMPU_METHOD CONV_crt_PT_122_Accel_Lateral "Linear scaling, used for variable crt_PT_122_Accel_Lateral, signal Accel_Lateral" RAT_FUNC "%6" "g" COEFFS 0 1 -0.0 0 0 0.001 /end COMPU_METHOD
/* Measurement point for signal Accel_Vertical of frame RT_SB_Accel, 290 (0x122) */
/begin MEASUREMENT crt_PT_122_Accel_Vertical "signal Accel_Vertical of frame RT_SB_Accel, 290 (0x122). Vertical acceleration.  This is positive when the vehicle accelerates in an upwards direction, e.g. when travelling through a dip." SWORD CONV_crt_PT_122_Accel_Vertical 0.001 100.0 -65.0 65.0 ECU_ADDRESS 0x0000 /end MEASUREMENT
/begin COMPU_METHOD CONV_crt_PT_122_Accel_Vertical "Linear scaling, used for variable crt_PT_122_Accel_Vertical, signal Accel_Vertical" RAT_FUNC "%6" "g" COEFFS 0 1 -0.0 0 0 0.001 /end COMPU_METHOD
/* Measurement point for signal Validity_Gyro_Rate_Yaw of frame RT_SB_Gyro_Rates, 8388898 (0x800122) */
/begin MEASUREMENT crt_PT_800122_Validity_Gyro_Rate_Yaw "signal Validity_Gyro_Rate_Yaw of frame RT_SB_Gyro_Rates, 8388898 (0x800122). Valid when bit is set, invalid when bit is clear." UBYTE CONV_crt_PT_800122_Validity_Gyro_Rate_Yaw 1.0 100.0 0 1 ECU_ADDRESS 0x0000 /end MEASUREMENT
/begin COMPU_METHOD CONV_crt_PT_800122_Validity_Gyro_Rate_Yaw "Linear scaling, used for variable crt_PT_800122_Validity_Gyro_Rate_Yaw, signal Validity_Gyro_Rate_Yaw" RAT_FUNC "%1" "" COEFFS 0 1 0 0 0 1 /end COMPU_METHOD
/* Measurement point for signal Validity_Gyro_Rate_Pitch of frame RT_SB_Gyro_Rates, 8388898 (0x800122) */
/begin MEASUREMENT crt_PT_800122_Validity_Gyro_Rate_Pitch "signal Validity_Gyro_Rate_Pitch of frame RT_SB_Gyro_Rates, 8388898 (0x800122). Valid when bit is set, invalid when bit is clear." UBYTE CONV_crt_PT_800122_Validity_Gyro_Rate_Pitch 1.0 100.0 0 1 ECU_ADDRESS 0x0000 /end MEASUREMENT
/begin COMPU_METHOD CONV_crt_PT_800122_Validity_Gyro_Rate_Pitch "Linear scaling, used for variable crt_PT_800122_Validity_Gyro_Rate_Pitch, signal Validity_Gyro_Rate_Pitch" RAT_FUNC "%1" "" COEFFS 0 1 0 0 0 1 /end COMPU_METHOD
/* Measurement point for signal Validity_Gyro_Rate_Roll of frame RT_SB_Gyro_Rates, 8388898 (0x800122) */
/begin MEASUREMENT crt_PT_800122_Validity_Gyro_Rate_Roll "signal Validity_Gyro_Rate_Roll of frame RT_SB_Gyro_Rates, 8388898 (0x800122). Valid when bit is set, invalid when bit is clear." UBYTE CONV_crt_PT_800122_Validity_Gyro_Rate_Roll 1.0 100.0 0 1 ECU_ADDRESS 0x0000 /end MEASUREMENT
/begin COMPU_METHOD CONV_crt_PT_800122_Validity_Gyro_Rate_Roll "Linear scaling, used for variable crt_PT_800122_Validity_Gyro_Rate_Roll, signal Validity_Gyro_Rate_Roll" RAT_FUNC "%1" "" COEFFS 0 1 0 0 0 1 /end COMPU_METHOD
/* Measurement point for signal Accuracy_Gyro_Rates of frame RT_SB_Gyro_Rates, 8388898 (0x800122) */
/begin MEASUREMENT crt_PT_800122_Accuracy_Gyro_Rates "signal Accuracy_Gyro_Rates of frame RT_SB_Gyro_Rates, 8388898 (0x800122). Dimensionless.  Lower values imply but do not guarantee better accuracy than higher values." UBYTE CONV_crt_PT_800122_Accuracy_Gyro_Rates 1.0 100.0 0 0 ECU_ADDRESS 0x0000 /end MEASUREMENT
/begin COMPU_METHOD CONV_crt_PT_800122_Accuracy_Gyro_Rates "Linear scaling, used for variable crt_PT_800122_Accuracy_Gyro_Rates, signal Accuracy_Gyro_Rates" RAT_FUNC "%4" "" COEFFS 0 1 0 0 0 1 /end COMPU_METHOD
/* Measurement point for signal Gyro_Rate_Yaw of frame RT_SB_Gyro_Rates, 8388898 (0x800122) */
/begin MEASUREMENT crt_PT_800122_Gyro_Rate_Yaw "signal Gyro_Rate_Yaw of frame RT_SB_Gyro_Rates, 8388898 (0x800122). Yaw rate is positive for clockwise rotation when looking down on the vehicle from above." SWORD CONV_crt_PT_800122_Gyro_Rate_Yaw 0.01 100.0 -327.0 327.0 ECU_ADDRESS 0x0000 /end MEASUREMENT
/begin COMPU_METHOD CONV_crt_PT_800122_Gyro_Rate_Yaw "Linear scaling, used for variable crt_PT_800122_Gyro_Rate_Yaw, signal Gyro_Rate_Yaw" RAT_FUNC "%6" "degrees/s" COEFFS 0 1 -0.0 0 0 0.01 /end COMPU_METHOD
/* Measurement point for signal Gyro_Rate_Pitch of frame RT_SB_Gyro_Rates, 8388898 (0x800122) */
/begin MEASUREMENT crt_PT_800122_Gyro_Rate_Pitch "signal Gyro_Rate_Pitch of frame RT_SB_Gyro_Rates, 8388898 (0x800122). Pitch rate is positive for clockwise rotation when looking at the left hand side of the vehicle from the left of the vehicle." SWORD CONV_crt_PT_800122_Gyro_Rate_Pitch 0.01 100.0 -327.0 327.0 ECU_ADDRESS 0x0000 /end MEASUREMENT
/begin COMPU_METHOD CONV_crt_PT_800122_Gyro_Rate_Pitch "Linear scaling, used for variable crt_PT_800122_Gyro_Rate_Pitch, signal Gyro_Rate_Pitch" RAT_FUNC "%6" "degrees/s" COEFFS 0 1 -0.0 0 0 0.01 /end COMPU_METHOD
/* Measurement point for signal Gyro_Rate_Roll of frame RT_SB_Gyro_Rates, 8388898 (0x800122) */
/begin MEASUREMENT crt_PT_800122_Gyro_Rate_Roll "signal Gyro_Rate_Roll of frame RT_SB_Gyro_Rates, 8388898 (0x800122). Roll rate is positive for clockwise rotation when looking at the rear of the vehicle from behind the vehicle." SWORD CONV_crt_PT_800122_Gyro_Rate_Roll 0.01 100.0 -327.0 327.0 ECU_ADDRESS 0x0000 /end MEASUREMENT
/begin COMPU_METHOD CONV_crt_PT_800122_Gyro_Rate_Roll "Linear scaling, used for variable crt_PT_800122_Gyro_Rate_Roll, signal Gyro_Rate_Roll" RAT_FUNC "%6" "degrees/s" COEFFS 0 1 -0.0 0 0 0.01 /end COMPU_METHOD
/end MODULE
/end PROJECT
