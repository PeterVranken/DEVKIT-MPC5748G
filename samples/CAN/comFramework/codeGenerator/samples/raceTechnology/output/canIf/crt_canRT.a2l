/* ASAM MCD-2MC interface specification for CAN network cluster raceCar */
/* Created with comFramework - codeGenerator version 1.10.4, see http://sourceforge.net/projects/comframe/ */
/begin PROJECT MERGED_PROJECT "CAN interface of cluster raceCar"
/begin HEADER "This is an A2L fragment which has to be merged into the main project" VERSION "31.10.2020 18:40:30" /end HEADER
/begin MODULE MERGED_MODULE "CAN interface of cluster raceCar"
/begin MOD_PAR "MODULE PARAMETERS" VERSION "31.10.2020 18:40:30" /end MOD_PAR
/* Measurement point for signal Validity_INS_Vel_Forwards of frame RT_SB_INS_Vel_Body_Axes, 215 (0x0d7) */
/begin MEASUREMENT crt_PT_0d7_Validity_INS_Vel_Forwards "signal Validity_INS_Vel_Forwards of frame RT_SB_INS_Vel_Body_Axes, 215 (0x0d7)" UBYTE CONV_crt_PT_0d7_Validity_INS_Vel_Forwards 1.0 100.0 0 1 ECU_ADDRESS 0x0000 /end MEASUREMENT
/begin COMPU_METHOD CONV_crt_PT_0d7_Validity_INS_Vel_Forwards "Linear scaling, used for variable crt_PT_0d7_Validity_INS_Vel_Forwards, signal Validity_INS_Vel_Forwards" RAT_FUNC "%1" "" COEFFS 0 1 0 0 0 1 /end COMPU_METHOD
/* Measurement point for signal Validity_INS_Vel_Sideways of frame RT_SB_INS_Vel_Body_Axes, 215 (0x0d7) */
/begin MEASUREMENT crt_PT_0d7_Validity_INS_Vel_Sideways "signal Validity_INS_Vel_Sideways of frame RT_SB_INS_Vel_Body_Axes, 215 (0x0d7)" UBYTE CONV_crt_PT_0d7_Validity_INS_Vel_Sideways 1.0 100.0 0 1 ECU_ADDRESS 0x0000 /end MEASUREMENT
/begin COMPU_METHOD CONV_crt_PT_0d7_Validity_INS_Vel_Sideways "Linear scaling, used for variable crt_PT_0d7_Validity_INS_Vel_Sideways, signal Validity_INS_Vel_Sideways" RAT_FUNC "%1" "" COEFFS 0 1 0 0 0 1 /end COMPU_METHOD
/* Measurement point for signal Bit4 of frame RT_SB_INS_Vel_Body_Axes, 215 (0x0d7) */
/begin MEASUREMENT crt_PT_0d7_Bit4 "signal Bit4 of frame RT_SB_INS_Vel_Body_Axes, 215 (0x0d7)" UBYTE CONV_crt_PT_0d7_Bit4 1.0 100.0 0 1 ECU_ADDRESS 0x0000 /end MEASUREMENT
/begin COMPU_METHOD CONV_crt_PT_0d7_Bit4 "Linear scaling, used for variable crt_PT_0d7_Bit4, signal Bit4" RAT_FUNC "%1" "" COEFFS 0 1 0 0 0 1 /end COMPU_METHOD
/* Measurement point for signal Bit7 of frame RT_SB_INS_Vel_Body_Axes, 215 (0x0d7) */
/begin MEASUREMENT crt_PT_0d7_Bit7 "signal Bit7 of frame RT_SB_INS_Vel_Body_Axes, 215 (0x0d7)" UBYTE CONV_crt_PT_0d7_Bit7 1.0 100.0 0 1 ECU_ADDRESS 0x0000 /end MEASUREMENT
/begin COMPU_METHOD CONV_crt_PT_0d7_Bit7 "Linear scaling, used for variable crt_PT_0d7_Bit7, signal Bit7" RAT_FUNC "%1" "" COEFFS 0 1 0 0 0 1 /end COMPU_METHOD
/* Measurement point for signal Byte2_Bit0 of frame RT_SB_INS_Vel_Body_Axes, 215 (0x0d7) */
/begin MEASUREMENT crt_PT_0d7_Byte2_Bit0 "signal Byte2_Bit0 of frame RT_SB_INS_Vel_Body_Axes, 215 (0x0d7)" UBYTE CONV_crt_PT_0d7_Byte2_Bit0 1.0 100.0 0 1 ECU_ADDRESS 0x0000 /end MEASUREMENT
/begin COMPU_METHOD CONV_crt_PT_0d7_Byte2_Bit0 "Linear scaling, used for variable crt_PT_0d7_Byte2_Bit0, signal Byte2_Bit0" RAT_FUNC "%1" "" COEFFS 0 1 0 0 0 1 /end COMPU_METHOD
/* Measurement point for signal INS_Vel_Sideways_2D of frame RT_SB_INS_Vel_Body_Axes, 215 (0x0d7) */
/begin MEASUREMENT crt_PT_0d7_INS_Vel_Sideways_2D "signal INS_Vel_Sideways_2D of frame RT_SB_INS_Vel_Body_Axes, 215 (0x0d7)" SLONG CONV_crt_PT_0d7_INS_Vel_Sideways_2D 1.0E-4 100.0 -838.0 838.0 ECU_ADDRESS 0x0000 /end MEASUREMENT
/begin COMPU_METHOD CONV_crt_PT_0d7_INS_Vel_Sideways_2D "Linear scaling, used for variable crt_PT_0d7_INS_Vel_Sideways_2D, signal INS_Vel_Sideways_2D" RAT_FUNC "%12" "m/s" COEFFS 0 1 -0.0 0 0 1.0E-4 /end COMPU_METHOD
/* Measurement point for signal Byte4_Bits67 of frame RT_SB_INS_Vel_Body_Axes, 215 (0x0d7) */
/begin MEASUREMENT crt_PT_0d7_Byte4_Bits67 "signal Byte4_Bits67 of frame RT_SB_INS_Vel_Body_Axes, 215 (0x0d7)" UBYTE CONV_crt_PT_0d7_Byte4_Bits67 1.0 100.0 1 3 ECU_ADDRESS 0x0000 /end MEASUREMENT
/begin COMPU_METHOD CONV_crt_PT_0d7_Byte4_Bits67 "Linear scaling, used for variable crt_PT_0d7_Byte4_Bits67, signal Byte4_Bits67" RAT_FUNC "%4" "Mpx selection" COEFFS 0 1 0 0 0 1 /end COMPU_METHOD
/* Measurement point for signal Accuracy_INS_Vel_Body_org of frame RT_SB_INS_Vel_Body_Axes, 215 (0x0d7) */
/begin MEASUREMENT crt_PT_0d7_Accuracy_INS_Vel_Body_org_m1 "signal Accuracy_INS_Vel_Body_org of frame RT_SB_INS_Vel_Body_Axes, 215 (0x0d7)" UBYTE CONV_crt_PT_0d7_Accuracy_INS_Vel_Body_org_m1 1.0 100.0 0 255 ECU_ADDRESS 0x0000 /end MEASUREMENT
/begin COMPU_METHOD CONV_crt_PT_0d7_Accuracy_INS_Vel_Body_org_m1 "Linear scaling, used for variable crt_PT_0d7_Accuracy_INS_Vel_Body_org_m1, signal Accuracy_INS_Vel_Body_org" RAT_FUNC "%4" "" COEFFS 0 1 0 0 0 1 /end COMPU_METHOD
/* Measurement point for signal INS_Vel_Forwards_2D_org of frame RT_SB_INS_Vel_Body_Axes, 215 (0x0d7) */
/begin MEASUREMENT crt_PT_0d7_INS_Vel_Forwards_2D_org_m1 "signal INS_Vel_Forwards_2D_org of frame RT_SB_INS_Vel_Body_Axes, 215 (0x0d7)" SLONG CONV_crt_PT_0d7_INS_Vel_Forwards_2D_org_m1 1.0E-4 100.0 -838.0 838.0 ECU_ADDRESS 0x0000 /end MEASUREMENT
/begin COMPU_METHOD CONV_crt_PT_0d7_INS_Vel_Forwards_2D_org_m1 "Linear scaling, used for variable crt_PT_0d7_INS_Vel_Forwards_2D_org_m1, signal INS_Vel_Forwards_2D_org" RAT_FUNC "%12" "m/s" COEFFS 0 1 -0.0 0 0 1.0E-4 /end COMPU_METHOD
/* Measurement point for signal Accuracy_INS_Vel_Body_no2 of frame RT_SB_INS_Vel_Body_Axes, 215 (0x0d7) */
/begin MEASUREMENT crt_PT_0d7_Accuracy_INS_Vel_Body_no2_m2 "signal Accuracy_INS_Vel_Body_no2 of frame RT_SB_INS_Vel_Body_Axes, 215 (0x0d7)" UBYTE CONV_crt_PT_0d7_Accuracy_INS_Vel_Body_no2_m2 1.0 100.0 0 255 ECU_ADDRESS 0x0000 /end MEASUREMENT
/begin COMPU_METHOD CONV_crt_PT_0d7_Accuracy_INS_Vel_Body_no2_m2 "Linear scaling, used for variable crt_PT_0d7_Accuracy_INS_Vel_Body_no2_m2, signal Accuracy_INS_Vel_Body_no2" RAT_FUNC "%4" "" COEFFS 0 1 0 0 0 1 /end COMPU_METHOD
/* Measurement point for signal INS_Vel_Forwards_2D_no2 of frame RT_SB_INS_Vel_Body_Axes, 215 (0x0d7) */
/begin MEASUREMENT crt_PT_0d7_INS_Vel_Forwards_2D_no2_m2 "signal INS_Vel_Forwards_2D_no2 of frame RT_SB_INS_Vel_Body_Axes, 215 (0x0d7)" SLONG CONV_crt_PT_0d7_INS_Vel_Forwards_2D_no2_m2 1.0E-4 100.0 -104.0 104.0 ECU_ADDRESS 0x0000 /end MEASUREMENT
/begin COMPU_METHOD CONV_crt_PT_0d7_INS_Vel_Forwards_2D_no2_m2 "Linear scaling, used for variable crt_PT_0d7_INS_Vel_Forwards_2D_no2_m2, signal INS_Vel_Forwards_2D_no2" RAT_FUNC "%12" "m/s" COEFFS 0 1 -0.0 0 0 1.0E-4 /end COMPU_METHOD
/* Measurement point for signal Accuracy_INS_Vel_Body_no3 of frame RT_SB_INS_Vel_Body_Axes, 215 (0x0d7) */
/begin MEASUREMENT crt_PT_0d7_Accuracy_INS_Vel_Body_no3_m3 "signal Accuracy_INS_Vel_Body_no3 of frame RT_SB_INS_Vel_Body_Axes, 215 (0x0d7)" UWORD CONV_crt_PT_0d7_Accuracy_INS_Vel_Body_no3_m3 0.001 100.0 0.0 32.768 ECU_ADDRESS 0x0000 /end MEASUREMENT
/begin COMPU_METHOD CONV_crt_PT_0d7_Accuracy_INS_Vel_Body_no3_m3 "Linear scaling, used for variable crt_PT_0d7_Accuracy_INS_Vel_Body_no3_m3, signal Accuracy_INS_Vel_Body_no3" RAT_FUNC "%6" "" COEFFS 0 1 -0.0 0 0 0.001 /end COMPU_METHOD
/* Measurement point for signal INS_Vel_Forwards_2D_no3 of frame RT_SB_INS_Vel_Body_Axes, 215 (0x0d7) */
/begin MEASUREMENT crt_PT_0d7_INS_Vel_Forwards_2D_no3_m3 "signal INS_Vel_Forwards_2D_no3 of frame RT_SB_INS_Vel_Body_Axes, 215 (0x0d7)" SWORD CONV_crt_PT_0d7_INS_Vel_Forwards_2D_no3_m3 0.01 100.0 -81.92 81.91 ECU_ADDRESS 0x0000 /end MEASUREMENT
/begin COMPU_METHOD CONV_crt_PT_0d7_INS_Vel_Forwards_2D_no3_m3 "Linear scaling, used for variable crt_PT_0d7_INS_Vel_Forwards_2D_no3_m3, signal INS_Vel_Forwards_2D_no3" RAT_FUNC "%6" "m/s" COEFFS 0 1 -0.0 0 0 0.01 /end COMPU_METHOD
/* Measurement point for signal Validity_Speed of frame RT_DL1MK3_Speed, 8392740 (0x801024) */
/begin MEASUREMENT crt_PT_801024_Validity_Speed "signal Validity_Speed of frame RT_DL1MK3_Speed, 8392740 (0x801024). Valid when bit is set, invalid when bit is clear." UBYTE CONV_crt_PT_801024_Validity_Speed 1.0 100.0 0 1 ECU_ADDRESS 0x0000 /end MEASUREMENT
/begin COMPU_METHOD CONV_crt_PT_801024_Validity_Speed "Linear scaling, used for variable crt_PT_801024_Validity_Speed, signal Validity_Speed" RAT_FUNC "%1" "" COEFFS 0 1 0 0 0 1 /end COMPU_METHOD
/* Measurement point for signal Accuracy_Speed of frame RT_DL1MK3_Speed, 8392740 (0x801024) */
/begin MEASUREMENT crt_PT_801024_Accuracy_Speed "signal Accuracy_Speed of frame RT_DL1MK3_Speed, 8392740 (0x801024). Dimensionless. Lower values imply but do not guarantee better accuracy than higher values." UBYTE CONV_crt_PT_801024_Accuracy_Speed 1.0 100.0 0 255 ECU_ADDRESS 0x0000 /end MEASUREMENT
/begin COMPU_METHOD CONV_crt_PT_801024_Accuracy_Speed "Linear scaling, used for variable crt_PT_801024_Accuracy_Speed, signal Accuracy_Speed" RAT_FUNC "%4" "" COEFFS 0 1 0 0 0 1 /end COMPU_METHOD
/* Measurement point for signal Direction of frame RT_DL1MK3_Speed, 8392740 (0x801024) */
/begin MEASUREMENT crt_PT_801024_Direction "signal Direction of frame RT_DL1MK3_Speed, 8392740 (0x801024). Dimensionless. Direction of speed. 1 means forward, -1 means reverse" UBYTE CONV_crt_PT_801024_Direction 2.0 100.0 -1.0 1.0 ECU_ADDRESS 0x0000 /end MEASUREMENT
/begin COMPU_METHOD CONV_crt_PT_801024_Direction "Linear scaling, used for variable crt_PT_801024_Direction, signal Direction" RAT_FUNC "%4" "" COEFFS 0 1 --1.0 0 0 2.0 /end COMPU_METHOD
/* Measurement point for signal Speed of frame RT_DL1MK3_Speed, 8392740 (0x801024) */
/begin MEASUREMENT crt_PT_801024_Speed "signal Speed of frame RT_DL1MK3_Speed, 8392740 (0x801024)" SLONG CONV_crt_PT_801024_Speed 1.0E-5 100.0 -20000.0 20000.0 ECU_ADDRESS 0x0000 /end MEASUREMENT
/begin COMPU_METHOD CONV_crt_PT_801024_Speed "Linear scaling, used for variable crt_PT_801024_Speed, signal Speed" RAT_FUNC "%12" "m/s" COEFFS 0 1 -0.0 0 0 1.0E-5 /end COMPU_METHOD
/* Measurement point for signal Validity_GPS_Time of frame RT_DL1MK3_GPS_Time, 9175332 (0x8c0124) */
/begin MEASUREMENT crt_PT_8c0124_Validity_GPS_Time "signal Validity_GPS_Time of frame RT_DL1MK3_GPS_Time, 9175332 (0x8c0124). Valid when bit is set, invalid when bit is clear." UBYTE CONV_crt_PT_8c0124_Validity_GPS_Time 1.0 100.0 0 1 ECU_ADDRESS 0x0000 /end MEASUREMENT
/begin COMPU_METHOD CONV_crt_PT_8c0124_Validity_GPS_Time "Linear scaling, used for variable crt_PT_8c0124_Validity_GPS_Time, signal Validity_GPS_Time" RAT_FUNC "%1" "" COEFFS 0 1 0 0 0 1 /end COMPU_METHOD
/* Measurement point for signal Validity_GPS_Week of frame RT_DL1MK3_GPS_Time, 9175332 (0x8c0124) */
/begin MEASUREMENT crt_PT_8c0124_Validity_GPS_Week "signal Validity_GPS_Week of frame RT_DL1MK3_GPS_Time, 9175332 (0x8c0124). Valid when bit is set, invalid when bit is clear." UBYTE CONV_crt_PT_8c0124_Validity_GPS_Week 1.0 100.0 0 1 ECU_ADDRESS 0x0000 /end MEASUREMENT
/begin COMPU_METHOD CONV_crt_PT_8c0124_Validity_GPS_Week "Linear scaling, used for variable crt_PT_8c0124_Validity_GPS_Week, signal Validity_GPS_Week" RAT_FUNC "%1" "" COEFFS 0 1 0 0 0 1 /end COMPU_METHOD
/* Measurement point for signal Accuracy_GPS_Time of frame RT_DL1MK3_GPS_Time, 9175332 (0x8c0124) */
/begin MEASUREMENT crt_PT_8c0124_Accuracy_GPS_Time "signal Accuracy_GPS_Time of frame RT_DL1MK3_GPS_Time, 9175332 (0x8c0124)" UBYTE CONV_crt_PT_8c0124_Accuracy_GPS_Time 1.0 100.0 0 255 ECU_ADDRESS 0x0000 /end MEASUREMENT
/begin COMPU_METHOD CONV_crt_PT_8c0124_Accuracy_GPS_Time "Linear scaling, used for variable crt_PT_8c0124_Accuracy_GPS_Time, signal Accuracy_GPS_Time" RAT_FUNC "%4" "" COEFFS 0 1 0 0 0 1 /end COMPU_METHOD
/* Measurement point for signal GPS_Time of frame RT_DL1MK3_GPS_Time, 9175332 (0x8c0124) */
/begin MEASUREMENT crt_PT_8c0124_GPS_Time "signal GPS_Time of frame RT_DL1MK3_GPS_Time, 9175332 (0x8c0124). GPS time is the time in seconds since midnight GMT on Saturday night." ULONG CONV_crt_PT_8c0124_GPS_Time 0.001 100.0 0.0 604800.0 ECU_ADDRESS 0x0000 /end MEASUREMENT
/begin COMPU_METHOD CONV_crt_PT_8c0124_GPS_Time "Linear scaling, used for variable crt_PT_8c0124_GPS_Time, signal GPS_Time" RAT_FUNC "%12" "s" COEFFS 0 1 -0.0 0 0 0.001 /end COMPU_METHOD
/* Measurement point for signal GPS_Week of frame RT_DL1MK3_GPS_Time, 9175332 (0x8c0124) */
/begin MEASUREMENT crt_PT_8c0124_GPS_Week "signal GPS_Week of frame RT_DL1MK3_GPS_Time, 9175332 (0x8c0124)" UWORD CONV_crt_PT_8c0124_GPS_Week 1.0 100.0 0 65535 ECU_ADDRESS 0x0000 /end MEASUREMENT
/begin COMPU_METHOD CONV_crt_PT_8c0124_GPS_Week "Linear scaling, used for variable crt_PT_8c0124_GPS_Week, signal GPS_Week" RAT_FUNC "%6" "" COEFFS 0 1 0 0 0 1 /end COMPU_METHOD
/* Measurement point for signal GPS_Pos_LLH_Longitude of frame RT_DL1MK3_GPS_Pos_LLH_2, 9175844 (0x8c0324) */
/begin MEASUREMENT crt_PT_8c0324_GPS_Pos_LLH_Longitude "signal GPS_Pos_LLH_Longitude of frame RT_DL1MK3_GPS_Pos_LLH_2, 9175844 (0x8c0324)" SLONG CONV_crt_PT_8c0324_GPS_Pos_LLH_Longitude 1.0E-7 100.0 -180.0 180.0 ECU_ADDRESS 0x0000 /end MEASUREMENT
/begin COMPU_METHOD CONV_crt_PT_8c0324_GPS_Pos_LLH_Longitude "Linear scaling, used for variable crt_PT_8c0324_GPS_Pos_LLH_Longitude, signal GPS_Pos_LLH_Longitude" RAT_FUNC "%12" "degrees" COEFFS 0 1 -0.0 0 0 1.0E-7 /end COMPU_METHOD
/* Measurement point for signal GPS_Pos_LLH_Altitude of frame RT_DL1MK3_GPS_Pos_LLH_2, 9175844 (0x8c0324) */
/begin MEASUREMENT crt_PT_8c0324_GPS_Pos_LLH_Altitude "signal GPS_Pos_LLH_Altitude of frame RT_DL1MK3_GPS_Pos_LLH_2, 9175844 (0x8c0324)" SLONG CONV_crt_PT_8c0324_GPS_Pos_LLH_Altitude 0.001 100.0 -1000.0 100000.0 ECU_ADDRESS 0x0000 /end MEASUREMENT
/begin COMPU_METHOD CONV_crt_PT_8c0324_GPS_Pos_LLH_Altitude "Linear scaling, used for variable crt_PT_8c0324_GPS_Pos_LLH_Altitude, signal GPS_Pos_LLH_Altitude" RAT_FUNC "%12" "m" COEFFS 0 1 -0.0 0 0 0.001 /end COMPU_METHOD
/* Measurement point for signal Validity_GPS_Pos_LLH_Latitude of frame RT_DL1MK3_GPS_Pos_LLH_1, 9175588 (0x8c0224) */
/begin MEASUREMENT crt_PT_8c0224_Validity_GPS_Pos_LLH_Latitude "signal Validity_GPS_Pos_LLH_Latitude of frame RT_DL1MK3_GPS_Pos_LLH_1, 9175588 (0x8c0224). Valid when bit is set, invalid when bit is clear." UBYTE CONV_crt_PT_8c0224_Validity_GPS_Pos_LLH_Latitude 1.0 100.0 0 1 ECU_ADDRESS 0x0000 /end MEASUREMENT
/begin COMPU_METHOD CONV_crt_PT_8c0224_Validity_GPS_Pos_LLH_Latitude "Linear scaling, used for variable crt_PT_8c0224_Validity_GPS_Pos_LLH_Latitude, signal Validity_GPS_Pos_LLH_Latitude" RAT_FUNC "%1" "" COEFFS 0 1 0 0 0 1 /end COMPU_METHOD
/* Measurement point for signal Validity_GPS_Pos_LLH_Longitude of frame RT_DL1MK3_GPS_Pos_LLH_1, 9175588 (0x8c0224) */
/begin MEASUREMENT crt_PT_8c0224_Validity_GPS_Pos_LLH_Longitude "signal Validity_GPS_Pos_LLH_Longitude of frame RT_DL1MK3_GPS_Pos_LLH_1, 9175588 (0x8c0224). Valid when bit is set, invalid when bit is clear." UBYTE CONV_crt_PT_8c0224_Validity_GPS_Pos_LLH_Longitude 1.0 100.0 0 1 ECU_ADDRESS 0x0000 /end MEASUREMENT
/begin COMPU_METHOD CONV_crt_PT_8c0224_Validity_GPS_Pos_LLH_Longitude "Linear scaling, used for variable crt_PT_8c0224_Validity_GPS_Pos_LLH_Longitude, signal Validity_GPS_Pos_LLH_Longitude" RAT_FUNC "%1" "" COEFFS 0 1 0 0 0 1 /end COMPU_METHOD
/* Measurement point for signal Validity_GPS_Pos_LLH_Altitude of frame RT_DL1MK3_GPS_Pos_LLH_1, 9175588 (0x8c0224) */
/begin MEASUREMENT crt_PT_8c0224_Validity_GPS_Pos_LLH_Altitude "signal Validity_GPS_Pos_LLH_Altitude of frame RT_DL1MK3_GPS_Pos_LLH_1, 9175588 (0x8c0224). Valid when bit is set, invalid when bit is clear." UBYTE CONV_crt_PT_8c0224_Validity_GPS_Pos_LLH_Altitude 1.0 100.0 0 1 ECU_ADDRESS 0x0000 /end MEASUREMENT
/begin COMPU_METHOD CONV_crt_PT_8c0224_Validity_GPS_Pos_LLH_Altitude "Linear scaling, used for variable crt_PT_8c0224_Validity_GPS_Pos_LLH_Altitude, signal Validity_GPS_Pos_LLH_Altitude" RAT_FUNC "%1" "" COEFFS 0 1 0 0 0 1 /end COMPU_METHOD
/* Measurement point for signal Accuracy_GPS_Pos_LLH_Latitude of frame RT_DL1MK3_GPS_Pos_LLH_1, 9175588 (0x8c0224) */
/begin MEASUREMENT crt_PT_8c0224_Accuracy_GPS_Pos_LLH_Latitude "signal Accuracy_GPS_Pos_LLH_Latitude of frame RT_DL1MK3_GPS_Pos_LLH_1, 9175588 (0x8c0224). This accuracy value applies to both 2D and 3D GPS speed." UBYTE CONV_crt_PT_8c0224_Accuracy_GPS_Pos_LLH_Latitude 1.0 100.0 0 255 ECU_ADDRESS 0x0000 /end MEASUREMENT
/begin COMPU_METHOD CONV_crt_PT_8c0224_Accuracy_GPS_Pos_LLH_Latitude "Linear scaling, used for variable crt_PT_8c0224_Accuracy_GPS_Pos_LLH_Latitude, signal Accuracy_GPS_Pos_LLH_Latitude" RAT_FUNC "%4" "" COEFFS 0 1 0 0 0 1 /end COMPU_METHOD
/* Measurement point for signal Accuracy_GPS_Pos_LLH_Longitude of frame RT_DL1MK3_GPS_Pos_LLH_1, 9175588 (0x8c0224) */
/begin MEASUREMENT crt_PT_8c0224_Accuracy_GPS_Pos_LLH_Longitude "signal Accuracy_GPS_Pos_LLH_Longitude of frame RT_DL1MK3_GPS_Pos_LLH_1, 9175588 (0x8c0224). This accuracy value applies to both 2D and 3D GPS speed." UBYTE CONV_crt_PT_8c0224_Accuracy_GPS_Pos_LLH_Longitude 1.0 100.0 0 255 ECU_ADDRESS 0x0000 /end MEASUREMENT
/begin COMPU_METHOD CONV_crt_PT_8c0224_Accuracy_GPS_Pos_LLH_Longitude "Linear scaling, used for variable crt_PT_8c0224_Accuracy_GPS_Pos_LLH_Longitude, signal Accuracy_GPS_Pos_LLH_Longitude" RAT_FUNC "%4" "" COEFFS 0 1 0 0 0 1 /end COMPU_METHOD
/* Measurement point for signal Accuracy_GPS_Pos_LLH_Altitude of frame RT_DL1MK3_GPS_Pos_LLH_1, 9175588 (0x8c0224) */
/begin MEASUREMENT crt_PT_8c0224_Accuracy_GPS_Pos_LLH_Altitude "signal Accuracy_GPS_Pos_LLH_Altitude of frame RT_DL1MK3_GPS_Pos_LLH_1, 9175588 (0x8c0224). This accuracy value applies to both 2D and 3D GPS speed." UBYTE CONV_crt_PT_8c0224_Accuracy_GPS_Pos_LLH_Altitude 1.0 100.0 0 255 ECU_ADDRESS 0x0000 /end MEASUREMENT
/begin COMPU_METHOD CONV_crt_PT_8c0224_Accuracy_GPS_Pos_LLH_Altitude "Linear scaling, used for variable crt_PT_8c0224_Accuracy_GPS_Pos_LLH_Altitude, signal Accuracy_GPS_Pos_LLH_Altitude" RAT_FUNC "%4" "" COEFFS 0 1 0 0 0 1 /end COMPU_METHOD
/* Measurement point for signal GPS_Pos_LLH_Latitude of frame RT_DL1MK3_GPS_Pos_LLH_1, 9175588 (0x8c0224) */
/begin MEASUREMENT crt_PT_8c0224_GPS_Pos_LLH_Latitude "signal GPS_Pos_LLH_Latitude of frame RT_DL1MK3_GPS_Pos_LLH_1, 9175588 (0x8c0224)" SLONG CONV_crt_PT_8c0224_GPS_Pos_LLH_Latitude 1.0E-7 100.0 -90.0 90.0 ECU_ADDRESS 0x0000 /end MEASUREMENT
/begin COMPU_METHOD CONV_crt_PT_8c0224_GPS_Pos_LLH_Latitude "Linear scaling, used for variable crt_PT_8c0224_GPS_Pos_LLH_Latitude, signal GPS_Pos_LLH_Latitude" RAT_FUNC "%12" "degrees" COEFFS 0 1 -0.0 0 0 1.0E-7 /end COMPU_METHOD
/* Measurement point for signal Validity_GPS_Speed_2D of frame RT_DL1MK3_GPS_Speed, 1234 (0x4d2) */
/begin MEASUREMENT crt_PT_4d2_Validity_GPS_Speed_2D "signal Validity_GPS_Speed_2D of frame RT_DL1MK3_GPS_Speed, 1234 (0x4d2). Valid when bit is set, invalid when bit is clear." UBYTE CONV_crt_PT_4d2_Validity_GPS_Speed_2D 1.0 100.0 0 1 ECU_ADDRESS 0x0000 /end MEASUREMENT
/begin COMPU_METHOD CONV_crt_PT_4d2_Validity_GPS_Speed_2D "Linear scaling, used for variable crt_PT_4d2_Validity_GPS_Speed_2D, signal Validity_GPS_Speed_2D" RAT_FUNC "%1" "" COEFFS 0 1 0 0 0 1 /end COMPU_METHOD
/* Measurement point for signal Validity_GPS_Speed_3D of frame RT_DL1MK3_GPS_Speed, 1234 (0x4d2) */
/begin MEASUREMENT crt_PT_4d2_Validity_GPS_Speed_3D "signal Validity_GPS_Speed_3D of frame RT_DL1MK3_GPS_Speed, 1234 (0x4d2). Valid when bit is set, invalid when bit is clear." UBYTE CONV_crt_PT_4d2_Validity_GPS_Speed_3D 1.0 100.0 0 1 ECU_ADDRESS 0x0000 /end MEASUREMENT
/begin COMPU_METHOD CONV_crt_PT_4d2_Validity_GPS_Speed_3D "Linear scaling, used for variable crt_PT_4d2_Validity_GPS_Speed_3D, signal Validity_GPS_Speed_3D" RAT_FUNC "%1" "" COEFFS 0 1 0 0 0 1 /end COMPU_METHOD
/* Measurement point for signal Accuracy_GPS_Speed of frame RT_DL1MK3_GPS_Speed, 1234 (0x4d2) */
/begin MEASUREMENT crt_PT_4d2_Accuracy_GPS_Speed "signal Accuracy_GPS_Speed of frame RT_DL1MK3_GPS_Speed, 1234 (0x4d2). This accuracy value applies to both 2D and 3D GPS speed." UBYTE CONV_crt_PT_4d2_Accuracy_GPS_Speed 1.0 100.0 0 255 ECU_ADDRESS 0x0000 /end MEASUREMENT
/begin COMPU_METHOD CONV_crt_PT_4d2_Accuracy_GPS_Speed "Linear scaling, used for variable crt_PT_4d2_Accuracy_GPS_Speed, signal Accuracy_GPS_Speed" RAT_FUNC "%4" "" COEFFS 0 1 0 0 0 1 /end COMPU_METHOD
/* Measurement point for signal GPS_Speed_2D of frame RT_DL1MK3_GPS_Speed, 1234 (0x4d2) */
/begin MEASUREMENT crt_PT_4d2_GPS_Speed_2D "signal GPS_Speed_2D of frame RT_DL1MK3_GPS_Speed, 1234 (0x4d2). This is GPS scalar 2D speed - scalar speed with no local Z axis component included." ULONG CONV_crt_PT_4d2_GPS_Speed_2D 1.0E-4 100.0 0.0 1675.0 ECU_ADDRESS 0x0000 /end MEASUREMENT
/begin COMPU_METHOD CONV_crt_PT_4d2_GPS_Speed_2D "Linear scaling, used for variable crt_PT_4d2_GPS_Speed_2D, signal GPS_Speed_2D" RAT_FUNC "%12" "m/s" COEFFS 0 1 -0.0 0 0 1.0E-4 /end COMPU_METHOD
/* Measurement point for signal GPS_Speed_3D of frame RT_DL1MK3_GPS_Speed, 1234 (0x4d2) */
/begin MEASUREMENT crt_PT_4d2_GPS_Speed_3D "signal GPS_Speed_3D of frame RT_DL1MK3_GPS_Speed, 1234 (0x4d2). This is GPS scalar 3D speed - scalar speed with the local Z axis component included." ULONG CONV_crt_PT_4d2_GPS_Speed_3D 1.0E-4 100.0 0.0 1675.0 ECU_ADDRESS 0x0000 /end MEASUREMENT
/begin COMPU_METHOD CONV_crt_PT_4d2_GPS_Speed_3D "Linear scaling, used for variable crt_PT_4d2_GPS_Speed_3D, signal GPS_Speed_3D" RAT_FUNC "%12" "m/s" COEFFS 0 1 -0.0 0 0 1.0E-4 /end COMPU_METHOD
/* Measurement point for signal IR_Temperature_7 of frame RT_IRTemp_Temp_7, 9504549 (0x910725) */
/begin MEASUREMENT crt_PT_910725_IR_Temperature_7 "signal IR_Temperature_7 of frame RT_IRTemp_Temp_7, 9504549 (0x910725)" SWORD CONV_crt_PT_910725_IR_Temperature_7 0.1 100.0 0.0 0.0 ECU_ADDRESS 0x0000 /end MEASUREMENT
/begin COMPU_METHOD CONV_crt_PT_910725_IR_Temperature_7 "Linear scaling, used for variable crt_PT_910725_IR_Temperature_7, signal IR_Temperature_7" RAT_FUNC "%6" "" COEFFS 0 1 -0.0 0 0 0.1 /end COMPU_METHOD
/* Measurement point for signal IR_Temperature_29 of frame RT_IRTemp_Temp_RR_2, 9963557 (0x980825) */
/begin MEASUREMENT crt_PT_980825_IR_Temperature_29 "signal IR_Temperature_29 of frame RT_IRTemp_Temp_RR_2, 9963557 (0x980825)" SWORD CONV_crt_PT_980825_IR_Temperature_29 0.1 100.0 0.0 0.0 ECU_ADDRESS 0x0000 /end MEASUREMENT
/begin COMPU_METHOD CONV_crt_PT_980825_IR_Temperature_29 "Linear scaling, used for variable crt_PT_980825_IR_Temperature_29, signal IR_Temperature_29" RAT_FUNC "%6" "" COEFFS 0 1 -0.0 0 0 0.1 /end COMPU_METHOD
/* Measurement point for signal IR_Temperature_30 of frame RT_IRTemp_Temp_RR_2, 9963557 (0x980825) */
/begin MEASUREMENT crt_PT_980825_IR_Temperature_30 "signal IR_Temperature_30 of frame RT_IRTemp_Temp_RR_2, 9963557 (0x980825)" SWORD CONV_crt_PT_980825_IR_Temperature_30 0.1 100.0 0.0 0.0 ECU_ADDRESS 0x0000 /end MEASUREMENT
/begin COMPU_METHOD CONV_crt_PT_980825_IR_Temperature_30 "Linear scaling, used for variable crt_PT_980825_IR_Temperature_30, signal IR_Temperature_30" RAT_FUNC "%6" "" COEFFS 0 1 -0.0 0 0 0.1 /end COMPU_METHOD
/* Measurement point for signal IR_Temperature_31 of frame RT_IRTemp_Temp_RR_2, 9963557 (0x980825) */
/begin MEASUREMENT crt_PT_980825_IR_Temperature_31 "signal IR_Temperature_31 of frame RT_IRTemp_Temp_RR_2, 9963557 (0x980825)" SWORD CONV_crt_PT_980825_IR_Temperature_31 0.1 100.0 0.0 0.0 ECU_ADDRESS 0x0000 /end MEASUREMENT
/begin COMPU_METHOD CONV_crt_PT_980825_IR_Temperature_31 "Linear scaling, used for variable crt_PT_980825_IR_Temperature_31, signal IR_Temperature_31" RAT_FUNC "%6" "" COEFFS 0 1 -0.0 0 0 0.1 /end COMPU_METHOD
/* Measurement point for signal IR_Temperature_32 of frame RT_IRTemp_Temp_RR_2, 9963557 (0x980825) */
/begin MEASUREMENT crt_PT_980825_IR_Temperature_32 "signal IR_Temperature_32 of frame RT_IRTemp_Temp_RR_2, 9963557 (0x980825)" SWORD CONV_crt_PT_980825_IR_Temperature_32 0.1 100.0 0.0 0.0 ECU_ADDRESS 0x0000 /end MEASUREMENT
/begin COMPU_METHOD CONV_crt_PT_980825_IR_Temperature_32 "Linear scaling, used for variable crt_PT_980825_IR_Temperature_32, signal IR_Temperature_32" RAT_FUNC "%6" "" COEFFS 0 1 -0.0 0 0 0.1 /end COMPU_METHOD
/* Measurement point for signal IR_Temperature_21 of frame RT_IRTemp_Temp_RL_2, 9963045 (0x980625) */
/begin MEASUREMENT crt_PT_980625_IR_Temperature_21 "signal IR_Temperature_21 of frame RT_IRTemp_Temp_RL_2, 9963045 (0x980625)" SWORD CONV_crt_PT_980625_IR_Temperature_21 0.1 100.0 0.0 0.0 ECU_ADDRESS 0x0000 /end MEASUREMENT
/begin COMPU_METHOD CONV_crt_PT_980625_IR_Temperature_21 "Linear scaling, used for variable crt_PT_980625_IR_Temperature_21, signal IR_Temperature_21" RAT_FUNC "%6" "" COEFFS 0 1 -0.0 0 0 0.1 /end COMPU_METHOD
/* Measurement point for signal IR_Temperature_22 of frame RT_IRTemp_Temp_RL_2, 9963045 (0x980625) */
/begin MEASUREMENT crt_PT_980625_IR_Temperature_22 "signal IR_Temperature_22 of frame RT_IRTemp_Temp_RL_2, 9963045 (0x980625)" SWORD CONV_crt_PT_980625_IR_Temperature_22 0.1 100.0 0.0 0.0 ECU_ADDRESS 0x0000 /end MEASUREMENT
/begin COMPU_METHOD CONV_crt_PT_980625_IR_Temperature_22 "Linear scaling, used for variable crt_PT_980625_IR_Temperature_22, signal IR_Temperature_22" RAT_FUNC "%6" "" COEFFS 0 1 -0.0 0 0 0.1 /end COMPU_METHOD
/* Measurement point for signal IR_Temperature_23 of frame RT_IRTemp_Temp_RL_2, 9963045 (0x980625) */
/begin MEASUREMENT crt_PT_980625_IR_Temperature_23 "signal IR_Temperature_23 of frame RT_IRTemp_Temp_RL_2, 9963045 (0x980625)" SWORD CONV_crt_PT_980625_IR_Temperature_23 0.1 100.0 0.0 0.0 ECU_ADDRESS 0x0000 /end MEASUREMENT
/begin COMPU_METHOD CONV_crt_PT_980625_IR_Temperature_23 "Linear scaling, used for variable crt_PT_980625_IR_Temperature_23, signal IR_Temperature_23" RAT_FUNC "%6" "" COEFFS 0 1 -0.0 0 0 0.1 /end COMPU_METHOD
/* Measurement point for signal IR_Temperature_24 of frame RT_IRTemp_Temp_RL_2, 9963045 (0x980625) */
/begin MEASUREMENT crt_PT_980625_IR_Temperature_24 "signal IR_Temperature_24 of frame RT_IRTemp_Temp_RL_2, 9963045 (0x980625)" SWORD CONV_crt_PT_980625_IR_Temperature_24 0.1 100.0 0.0 0.0 ECU_ADDRESS 0x0000 /end MEASUREMENT
/begin COMPU_METHOD CONV_crt_PT_980625_IR_Temperature_24 "Linear scaling, used for variable crt_PT_980625_IR_Temperature_24, signal IR_Temperature_24" RAT_FUNC "%6" "" COEFFS 0 1 -0.0 0 0 0.1 /end COMPU_METHOD
/* Measurement point for signal IR_Temperature_13 of frame RT_IRTemp_Temp_FR_2, 9962533 (0x980425) */
/begin MEASUREMENT crt_PT_980425_IR_Temperature_13 "signal IR_Temperature_13 of frame RT_IRTemp_Temp_FR_2, 9962533 (0x980425)" SWORD CONV_crt_PT_980425_IR_Temperature_13 0.1 100.0 0.0 0.0 ECU_ADDRESS 0x0000 /end MEASUREMENT
/begin COMPU_METHOD CONV_crt_PT_980425_IR_Temperature_13 "Linear scaling, used for variable crt_PT_980425_IR_Temperature_13, signal IR_Temperature_13" RAT_FUNC "%6" "" COEFFS 0 1 -0.0 0 0 0.1 /end COMPU_METHOD
/* Measurement point for signal IR_Temperature_14 of frame RT_IRTemp_Temp_FR_2, 9962533 (0x980425) */
/begin MEASUREMENT crt_PT_980425_IR_Temperature_14 "signal IR_Temperature_14 of frame RT_IRTemp_Temp_FR_2, 9962533 (0x980425)" SWORD CONV_crt_PT_980425_IR_Temperature_14 0.1 100.0 0.0 0.0 ECU_ADDRESS 0x0000 /end MEASUREMENT
/begin COMPU_METHOD CONV_crt_PT_980425_IR_Temperature_14 "Linear scaling, used for variable crt_PT_980425_IR_Temperature_14, signal IR_Temperature_14" RAT_FUNC "%6" "" COEFFS 0 1 -0.0 0 0 0.1 /end COMPU_METHOD
/* Measurement point for signal IR_Temperature_15 of frame RT_IRTemp_Temp_FR_2, 9962533 (0x980425) */
/begin MEASUREMENT crt_PT_980425_IR_Temperature_15 "signal IR_Temperature_15 of frame RT_IRTemp_Temp_FR_2, 9962533 (0x980425)" SWORD CONV_crt_PT_980425_IR_Temperature_15 0.1 100.0 0.0 0.0 ECU_ADDRESS 0x0000 /end MEASUREMENT
/begin COMPU_METHOD CONV_crt_PT_980425_IR_Temperature_15 "Linear scaling, used for variable crt_PT_980425_IR_Temperature_15, signal IR_Temperature_15" RAT_FUNC "%6" "" COEFFS 0 1 -0.0 0 0 0.1 /end COMPU_METHOD
/* Measurement point for signal IR_Temperature_16 of frame RT_IRTemp_Temp_FR_2, 9962533 (0x980425) */
/begin MEASUREMENT crt_PT_980425_IR_Temperature_16 "signal IR_Temperature_16 of frame RT_IRTemp_Temp_FR_2, 9962533 (0x980425)" SWORD CONV_crt_PT_980425_IR_Temperature_16 0.1 100.0 0.0 0.0 ECU_ADDRESS 0x0000 /end MEASUREMENT
/begin COMPU_METHOD CONV_crt_PT_980425_IR_Temperature_16 "Linear scaling, used for variable crt_PT_980425_IR_Temperature_16, signal IR_Temperature_16" RAT_FUNC "%6" "" COEFFS 0 1 -0.0 0 0 0.1 /end COMPU_METHOD
/* Measurement point for signal IR_Temperature_5 of frame RT_IRTemp_Temp_FL_2, 9962021 (0x980225) */
/begin MEASUREMENT crt_PT_980225_IR_Temperature_5 "signal IR_Temperature_5 of frame RT_IRTemp_Temp_FL_2, 9962021 (0x980225)" SWORD CONV_crt_PT_980225_IR_Temperature_5 0.1 100.0 0.0 0.0 ECU_ADDRESS 0x0000 /end MEASUREMENT
/begin COMPU_METHOD CONV_crt_PT_980225_IR_Temperature_5 "Linear scaling, used for variable crt_PT_980225_IR_Temperature_5, signal IR_Temperature_5" RAT_FUNC "%6" "" COEFFS 0 1 -0.0 0 0 0.1 /end COMPU_METHOD
/* Measurement point for signal IR_Temperature_6 of frame RT_IRTemp_Temp_FL_2, 9962021 (0x980225) */
/begin MEASUREMENT crt_PT_980225_IR_Temperature_6 "signal IR_Temperature_6 of frame RT_IRTemp_Temp_FL_2, 9962021 (0x980225)" SWORD CONV_crt_PT_980225_IR_Temperature_6 0.1 100.0 0.0 0.0 ECU_ADDRESS 0x0000 /end MEASUREMENT
/begin COMPU_METHOD CONV_crt_PT_980225_IR_Temperature_6 "Linear scaling, used for variable crt_PT_980225_IR_Temperature_6, signal IR_Temperature_6" RAT_FUNC "%6" "" COEFFS 0 1 -0.0 0 0 0.1 /end COMPU_METHOD
/* Measurement point for signal IR_Temperature_7 of frame RT_IRTemp_Temp_FL_2, 9962021 (0x980225) */
/begin MEASUREMENT crt_PT_980225_IR_Temperature_7 "signal IR_Temperature_7 of frame RT_IRTemp_Temp_FL_2, 9962021 (0x980225)" SWORD CONV_crt_PT_980225_IR_Temperature_7 0.1 100.0 0.0 0.0 ECU_ADDRESS 0x0000 /end MEASUREMENT
/begin COMPU_METHOD CONV_crt_PT_980225_IR_Temperature_7 "Linear scaling, used for variable crt_PT_980225_IR_Temperature_7, signal IR_Temperature_7" RAT_FUNC "%6" "" COEFFS 0 1 -0.0 0 0 0.1 /end COMPU_METHOD
/* Measurement point for signal IR_Temperature_8 of frame RT_IRTemp_Temp_FL_2, 9962021 (0x980225) */
/begin MEASUREMENT crt_PT_980225_IR_Temperature_8 "signal IR_Temperature_8 of frame RT_IRTemp_Temp_FL_2, 9962021 (0x980225)" SWORD CONV_crt_PT_980225_IR_Temperature_8 0.1 100.0 0.0 0.0 ECU_ADDRESS 0x0000 /end MEASUREMENT
/begin COMPU_METHOD CONV_crt_PT_980225_IR_Temperature_8 "Linear scaling, used for variable crt_PT_980225_IR_Temperature_8, signal IR_Temperature_8" RAT_FUNC "%6" "" COEFFS 0 1 -0.0 0 0 0.1 /end COMPU_METHOD
/* Measurement point for signal IR_Temperature_25 of frame RT_IRTemp_Temp_RR_1, 9963301 (0x980725) */
/begin MEASUREMENT crt_PT_980725_IR_Temperature_25 "signal IR_Temperature_25 of frame RT_IRTemp_Temp_RR_1, 9963301 (0x980725)" SWORD CONV_crt_PT_980725_IR_Temperature_25 0.1 100.0 0.0 0.0 ECU_ADDRESS 0x0000 /end MEASUREMENT
/begin COMPU_METHOD CONV_crt_PT_980725_IR_Temperature_25 "Linear scaling, used for variable crt_PT_980725_IR_Temperature_25, signal IR_Temperature_25" RAT_FUNC "%6" "" COEFFS 0 1 -0.0 0 0 0.1 /end COMPU_METHOD
/* Measurement point for signal IR_Temperature_26 of frame RT_IRTemp_Temp_RR_1, 9963301 (0x980725) */
/begin MEASUREMENT crt_PT_980725_IR_Temperature_26 "signal IR_Temperature_26 of frame RT_IRTemp_Temp_RR_1, 9963301 (0x980725)" SWORD CONV_crt_PT_980725_IR_Temperature_26 0.1 100.0 0.0 0.0 ECU_ADDRESS 0x0000 /end MEASUREMENT
/begin COMPU_METHOD CONV_crt_PT_980725_IR_Temperature_26 "Linear scaling, used for variable crt_PT_980725_IR_Temperature_26, signal IR_Temperature_26" RAT_FUNC "%6" "" COEFFS 0 1 -0.0 0 0 0.1 /end COMPU_METHOD
/* Measurement point for signal IR_Temperature_27 of frame RT_IRTemp_Temp_RR_1, 9963301 (0x980725) */
/begin MEASUREMENT crt_PT_980725_IR_Temperature_27 "signal IR_Temperature_27 of frame RT_IRTemp_Temp_RR_1, 9963301 (0x980725)" SWORD CONV_crt_PT_980725_IR_Temperature_27 0.1 100.0 0.0 0.0 ECU_ADDRESS 0x0000 /end MEASUREMENT
/begin COMPU_METHOD CONV_crt_PT_980725_IR_Temperature_27 "Linear scaling, used for variable crt_PT_980725_IR_Temperature_27, signal IR_Temperature_27" RAT_FUNC "%6" "" COEFFS 0 1 -0.0 0 0 0.1 /end COMPU_METHOD
/* Measurement point for signal IR_Temperature_28 of frame RT_IRTemp_Temp_RR_1, 9963301 (0x980725) */
/begin MEASUREMENT crt_PT_980725_IR_Temperature_28 "signal IR_Temperature_28 of frame RT_IRTemp_Temp_RR_1, 9963301 (0x980725)" SWORD CONV_crt_PT_980725_IR_Temperature_28 0.1 100.0 0.0 0.0 ECU_ADDRESS 0x0000 /end MEASUREMENT
/begin COMPU_METHOD CONV_crt_PT_980725_IR_Temperature_28 "Linear scaling, used for variable crt_PT_980725_IR_Temperature_28, signal IR_Temperature_28" RAT_FUNC "%6" "" COEFFS 0 1 -0.0 0 0 0.1 /end COMPU_METHOD
/* Measurement point for signal IR_Temperature_17 of frame RT_IRTemp_Temp_RL_1, 9962789 (0x980525) */
/begin MEASUREMENT crt_PT_980525_IR_Temperature_17 "signal IR_Temperature_17 of frame RT_IRTemp_Temp_RL_1, 9962789 (0x980525)" SWORD CONV_crt_PT_980525_IR_Temperature_17 0.1 100.0 0.0 0.0 ECU_ADDRESS 0x0000 /end MEASUREMENT
/begin COMPU_METHOD CONV_crt_PT_980525_IR_Temperature_17 "Linear scaling, used for variable crt_PT_980525_IR_Temperature_17, signal IR_Temperature_17" RAT_FUNC "%6" "" COEFFS 0 1 -0.0 0 0 0.1 /end COMPU_METHOD
/* Measurement point for signal IR_Temperature_18 of frame RT_IRTemp_Temp_RL_1, 9962789 (0x980525) */
/begin MEASUREMENT crt_PT_980525_IR_Temperature_18 "signal IR_Temperature_18 of frame RT_IRTemp_Temp_RL_1, 9962789 (0x980525)" SWORD CONV_crt_PT_980525_IR_Temperature_18 0.1 100.0 0.0 0.0 ECU_ADDRESS 0x0000 /end MEASUREMENT
/begin COMPU_METHOD CONV_crt_PT_980525_IR_Temperature_18 "Linear scaling, used for variable crt_PT_980525_IR_Temperature_18, signal IR_Temperature_18" RAT_FUNC "%6" "" COEFFS 0 1 -0.0 0 0 0.1 /end COMPU_METHOD
/* Measurement point for signal IR_Temperature_19 of frame RT_IRTemp_Temp_RL_1, 9962789 (0x980525) */
/begin MEASUREMENT crt_PT_980525_IR_Temperature_19 "signal IR_Temperature_19 of frame RT_IRTemp_Temp_RL_1, 9962789 (0x980525)" SWORD CONV_crt_PT_980525_IR_Temperature_19 0.1 100.0 0.0 0.0 ECU_ADDRESS 0x0000 /end MEASUREMENT
/begin COMPU_METHOD CONV_crt_PT_980525_IR_Temperature_19 "Linear scaling, used for variable crt_PT_980525_IR_Temperature_19, signal IR_Temperature_19" RAT_FUNC "%6" "" COEFFS 0 1 -0.0 0 0 0.1 /end COMPU_METHOD
/* Measurement point for signal IR_Temperature_20 of frame RT_IRTemp_Temp_RL_1, 9962789 (0x980525) */
/begin MEASUREMENT crt_PT_980525_IR_Temperature_20 "signal IR_Temperature_20 of frame RT_IRTemp_Temp_RL_1, 9962789 (0x980525)" SWORD CONV_crt_PT_980525_IR_Temperature_20 0.1 100.0 0.0 0.0 ECU_ADDRESS 0x0000 /end MEASUREMENT
/begin COMPU_METHOD CONV_crt_PT_980525_IR_Temperature_20 "Linear scaling, used for variable crt_PT_980525_IR_Temperature_20, signal IR_Temperature_20" RAT_FUNC "%6" "" COEFFS 0 1 -0.0 0 0 0.1 /end COMPU_METHOD
/* Measurement point for signal IR_Temperature_9 of frame RT_IRTemp_Temp_FR_1, 9962277 (0x980325) */
/begin MEASUREMENT crt_PT_980325_IR_Temperature_9 "signal IR_Temperature_9 of frame RT_IRTemp_Temp_FR_1, 9962277 (0x980325)" SWORD CONV_crt_PT_980325_IR_Temperature_9 0.1 100.0 0.0 0.0 ECU_ADDRESS 0x0000 /end MEASUREMENT
/begin COMPU_METHOD CONV_crt_PT_980325_IR_Temperature_9 "Linear scaling, used for variable crt_PT_980325_IR_Temperature_9, signal IR_Temperature_9" RAT_FUNC "%6" "" COEFFS 0 1 -0.0 0 0 0.1 /end COMPU_METHOD
/* Measurement point for signal IR_Temperature_10 of frame RT_IRTemp_Temp_FR_1, 9962277 (0x980325) */
/begin MEASUREMENT crt_PT_980325_IR_Temperature_10 "signal IR_Temperature_10 of frame RT_IRTemp_Temp_FR_1, 9962277 (0x980325)" SWORD CONV_crt_PT_980325_IR_Temperature_10 0.1 100.0 0.0 0.0 ECU_ADDRESS 0x0000 /end MEASUREMENT
/begin COMPU_METHOD CONV_crt_PT_980325_IR_Temperature_10 "Linear scaling, used for variable crt_PT_980325_IR_Temperature_10, signal IR_Temperature_10" RAT_FUNC "%6" "" COEFFS 0 1 -0.0 0 0 0.1 /end COMPU_METHOD
/* Measurement point for signal IR_Temperature_11 of frame RT_IRTemp_Temp_FR_1, 9962277 (0x980325) */
/begin MEASUREMENT crt_PT_980325_IR_Temperature_11 "signal IR_Temperature_11 of frame RT_IRTemp_Temp_FR_1, 9962277 (0x980325)" SWORD CONV_crt_PT_980325_IR_Temperature_11 0.1 100.0 0.0 0.0 ECU_ADDRESS 0x0000 /end MEASUREMENT
/begin COMPU_METHOD CONV_crt_PT_980325_IR_Temperature_11 "Linear scaling, used for variable crt_PT_980325_IR_Temperature_11, signal IR_Temperature_11" RAT_FUNC "%6" "" COEFFS 0 1 -0.0 0 0 0.1 /end COMPU_METHOD
/* Measurement point for signal IR_Temperature_12 of frame RT_IRTemp_Temp_FR_1, 9962277 (0x980325) */
/begin MEASUREMENT crt_PT_980325_IR_Temperature_12 "signal IR_Temperature_12 of frame RT_IRTemp_Temp_FR_1, 9962277 (0x980325)" SWORD CONV_crt_PT_980325_IR_Temperature_12 0.1 100.0 0.0 0.0 ECU_ADDRESS 0x0000 /end MEASUREMENT
/begin COMPU_METHOD CONV_crt_PT_980325_IR_Temperature_12 "Linear scaling, used for variable crt_PT_980325_IR_Temperature_12, signal IR_Temperature_12" RAT_FUNC "%6" "" COEFFS 0 1 -0.0 0 0 0.1 /end COMPU_METHOD
/* Measurement point for signal IR_Temperature_1 of frame RT_IRTemp_Temp_FL_1, 9961765 (0x980125) */
/begin MEASUREMENT crt_PT_980125_IR_Temperature_1 "signal IR_Temperature_1 of frame RT_IRTemp_Temp_FL_1, 9961765 (0x980125)" SWORD CONV_crt_PT_980125_IR_Temperature_1 0.1 100.0 0.0 0.0 ECU_ADDRESS 0x0000 /end MEASUREMENT
/begin COMPU_METHOD CONV_crt_PT_980125_IR_Temperature_1 "Linear scaling, used for variable crt_PT_980125_IR_Temperature_1, signal IR_Temperature_1" RAT_FUNC "%6" "" COEFFS 0 1 -0.0 0 0 0.1 /end COMPU_METHOD
/* Measurement point for signal IR_Temperature_2 of frame RT_IRTemp_Temp_FL_1, 9961765 (0x980125) */
/begin MEASUREMENT crt_PT_980125_IR_Temperature_2 "signal IR_Temperature_2 of frame RT_IRTemp_Temp_FL_1, 9961765 (0x980125)" SWORD CONV_crt_PT_980125_IR_Temperature_2 0.1 100.0 0.0 0.0 ECU_ADDRESS 0x0000 /end MEASUREMENT
/begin COMPU_METHOD CONV_crt_PT_980125_IR_Temperature_2 "Linear scaling, used for variable crt_PT_980125_IR_Temperature_2, signal IR_Temperature_2" RAT_FUNC "%6" "" COEFFS 0 1 -0.0 0 0 0.1 /end COMPU_METHOD
/* Measurement point for signal IR_Temperature_3 of frame RT_IRTemp_Temp_FL_1, 9961765 (0x980125) */
/begin MEASUREMENT crt_PT_980125_IR_Temperature_3 "signal IR_Temperature_3 of frame RT_IRTemp_Temp_FL_1, 9961765 (0x980125)" SWORD CONV_crt_PT_980125_IR_Temperature_3 0.1 100.0 0.0 0.0 ECU_ADDRESS 0x0000 /end MEASUREMENT
/begin COMPU_METHOD CONV_crt_PT_980125_IR_Temperature_3 "Linear scaling, used for variable crt_PT_980125_IR_Temperature_3, signal IR_Temperature_3" RAT_FUNC "%6" "" COEFFS 0 1 -0.0 0 0 0.1 /end COMPU_METHOD
/* Measurement point for signal IR_Temperature_4 of frame RT_IRTemp_Temp_FL_1, 9961765 (0x980125) */
/begin MEASUREMENT crt_PT_980125_IR_Temperature_4 "signal IR_Temperature_4 of frame RT_IRTemp_Temp_FL_1, 9961765 (0x980125)" SWORD CONV_crt_PT_980125_IR_Temperature_4 0.1 100.0 0.0 0.0 ECU_ADDRESS 0x0000 /end MEASUREMENT
/begin COMPU_METHOD CONV_crt_PT_980125_IR_Temperature_4 "Linear scaling, used for variable crt_PT_980125_IR_Temperature_4, signal IR_Temperature_4" RAT_FUNC "%6" "" COEFFS 0 1 -0.0 0 0 0.1 /end COMPU_METHOD
/* Measurement point for signal IR_Temperature_32 of frame RT_IRTemp_Temp_32, 9510949 (0x912025) */
/begin MEASUREMENT crt_PT_912025_IR_Temperature_32 "signal IR_Temperature_32 of frame RT_IRTemp_Temp_32, 9510949 (0x912025)" SWORD CONV_crt_PT_912025_IR_Temperature_32 0.1 100.0 0.0 0.0 ECU_ADDRESS 0x0000 /end MEASUREMENT
/begin COMPU_METHOD CONV_crt_PT_912025_IR_Temperature_32 "Linear scaling, used for variable crt_PT_912025_IR_Temperature_32, signal IR_Temperature_32" RAT_FUNC "%6" "" COEFFS 0 1 -0.0 0 0 0.1 /end COMPU_METHOD
/* Measurement point for signal IR_Temperature_31 of frame RT_IRTemp_Temp_31, 9510693 (0x911f25) */
/begin MEASUREMENT crt_PT_911f25_IR_Temperature_31 "signal IR_Temperature_31 of frame RT_IRTemp_Temp_31, 9510693 (0x911f25)" SWORD CONV_crt_PT_911f25_IR_Temperature_31 0.1 100.0 0.0 0.0 ECU_ADDRESS 0x0000 /end MEASUREMENT
/begin COMPU_METHOD CONV_crt_PT_911f25_IR_Temperature_31 "Linear scaling, used for variable crt_PT_911f25_IR_Temperature_31, signal IR_Temperature_31" RAT_FUNC "%6" "" COEFFS 0 1 -0.0 0 0 0.1 /end COMPU_METHOD
/* Measurement point for signal IR_Temperature_30 of frame RT_IRTemp_Temp_30, 9510437 (0x911e25) */
/begin MEASUREMENT crt_PT_911e25_IR_Temperature_30 "signal IR_Temperature_30 of frame RT_IRTemp_Temp_30, 9510437 (0x911e25)" SWORD CONV_crt_PT_911e25_IR_Temperature_30 0.1 100.0 0.0 0.0 ECU_ADDRESS 0x0000 /end MEASUREMENT
/begin COMPU_METHOD CONV_crt_PT_911e25_IR_Temperature_30 "Linear scaling, used for variable crt_PT_911e25_IR_Temperature_30, signal IR_Temperature_30" RAT_FUNC "%6" "" COEFFS 0 1 -0.0 0 0 0.1 /end COMPU_METHOD
/* Measurement point for signal IR_Temperature_29 of frame RT_IRTemp_Temp_29, 9510181 (0x911d25) */
/begin MEASUREMENT crt_PT_911d25_IR_Temperature_29 "signal IR_Temperature_29 of frame RT_IRTemp_Temp_29, 9510181 (0x911d25)" SWORD CONV_crt_PT_911d25_IR_Temperature_29 0.1 100.0 0.0 0.0 ECU_ADDRESS 0x0000 /end MEASUREMENT
/begin COMPU_METHOD CONV_crt_PT_911d25_IR_Temperature_29 "Linear scaling, used for variable crt_PT_911d25_IR_Temperature_29, signal IR_Temperature_29" RAT_FUNC "%6" "" COEFFS 0 1 -0.0 0 0 0.1 /end COMPU_METHOD
/* Measurement point for signal IR_Temperature_28 of frame RT_IRTemp_Temp_28, 9509925 (0x911c25) */
/begin MEASUREMENT crt_PT_911c25_IR_Temperature_28 "signal IR_Temperature_28 of frame RT_IRTemp_Temp_28, 9509925 (0x911c25)" SWORD CONV_crt_PT_911c25_IR_Temperature_28 0.1 100.0 0.0 0.0 ECU_ADDRESS 0x0000 /end MEASUREMENT
/begin COMPU_METHOD CONV_crt_PT_911c25_IR_Temperature_28 "Linear scaling, used for variable crt_PT_911c25_IR_Temperature_28, signal IR_Temperature_28" RAT_FUNC "%6" "" COEFFS 0 1 -0.0 0 0 0.1 /end COMPU_METHOD
/* Measurement point for signal IR_Temperature_27 of frame RT_IRTemp_Temp_27, 9509669 (0x911b25) */
/begin MEASUREMENT crt_PT_911b25_IR_Temperature_27 "signal IR_Temperature_27 of frame RT_IRTemp_Temp_27, 9509669 (0x911b25)" SWORD CONV_crt_PT_911b25_IR_Temperature_27 0.1 100.0 0.0 0.0 ECU_ADDRESS 0x0000 /end MEASUREMENT
/begin COMPU_METHOD CONV_crt_PT_911b25_IR_Temperature_27 "Linear scaling, used for variable crt_PT_911b25_IR_Temperature_27, signal IR_Temperature_27" RAT_FUNC "%6" "" COEFFS 0 1 -0.0 0 0 0.1 /end COMPU_METHOD
/* Measurement point for signal IR_Temperature_26 of frame RT_IRTemp_Temp_26, 9509413 (0x911a25) */
/begin MEASUREMENT crt_PT_911a25_IR_Temperature_26 "signal IR_Temperature_26 of frame RT_IRTemp_Temp_26, 9509413 (0x911a25)" SWORD CONV_crt_PT_911a25_IR_Temperature_26 0.1 100.0 0.0 0.0 ECU_ADDRESS 0x0000 /end MEASUREMENT
/begin COMPU_METHOD CONV_crt_PT_911a25_IR_Temperature_26 "Linear scaling, used for variable crt_PT_911a25_IR_Temperature_26, signal IR_Temperature_26" RAT_FUNC "%6" "" COEFFS 0 1 -0.0 0 0 0.1 /end COMPU_METHOD
/* Measurement point for signal IR_Temperature_25 of frame RT_IRTemp_Temp_25, 9509157 (0x911925) */
/begin MEASUREMENT crt_PT_911925_IR_Temperature_25 "signal IR_Temperature_25 of frame RT_IRTemp_Temp_25, 9509157 (0x911925)" SWORD CONV_crt_PT_911925_IR_Temperature_25 0.1 100.0 0.0 0.0 ECU_ADDRESS 0x0000 /end MEASUREMENT
/begin COMPU_METHOD CONV_crt_PT_911925_IR_Temperature_25 "Linear scaling, used for variable crt_PT_911925_IR_Temperature_25, signal IR_Temperature_25" RAT_FUNC "%6" "" COEFFS 0 1 -0.0 0 0 0.1 /end COMPU_METHOD
/* Measurement point for signal IR_Temperature_24 of frame RT_IRTemp_Temp_24, 9508901 (0x911825) */
/begin MEASUREMENT crt_PT_911825_IR_Temperature_24 "signal IR_Temperature_24 of frame RT_IRTemp_Temp_24, 9508901 (0x911825)" SWORD CONV_crt_PT_911825_IR_Temperature_24 0.1 100.0 0.0 0.0 ECU_ADDRESS 0x0000 /end MEASUREMENT
/begin COMPU_METHOD CONV_crt_PT_911825_IR_Temperature_24 "Linear scaling, used for variable crt_PT_911825_IR_Temperature_24, signal IR_Temperature_24" RAT_FUNC "%6" "" COEFFS 0 1 -0.0 0 0 0.1 /end COMPU_METHOD
/* Measurement point for signal IR_Temperature_22 of frame RT_IRTemp_Temp_22, 9508389 (0x911625) */
/begin MEASUREMENT crt_PT_911625_IR_Temperature_22 "signal IR_Temperature_22 of frame RT_IRTemp_Temp_22, 9508389 (0x911625)" SWORD CONV_crt_PT_911625_IR_Temperature_22 0.1 100.0 0.0 0.0 ECU_ADDRESS 0x0000 /end MEASUREMENT
/begin COMPU_METHOD CONV_crt_PT_911625_IR_Temperature_22 "Linear scaling, used for variable crt_PT_911625_IR_Temperature_22, signal IR_Temperature_22" RAT_FUNC "%6" "" COEFFS 0 1 -0.0 0 0 0.1 /end COMPU_METHOD
/* Measurement point for signal IR_Temperature_23 of frame RT_IRTemp_Temp_23, 9508645 (0x911725) */
/begin MEASUREMENT crt_PT_911725_IR_Temperature_23 "signal IR_Temperature_23 of frame RT_IRTemp_Temp_23, 9508645 (0x911725)" SWORD CONV_crt_PT_911725_IR_Temperature_23 0.1 100.0 0.0 0.0 ECU_ADDRESS 0x0000 /end MEASUREMENT
/begin COMPU_METHOD CONV_crt_PT_911725_IR_Temperature_23 "Linear scaling, used for variable crt_PT_911725_IR_Temperature_23, signal IR_Temperature_23" RAT_FUNC "%6" "" COEFFS 0 1 -0.0 0 0 0.1 /end COMPU_METHOD
/* Measurement point for signal IR_Temperature_21 of frame RT_IRTemp_Temp_21, 9508133 (0x911525) */
/begin MEASUREMENT crt_PT_911525_IR_Temperature_21 "signal IR_Temperature_21 of frame RT_IRTemp_Temp_21, 9508133 (0x911525)" SWORD CONV_crt_PT_911525_IR_Temperature_21 0.1 100.0 0.0 0.0 ECU_ADDRESS 0x0000 /end MEASUREMENT
/begin COMPU_METHOD CONV_crt_PT_911525_IR_Temperature_21 "Linear scaling, used for variable crt_PT_911525_IR_Temperature_21, signal IR_Temperature_21" RAT_FUNC "%6" "" COEFFS 0 1 -0.0 0 0 0.1 /end COMPU_METHOD
/* Measurement point for signal IR_Temperature_20 of frame RT_IRTemp_Temp_20, 9507877 (0x911425) */
/begin MEASUREMENT crt_PT_911425_IR_Temperature_20 "signal IR_Temperature_20 of frame RT_IRTemp_Temp_20, 9507877 (0x911425)" SWORD CONV_crt_PT_911425_IR_Temperature_20 0.1 100.0 0.0 0.0 ECU_ADDRESS 0x0000 /end MEASUREMENT
/begin COMPU_METHOD CONV_crt_PT_911425_IR_Temperature_20 "Linear scaling, used for variable crt_PT_911425_IR_Temperature_20, signal IR_Temperature_20" RAT_FUNC "%6" "" COEFFS 0 1 -0.0 0 0 0.1 /end COMPU_METHOD
/* Measurement point for signal IR_Temperature_19 of frame RT_IRTemp_Temp_19, 9507621 (0x911325) */
/begin MEASUREMENT crt_PT_911325_IR_Temperature_19 "signal IR_Temperature_19 of frame RT_IRTemp_Temp_19, 9507621 (0x911325)" SWORD CONV_crt_PT_911325_IR_Temperature_19 0.1 100.0 0.0 0.0 ECU_ADDRESS 0x0000 /end MEASUREMENT
/begin COMPU_METHOD CONV_crt_PT_911325_IR_Temperature_19 "Linear scaling, used for variable crt_PT_911325_IR_Temperature_19, signal IR_Temperature_19" RAT_FUNC "%6" "" COEFFS 0 1 -0.0 0 0 0.1 /end COMPU_METHOD
/* Measurement point for signal IR_Temperature_18 of frame RT_IRTemp_Temp_18, 9507365 (0x911225) */
/begin MEASUREMENT crt_PT_911225_IR_Temperature_18 "signal IR_Temperature_18 of frame RT_IRTemp_Temp_18, 9507365 (0x911225)" SWORD CONV_crt_PT_911225_IR_Temperature_18 0.1 100.0 0.0 0.0 ECU_ADDRESS 0x0000 /end MEASUREMENT
/begin COMPU_METHOD CONV_crt_PT_911225_IR_Temperature_18 "Linear scaling, used for variable crt_PT_911225_IR_Temperature_18, signal IR_Temperature_18" RAT_FUNC "%6" "" COEFFS 0 1 -0.0 0 0 0.1 /end COMPU_METHOD
/* Measurement point for signal IR_Temperature_16 of frame RT_IRTemp_Temp_16, 9506853 (0x911025) */
/begin MEASUREMENT crt_PT_911025_IR_Temperature_16 "signal IR_Temperature_16 of frame RT_IRTemp_Temp_16, 9506853 (0x911025)" SWORD CONV_crt_PT_911025_IR_Temperature_16 0.1 100.0 0.0 0.0 ECU_ADDRESS 0x0000 /end MEASUREMENT
/begin COMPU_METHOD CONV_crt_PT_911025_IR_Temperature_16 "Linear scaling, used for variable crt_PT_911025_IR_Temperature_16, signal IR_Temperature_16" RAT_FUNC "%6" "" COEFFS 0 1 -0.0 0 0 0.1 /end COMPU_METHOD
/* Measurement point for signal IR_Temperature_15 of frame RT_IRTemp_Temp_15, 9506597 (0x910f25) */
/begin MEASUREMENT crt_PT_910f25_IR_Temperature_15 "signal IR_Temperature_15 of frame RT_IRTemp_Temp_15, 9506597 (0x910f25)" SWORD CONV_crt_PT_910f25_IR_Temperature_15 0.1 100.0 0.0 0.0 ECU_ADDRESS 0x0000 /end MEASUREMENT
/begin COMPU_METHOD CONV_crt_PT_910f25_IR_Temperature_15 "Linear scaling, used for variable crt_PT_910f25_IR_Temperature_15, signal IR_Temperature_15" RAT_FUNC "%6" "" COEFFS 0 1 -0.0 0 0 0.1 /end COMPU_METHOD
/* Measurement point for signal IR_Temperature_14 of frame RT_IRTemp_Temp_14, 9506341 (0x910e25) */
/begin MEASUREMENT crt_PT_910e25_IR_Temperature_14 "signal IR_Temperature_14 of frame RT_IRTemp_Temp_14, 9506341 (0x910e25)" SWORD CONV_crt_PT_910e25_IR_Temperature_14 0.1 100.0 0.0 0.0 ECU_ADDRESS 0x0000 /end MEASUREMENT
/begin COMPU_METHOD CONV_crt_PT_910e25_IR_Temperature_14 "Linear scaling, used for variable crt_PT_910e25_IR_Temperature_14, signal IR_Temperature_14" RAT_FUNC "%6" "" COEFFS 0 1 -0.0 0 0 0.1 /end COMPU_METHOD
/* Measurement point for signal IR_Temperature_13 of frame RT_IRTemp_Temp_13, 9506085 (0x910d25) */
/begin MEASUREMENT crt_PT_910d25_IR_Temperature_13 "signal IR_Temperature_13 of frame RT_IRTemp_Temp_13, 9506085 (0x910d25)" SWORD CONV_crt_PT_910d25_IR_Temperature_13 0.1 100.0 0.0 0.0 ECU_ADDRESS 0x0000 /end MEASUREMENT
/begin COMPU_METHOD CONV_crt_PT_910d25_IR_Temperature_13 "Linear scaling, used for variable crt_PT_910d25_IR_Temperature_13, signal IR_Temperature_13" RAT_FUNC "%6" "" COEFFS 0 1 -0.0 0 0 0.1 /end COMPU_METHOD
/* Measurement point for signal IR_Temperature_12 of frame RT_IRTemp_Temp_12, 9505829 (0x910c25) */
/begin MEASUREMENT crt_PT_910c25_IR_Temperature_12 "signal IR_Temperature_12 of frame RT_IRTemp_Temp_12, 9505829 (0x910c25)" SWORD CONV_crt_PT_910c25_IR_Temperature_12 0.1 100.0 0.0 0.0 ECU_ADDRESS 0x0000 /end MEASUREMENT
/begin COMPU_METHOD CONV_crt_PT_910c25_IR_Temperature_12 "Linear scaling, used for variable crt_PT_910c25_IR_Temperature_12, signal IR_Temperature_12" RAT_FUNC "%6" "" COEFFS 0 1 -0.0 0 0 0.1 /end COMPU_METHOD
/* Measurement point for signal IR_Temperature_11 of frame RT_IRTemp_Temp_11, 9505573 (0x910b25) */
/begin MEASUREMENT crt_PT_910b25_IR_Temperature_11 "signal IR_Temperature_11 of frame RT_IRTemp_Temp_11, 9505573 (0x910b25)" SWORD CONV_crt_PT_910b25_IR_Temperature_11 0.1 100.0 0.0 0.0 ECU_ADDRESS 0x0000 /end MEASUREMENT
/begin COMPU_METHOD CONV_crt_PT_910b25_IR_Temperature_11 "Linear scaling, used for variable crt_PT_910b25_IR_Temperature_11, signal IR_Temperature_11" RAT_FUNC "%6" "" COEFFS 0 1 -0.0 0 0 0.1 /end COMPU_METHOD
/* Measurement point for signal IR_Temperature_10 of frame RT_IRTemp_Temp_10, 9505317 (0x910a25) */
/begin MEASUREMENT crt_PT_910a25_IR_Temperature_10 "signal IR_Temperature_10 of frame RT_IRTemp_Temp_10, 9505317 (0x910a25)" SWORD CONV_crt_PT_910a25_IR_Temperature_10 0.1 100.0 0.0 0.0 ECU_ADDRESS 0x0000 /end MEASUREMENT
/begin COMPU_METHOD CONV_crt_PT_910a25_IR_Temperature_10 "Linear scaling, used for variable crt_PT_910a25_IR_Temperature_10, signal IR_Temperature_10" RAT_FUNC "%6" "" COEFFS 0 1 -0.0 0 0 0.1 /end COMPU_METHOD
/* Measurement point for signal IR_Temperature_8 of frame RT_IRTemp_Temp_8, 9504805 (0x910825) */
/begin MEASUREMENT crt_PT_910825_IR_Temperature_8 "signal IR_Temperature_8 of frame RT_IRTemp_Temp_8, 9504805 (0x910825)" SWORD CONV_crt_PT_910825_IR_Temperature_8 0.1 100.0 0.0 0.0 ECU_ADDRESS 0x0000 /end MEASUREMENT
/begin COMPU_METHOD CONV_crt_PT_910825_IR_Temperature_8 "Linear scaling, used for variable crt_PT_910825_IR_Temperature_8, signal IR_Temperature_8" RAT_FUNC "%6" "" COEFFS 0 1 -0.0 0 0 0.1 /end COMPU_METHOD
/* Measurement point for signal IR_Temperature_9 of frame RT_IRTemp_Temp_9, 9505061 (0x910925) */
/begin MEASUREMENT crt_PT_910925_IR_Temperature_9 "signal IR_Temperature_9 of frame RT_IRTemp_Temp_9, 9505061 (0x910925)" SWORD CONV_crt_PT_910925_IR_Temperature_9 0.1 100.0 0.0 0.0 ECU_ADDRESS 0x0000 /end MEASUREMENT
/begin COMPU_METHOD CONV_crt_PT_910925_IR_Temperature_9 "Linear scaling, used for variable crt_PT_910925_IR_Temperature_9, signal IR_Temperature_9" RAT_FUNC "%6" "" COEFFS 0 1 -0.0 0 0 0.1 /end COMPU_METHOD
/* Measurement point for signal IR_Temperature_17 of frame RT_IRTemp_Temp_17, 9507109 (0x911125) */
/begin MEASUREMENT crt_PT_911125_IR_Temperature_17 "signal IR_Temperature_17 of frame RT_IRTemp_Temp_17, 9507109 (0x911125)" SWORD CONV_crt_PT_911125_IR_Temperature_17 0.1 100.0 0.0 0.0 ECU_ADDRESS 0x0000 /end MEASUREMENT
/begin COMPU_METHOD CONV_crt_PT_911125_IR_Temperature_17 "Linear scaling, used for variable crt_PT_911125_IR_Temperature_17, signal IR_Temperature_17" RAT_FUNC "%6" "" COEFFS 0 1 -0.0 0 0 0.1 /end COMPU_METHOD
/* Measurement point for signal IR_Temperature_6 of frame RT_IRTemp_Temp_6, 9504293 (0x910625) */
/begin MEASUREMENT crt_PT_910625_IR_Temperature_6 "signal IR_Temperature_6 of frame RT_IRTemp_Temp_6, 9504293 (0x910625)" SWORD CONV_crt_PT_910625_IR_Temperature_6 0.1 100.0 0.0 0.0 ECU_ADDRESS 0x0000 /end MEASUREMENT
/begin COMPU_METHOD CONV_crt_PT_910625_IR_Temperature_6 "Linear scaling, used for variable crt_PT_910625_IR_Temperature_6, signal IR_Temperature_6" RAT_FUNC "%6" "" COEFFS 0 1 -0.0 0 0 0.1 /end COMPU_METHOD
/* Measurement point for signal IR_Temperature_5 of frame RT_IRTemp_Temp_5, 9504037 (0x910525) */
/begin MEASUREMENT crt_PT_910525_IR_Temperature_5 "signal IR_Temperature_5 of frame RT_IRTemp_Temp_5, 9504037 (0x910525)" SWORD CONV_crt_PT_910525_IR_Temperature_5 0.1 100.0 0.0 0.0 ECU_ADDRESS 0x0000 /end MEASUREMENT
/begin COMPU_METHOD CONV_crt_PT_910525_IR_Temperature_5 "Linear scaling, used for variable crt_PT_910525_IR_Temperature_5, signal IR_Temperature_5" RAT_FUNC "%6" "" COEFFS 0 1 -0.0 0 0 0.1 /end COMPU_METHOD
/* Measurement point for signal IR_Temperature_4 of frame RT_IRTemp_Temp_4, 9503781 (0x910425) */
/begin MEASUREMENT crt_PT_910425_IR_Temperature_4 "signal IR_Temperature_4 of frame RT_IRTemp_Temp_4, 9503781 (0x910425)" SWORD CONV_crt_PT_910425_IR_Temperature_4 0.1 100.0 0.0 0.0 ECU_ADDRESS 0x0000 /end MEASUREMENT
/begin COMPU_METHOD CONV_crt_PT_910425_IR_Temperature_4 "Linear scaling, used for variable crt_PT_910425_IR_Temperature_4, signal IR_Temperature_4" RAT_FUNC "%6" "" COEFFS 0 1 -0.0 0 0 0.1 /end COMPU_METHOD
/* Measurement point for signal IR_Temperature_3 of frame RT_IRTemp_Temp_3, 9503525 (0x910325) */
/begin MEASUREMENT crt_PT_910325_IR_Temperature_3 "signal IR_Temperature_3 of frame RT_IRTemp_Temp_3, 9503525 (0x910325)" SWORD CONV_crt_PT_910325_IR_Temperature_3 0.1 100.0 0.0 0.0 ECU_ADDRESS 0x0000 /end MEASUREMENT
/begin COMPU_METHOD CONV_crt_PT_910325_IR_Temperature_3 "Linear scaling, used for variable crt_PT_910325_IR_Temperature_3, signal IR_Temperature_3" RAT_FUNC "%6" "" COEFFS 0 1 -0.0 0 0 0.1 /end COMPU_METHOD
/* Measurement point for signal IR_Temperature_2 of frame RT_IRTemp_Temp_2, 9503269 (0x910225) */
/begin MEASUREMENT crt_PT_910225_IR_Temperature_2 "signal IR_Temperature_2 of frame RT_IRTemp_Temp_2, 9503269 (0x910225)" SWORD CONV_crt_PT_910225_IR_Temperature_2 0.1 100.0 0.0 0.0 ECU_ADDRESS 0x0000 /end MEASUREMENT
/begin COMPU_METHOD CONV_crt_PT_910225_IR_Temperature_2 "Linear scaling, used for variable crt_PT_910225_IR_Temperature_2, signal IR_Temperature_2" RAT_FUNC "%6" "" COEFFS 0 1 -0.0 0 0 0.1 /end COMPU_METHOD
/* Measurement point for signal IR_Temperature_1 of frame RT_IRTemp_Temp_1, 9503013 (0x910125) */
/begin MEASUREMENT crt_PT_910125_IR_Temperature_1 "signal IR_Temperature_1 of frame RT_IRTemp_Temp_1, 9503013 (0x910125)" SWORD CONV_crt_PT_910125_IR_Temperature_1 0.1 100.0 0.0 0.0 ECU_ADDRESS 0x0000 /end MEASUREMENT
/begin COMPU_METHOD CONV_crt_PT_910125_IR_Temperature_1 "Linear scaling, used for variable crt_PT_910125_IR_Temperature_1, signal IR_Temperature_1" RAT_FUNC "%6" "" COEFFS 0 1 -0.0 0 0 0.1 /end COMPU_METHOD
/* Measurement point for signal CRC of frame RT_IRTemp_Temp_1, 9503013 (0x910125) */
/begin MEASUREMENT crt_PT_910125_CRC "signal CRC of frame RT_IRTemp_Temp_1, 9503013 (0x910125). Checksum" UBYTE CONV_crt_PT_910125_CRC 1.0 100.0 1 255 ECU_ADDRESS 0x0000 /end MEASUREMENT
/begin COMPU_METHOD CONV_crt_PT_910125_CRC "Linear scaling, used for variable crt_PT_910125_CRC, signal CRC" RAT_FUNC "%4" "" COEFFS 0 1 0 0 0 1 /end COMPU_METHOD
/* Measurement point for signal Validity_Final_Speed of frame RT_SB_Trig_Final_Condition, 9242402 (0x8d0722) */
/begin MEASUREMENT crt_PT_8d0722_Validity_Final_Speed "signal Validity_Final_Speed of frame RT_SB_Trig_Final_Condition, 9242402 (0x8d0722). Valid when bit is set, invalid when bit is clear." UBYTE CONV_crt_PT_8d0722_Validity_Final_Speed 1.0 100.0 0 1 ECU_ADDRESS 0x0000 /end MEASUREMENT
/begin COMPU_METHOD CONV_crt_PT_8d0722_Validity_Final_Speed "Linear scaling, used for variable crt_PT_8d0722_Validity_Final_Speed, signal Validity_Final_Speed" RAT_FUNC "%1" "" COEFFS 0 1 0 0 0 1 /end COMPU_METHOD
/* Measurement point for signal Final_Speed of frame RT_SB_Trig_Final_Condition, 9242402 (0x8d0722) */
/begin MEASUREMENT crt_PT_8d0722_Final_Speed "signal Final_Speed of frame RT_SB_Trig_Final_Condition, 9242402 (0x8d0722). Speed at end of triggered test" ULONG CONV_crt_PT_8d0722_Final_Speed 1.0E-4 100.0 0.0 1675.0 ECU_ADDRESS 0x0000 /end MEASUREMENT
/begin COMPU_METHOD CONV_crt_PT_8d0722_Final_Speed "Linear scaling, used for variable crt_PT_8d0722_Final_Speed, signal Final_Speed" RAT_FUNC "%12" "m/s" COEFFS 0 1 -0.0 0 0 1.0E-4 /end COMPU_METHOD
/* Measurement point for signal Validity_Initial_Speed of frame RT_SB_Trig_Initial_Condition, 794 (0x31a) */
/begin MEASUREMENT crt_PT_31a_Validity_Initial_Speed "signal Validity_Initial_Speed of frame RT_SB_Trig_Initial_Condition, 794 (0x31a). Valid when bit is set, invalid when bit is clear. Valid when bit is set, invalid when bit is clear." UBYTE CONV_crt_PT_31a_Validity_Initial_Speed 1.0 100.0 0 1 ECU_ADDRESS 0x0000 /end MEASUREMENT
/begin COMPU_METHOD CONV_crt_PT_31a_Validity_Initial_Speed "Linear scaling, used for variable crt_PT_31a_Validity_Initial_Speed, signal Validity_Initial_Speed" RAT_FUNC "%1" "" COEFFS 0 1 0 0 0 1 /end COMPU_METHOD
/* Measurement point for signal Validity_Initial_Heading of frame RT_SB_Trig_Initial_Condition, 794 (0x31a) */
/begin MEASUREMENT crt_PT_31a_Validity_Initial_Heading "signal Validity_Initial_Heading of frame RT_SB_Trig_Initial_Condition, 794 (0x31a). Valid when bit is set, invalid when bit is clear. Valid when bit is set, invalid when bit is clear." UBYTE CONV_crt_PT_31a_Validity_Initial_Heading 1.0 100.0 0 1 ECU_ADDRESS 0x0000 /end MEASUREMENT
/begin COMPU_METHOD CONV_crt_PT_31a_Validity_Initial_Heading "Linear scaling, used for variable crt_PT_31a_Validity_Initial_Heading, signal Validity_Initial_Heading" RAT_FUNC "%1" "" COEFFS 0 1 0 0 0 1 /end COMPU_METHOD
/* Measurement point for signal Initial_Speed of frame RT_SB_Trig_Initial_Condition, 794 (0x31a) */
/begin MEASUREMENT crt_PT_31a_Initial_Speed "signal Initial_Speed of frame RT_SB_Trig_Initial_Condition, 794 (0x31a). Speed at start of triggered test Speed at start of triggered test" ULONG CONV_crt_PT_31a_Initial_Speed 1.0E-4 100.0 0.0 1675.0 ECU_ADDRESS 0x0000 /end MEASUREMENT
/begin COMPU_METHOD CONV_crt_PT_31a_Initial_Speed "Linear scaling, used for variable crt_PT_31a_Initial_Speed, signal Initial_Speed" RAT_FUNC "%12" "m/s" COEFFS 0 1 -0.0 0 0 1.0E-4 /end COMPU_METHOD
/* Measurement point for signal Initial_Heading of frame RT_SB_Trig_Initial_Condition, 794 (0x31a) */
/begin MEASUREMENT crt_PT_31a_Initial_Heading "signal Initial_Heading of frame RT_SB_Trig_Initial_Condition, 794 (0x31a). Heading (track) at start of triggered test Heading (track) at start of triggered test" SWORD CONV_crt_PT_31a_Initial_Heading 0.01 100.0 -180.0 180.0 ECU_ADDRESS 0x0000 /end MEASUREMENT
/begin COMPU_METHOD CONV_crt_PT_31a_Initial_Heading "Linear scaling, used for variable crt_PT_31a_Initial_Heading, signal Initial_Heading" RAT_FUNC "%6" "degrees" COEFFS 0 1 -0.0 0 0 0.01 /end COMPU_METHOD
/* Measurement point for signal MFDD_Start_Threshold of frame RT_SB_Trig_Initial_Condition, 794 (0x31a) */
/begin MEASUREMENT crt_PT_31a_MFDD_Start_Threshold "signal MFDD_Start_Threshold of frame RT_SB_Trig_Initial_Condition, 794 (0x31a)" UBYTE CONV_crt_PT_31a_MFDD_Start_Threshold 1.0 100.0 0 100 ECU_ADDRESS 0x0000 /end MEASUREMENT
/begin COMPU_METHOD CONV_crt_PT_31a_MFDD_Start_Threshold "Linear scaling, used for variable crt_PT_31a_MFDD_Start_Threshold, signal MFDD_Start_Threshold" RAT_FUNC "%4" "%" COEFFS 0 1 0 0 0 1 /end COMPU_METHOD
/* Measurement point for signal MFDD_End_Threshold of frame RT_SB_Trig_Initial_Condition, 794 (0x31a) */
/begin MEASUREMENT crt_PT_31a_MFDD_End_Threshold "signal MFDD_End_Threshold of frame RT_SB_Trig_Initial_Condition, 794 (0x31a)" UBYTE CONV_crt_PT_31a_MFDD_End_Threshold 1.0 100.0 0 100 ECU_ADDRESS 0x0000 /end MEASUREMENT
/begin COMPU_METHOD CONV_crt_PT_31a_MFDD_End_Threshold "Linear scaling, used for variable crt_PT_31a_MFDD_End_Threshold, signal MFDD_End_Threshold" RAT_FUNC "%4" "%" COEFFS 0 1 0 0 0 1 /end COMPU_METHOD
/* Measurement point for signal Direct_Distance of frame RT_SB_Trig_Direct_Dist, 9241890 (0x8d0522) */
/begin MEASUREMENT crt_PT_8d0522_Direct_Distance "signal Direct_Distance of frame RT_SB_Trig_Direct_Dist, 9241890 (0x8d0522). Direct distance from start of test to current position" ULONG CONV_crt_PT_8d0522_Direct_Distance 0.001 100.0 0.0 4294970.0 ECU_ADDRESS 0x0000 /end MEASUREMENT
/begin COMPU_METHOD CONV_crt_PT_8d0522_Direct_Distance "Linear scaling, used for variable crt_PT_8d0522_Direct_Distance, signal Direct_Distance" RAT_FUNC "%12" "m" COEFFS 0 1 -0.0 0 0 0.001 /end COMPU_METHOD
/* Measurement point for signal Path_Distance_2D of frame RT_SB_Trig_Direct_Dist, 9241890 (0x8d0522) */
/begin MEASUREMENT crt_PT_8d0522_Path_Distance_2D "signal Path_Distance_2D of frame RT_SB_Trig_Direct_Dist, 9241890 (0x8d0522). 2D path distance (horizontal components only)" ULONG CONV_crt_PT_8d0522_Path_Distance_2D 0.001 100.0 0.0 4294970.0 ECU_ADDRESS 0x0000 /end MEASUREMENT
/begin COMPU_METHOD CONV_crt_PT_8d0522_Path_Distance_2D "Linear scaling, used for variable crt_PT_8d0522_Path_Distance_2D, signal Path_Distance_2D" RAT_FUNC "%12" "m" COEFFS 0 1 -0.0 0 0 0.001 /end COMPU_METHOD
/* Measurement point for signal Forward_Distance of frame RT_SB_Trig_Forward_Dist, 9241634 (0x8d0422) */
/begin MEASUREMENT crt_PT_8d0422_Forward_Distance "signal Forward_Distance of frame RT_SB_Trig_Forward_Dist, 9241634 (0x8d0422). Current forward distance from start of test in direction of initial heading at start of test" SLONG CONV_crt_PT_8d0422_Forward_Distance 0.001 100.0 -2147480.0 2147480.0 ECU_ADDRESS 0x0000 /end MEASUREMENT
/begin COMPU_METHOD CONV_crt_PT_8d0422_Forward_Distance "Linear scaling, used for variable crt_PT_8d0422_Forward_Distance, signal Forward_Distance" RAT_FUNC "%12" "m" COEFFS 0 1 -0.0 0 0 0.001 /end COMPU_METHOD
/* Measurement point for signal Deviation_Distance of frame RT_SB_Trig_Forward_Dist, 9241634 (0x8d0422) */
/begin MEASUREMENT crt_PT_8d0422_Deviation_Distance "signal Deviation_Distance of frame RT_SB_Trig_Forward_Dist, 9241634 (0x8d0422). Current deviation distance from a line projected along the initial heading at start of test, +ve for deviation to the right." SLONG CONV_crt_PT_8d0422_Deviation_Distance 0.001 100.0 -2147480.0 2147480.0 ECU_ADDRESS 0x0000 /end MEASUREMENT
/begin COMPU_METHOD CONV_crt_PT_8d0422_Deviation_Distance "Linear scaling, used for variable crt_PT_8d0422_Deviation_Distance, signal Deviation_Distance" RAT_FUNC "%12" "m" COEFFS 0 1 -0.0 0 0 0.001 /end COMPU_METHOD
/* Measurement point for signal Path_Distance_3D of frame RT_SB_Trig_Path_Dist, 9241378 (0x8d0322) */
/begin MEASUREMENT crt_PT_8d0322_Path_Distance_3D "signal Path_Distance_3D of frame RT_SB_Trig_Path_Dist, 9241378 (0x8d0322). 3D path distance" ULONG CONV_crt_PT_8d0322_Path_Distance_3D 0.001 100.0 0.0 4294970.0 ECU_ADDRESS 0x0000 /end MEASUREMENT
/begin COMPU_METHOD CONV_crt_PT_8d0322_Path_Distance_3D "Linear scaling, used for variable crt_PT_8d0322_Path_Distance_3D, signal Path_Distance_3D" RAT_FUNC "%12" "m" COEFFS 0 1 -0.0 0 0 0.001 /end COMPU_METHOD
/* Measurement point for signal Validity_MFDD of frame RT_SB_Trig_Accel, 9241122 (0x8d0222) */
/begin MEASUREMENT crt_PT_8d0222_Validity_MFDD "signal Validity_MFDD of frame RT_SB_Trig_Accel, 9241122 (0x8d0222). Valid when bit is set, invalid when bit is clear." UBYTE CONV_crt_PT_8d0222_Validity_MFDD 1.0 100.0 0 1 ECU_ADDRESS 0x0000 /end MEASUREMENT
/begin COMPU_METHOD CONV_crt_PT_8d0222_Validity_MFDD "Linear scaling, used for variable crt_PT_8d0222_Validity_MFDD, signal Validity_MFDD" RAT_FUNC "%1" "" COEFFS 0 1 0 0 0 1 /end COMPU_METHOD
/* Measurement point for signal Validity_Average_Accel of frame RT_SB_Trig_Accel, 9241122 (0x8d0222) */
/begin MEASUREMENT crt_PT_8d0222_Validity_Average_Accel "signal Validity_Average_Accel of frame RT_SB_Trig_Accel, 9241122 (0x8d0222). Valid when bit is set, invalid when bit is clear." UBYTE CONV_crt_PT_8d0222_Validity_Average_Accel 1.0 100.0 0 1 ECU_ADDRESS 0x0000 /end MEASUREMENT
/begin COMPU_METHOD CONV_crt_PT_8d0222_Validity_Average_Accel "Linear scaling, used for variable crt_PT_8d0222_Validity_Average_Accel, signal Validity_Average_Accel" RAT_FUNC "%1" "" COEFFS 0 1 0 0 0 1 /end COMPU_METHOD
/* Measurement point for signal Validity_Triggered_Time of frame RT_SB_Trig_Accel, 9241122 (0x8d0222) */
/begin MEASUREMENT crt_PT_8d0222_Validity_Triggered_Time "signal Validity_Triggered_Time of frame RT_SB_Trig_Accel, 9241122 (0x8d0222). Valid when bit is set, invalid when bit is clear." UBYTE CONV_crt_PT_8d0222_Validity_Triggered_Time 1.0 100.0 0 1 ECU_ADDRESS 0x0000 /end MEASUREMENT
/begin COMPU_METHOD CONV_crt_PT_8d0222_Validity_Triggered_Time "Linear scaling, used for variable crt_PT_8d0222_Validity_Triggered_Time, signal Validity_Triggered_Time" RAT_FUNC "%1" "" COEFFS 0 1 0 0 0 1 /end COMPU_METHOD
/* Measurement point for signal MFDD of frame RT_SB_Trig_Accel, 9241122 (0x8d0222) */
/begin MEASUREMENT crt_PT_8d0222_MFDD "signal MFDD of frame RT_SB_Trig_Accel, 9241122 (0x8d0222). Mean fully-developed decelleration of triggered test.  Thresholds used are as set in the logger configuration." SWORD CONV_crt_PT_8d0222_MFDD 0.001 100.0 -65.0 65.0 ECU_ADDRESS 0x0000 /end MEASUREMENT
/begin COMPU_METHOD CONV_crt_PT_8d0222_MFDD "Linear scaling, used for variable crt_PT_8d0222_MFDD, signal MFDD" RAT_FUNC "%6" "g" COEFFS 0 1 -0.0 0 0 0.001 /end COMPU_METHOD
/* Measurement point for signal Average_Accel of frame RT_SB_Trig_Accel, 9241122 (0x8d0222) */
/begin MEASUREMENT crt_PT_8d0222_Average_Accel "signal Average_Accel of frame RT_SB_Trig_Accel, 9241122 (0x8d0222). Average acceleration from start of triggered test to current time." SWORD CONV_crt_PT_8d0222_Average_Accel 0.001 100.0 -65.0 65.0 ECU_ADDRESS 0x0000 /end MEASUREMENT
/begin COMPU_METHOD CONV_crt_PT_8d0222_Average_Accel "Linear scaling, used for variable crt_PT_8d0222_Average_Accel, signal Average_Accel" RAT_FUNC "%6" "g" COEFFS 0 1 -0.0 0 0 0.001 /end COMPU_METHOD
/* Measurement point for signal Triggered_Time of frame RT_SB_Trig_Accel, 9241122 (0x8d0222) */
/begin MEASUREMENT crt_PT_8d0222_Triggered_Time "signal Triggered_Time of frame RT_SB_Trig_Accel, 9241122 (0x8d0222). Cumulative time from start of triggered test to current time." ULONG CONV_crt_PT_8d0222_Triggered_Time 0.01 100.0 0.0 167772.0 ECU_ADDRESS 0x0000 /end MEASUREMENT
/begin COMPU_METHOD CONV_crt_PT_8d0222_Triggered_Time "Linear scaling, used for variable crt_PT_8d0222_Triggered_Time, signal Triggered_Time" RAT_FUNC "%12" "s" COEFFS 0 1 -0.0 0 0 0.01 /end COMPU_METHOD
/* Measurement point for signal Measured_Time_12 of frame RT_DL1MK3_Measure_Time_12, 9833508 (0x960c24) */
/begin MEASUREMENT crt_PT_960c24_Measured_Time_12 "signal Measured_Time_12 of frame RT_DL1MK3_Measure_Time_12, 9833508 (0x960c24)" ULONG CONV_crt_PT_960c24_Measured_Time_12 1.0 100.0 0 0 ECU_ADDRESS 0x0000 /end MEASUREMENT
/begin COMPU_METHOD CONV_crt_PT_960c24_Measured_Time_12 "Linear scaling, used for variable crt_PT_960c24_Measured_Time_12, signal Measured_Time_12" RAT_FUNC "%12" "" COEFFS 0 1 0 0 0 1 /end COMPU_METHOD
/* Measurement point for signal Measured_Time_11 of frame RT_DL1MK3_Measure_Time_11, 9833252 (0x960b24) */
/begin MEASUREMENT crt_PT_960b24_Measured_Time_11 "signal Measured_Time_11 of frame RT_DL1MK3_Measure_Time_11, 9833252 (0x960b24)" ULONG CONV_crt_PT_960b24_Measured_Time_11 1.0 100.0 0 0 ECU_ADDRESS 0x0000 /end MEASUREMENT
/begin COMPU_METHOD CONV_crt_PT_960b24_Measured_Time_11 "Linear scaling, used for variable crt_PT_960b24_Measured_Time_11, signal Measured_Time_11" RAT_FUNC "%12" "" COEFFS 0 1 0 0 0 1 /end COMPU_METHOD
/* Measurement point for signal Measured_Time_10 of frame RT_DL1MK3_Measure_Time_10, 9832996 (0x960a24) */
/begin MEASUREMENT crt_PT_960a24_Measured_Time_10 "signal Measured_Time_10 of frame RT_DL1MK3_Measure_Time_10, 9832996 (0x960a24)" ULONG CONV_crt_PT_960a24_Measured_Time_10 1.0 100.0 0 0 ECU_ADDRESS 0x0000 /end MEASUREMENT
/begin COMPU_METHOD CONV_crt_PT_960a24_Measured_Time_10 "Linear scaling, used for variable crt_PT_960a24_Measured_Time_10, signal Measured_Time_10" RAT_FUNC "%12" "" COEFFS 0 1 0 0 0 1 /end COMPU_METHOD
/* Measurement point for signal Measured_Time_9 of frame RT_DL1MK3_Measure_Time_9, 9832740 (0x960924) */
/begin MEASUREMENT crt_PT_960924_Measured_Time_9 "signal Measured_Time_9 of frame RT_DL1MK3_Measure_Time_9, 9832740 (0x960924)" ULONG CONV_crt_PT_960924_Measured_Time_9 1.0 100.0 0 0 ECU_ADDRESS 0x0000 /end MEASUREMENT
/begin COMPU_METHOD CONV_crt_PT_960924_Measured_Time_9 "Linear scaling, used for variable crt_PT_960924_Measured_Time_9, signal Measured_Time_9" RAT_FUNC "%12" "" COEFFS 0 1 0 0 0 1 /end COMPU_METHOD
/* Measurement point for signal Measured_Time_8 of frame RT_DL1MK3_Measure_Time_8, 9832484 (0x960824) */
/begin MEASUREMENT crt_PT_960824_Measured_Time_8 "signal Measured_Time_8 of frame RT_DL1MK3_Measure_Time_8, 9832484 (0x960824)" ULONG CONV_crt_PT_960824_Measured_Time_8 1.0 100.0 0 0 ECU_ADDRESS 0x0000 /end MEASUREMENT
/begin COMPU_METHOD CONV_crt_PT_960824_Measured_Time_8 "Linear scaling, used for variable crt_PT_960824_Measured_Time_8, signal Measured_Time_8" RAT_FUNC "%12" "" COEFFS 0 1 0 0 0 1 /end COMPU_METHOD
/* Measurement point for signal Measured_Time_7 of frame RT_DL1MK3_Measure_Time_7, 9832228 (0x960724) */
/begin MEASUREMENT crt_PT_960724_Measured_Time_7 "signal Measured_Time_7 of frame RT_DL1MK3_Measure_Time_7, 9832228 (0x960724)" ULONG CONV_crt_PT_960724_Measured_Time_7 1.0 100.0 0 0 ECU_ADDRESS 0x0000 /end MEASUREMENT
/begin COMPU_METHOD CONV_crt_PT_960724_Measured_Time_7 "Linear scaling, used for variable crt_PT_960724_Measured_Time_7, signal Measured_Time_7" RAT_FUNC "%12" "" COEFFS 0 1 0 0 0 1 /end COMPU_METHOD
/* Measurement point for signal Measured_Time_6 of frame RT_DL1MK3_Measure_Time_6, 9831972 (0x960624) */
/begin MEASUREMENT crt_PT_960624_Measured_Time_6 "signal Measured_Time_6 of frame RT_DL1MK3_Measure_Time_6, 9831972 (0x960624)" ULONG CONV_crt_PT_960624_Measured_Time_6 1.0 100.0 0 0 ECU_ADDRESS 0x0000 /end MEASUREMENT
/begin COMPU_METHOD CONV_crt_PT_960624_Measured_Time_6 "Linear scaling, used for variable crt_PT_960624_Measured_Time_6, signal Measured_Time_6" RAT_FUNC "%12" "" COEFFS 0 1 0 0 0 1 /end COMPU_METHOD
/* Measurement point for signal Measured_Time_5 of frame RT_DL1MK3_Measure_Time_5, 9831716 (0x960524) */
/begin MEASUREMENT crt_PT_960524_Measured_Time_5 "signal Measured_Time_5 of frame RT_DL1MK3_Measure_Time_5, 9831716 (0x960524)" ULONG CONV_crt_PT_960524_Measured_Time_5 1.0 100.0 0 0 ECU_ADDRESS 0x0000 /end MEASUREMENT
/begin COMPU_METHOD CONV_crt_PT_960524_Measured_Time_5 "Linear scaling, used for variable crt_PT_960524_Measured_Time_5, signal Measured_Time_5" RAT_FUNC "%12" "" COEFFS 0 1 0 0 0 1 /end COMPU_METHOD
/* Measurement point for signal Measured_Time_4 of frame RT_DL1MK3_Measure_Time_4, 9831460 (0x960424) */
/begin MEASUREMENT crt_PT_960424_Measured_Time_4 "signal Measured_Time_4 of frame RT_DL1MK3_Measure_Time_4, 9831460 (0x960424)" ULONG CONV_crt_PT_960424_Measured_Time_4 1.0 100.0 0 0 ECU_ADDRESS 0x0000 /end MEASUREMENT
/begin COMPU_METHOD CONV_crt_PT_960424_Measured_Time_4 "Linear scaling, used for variable crt_PT_960424_Measured_Time_4, signal Measured_Time_4" RAT_FUNC "%12" "" COEFFS 0 1 0 0 0 1 /end COMPU_METHOD
/* Measurement point for signal Measured_Time_3 of frame RT_DL1MK3_Measure_Time_3, 9831204 (0x960324) */
/begin MEASUREMENT crt_PT_960324_Measured_Time_3 "signal Measured_Time_3 of frame RT_DL1MK3_Measure_Time_3, 9831204 (0x960324)" ULONG CONV_crt_PT_960324_Measured_Time_3 1.0 100.0 0 0 ECU_ADDRESS 0x0000 /end MEASUREMENT
/begin COMPU_METHOD CONV_crt_PT_960324_Measured_Time_3 "Linear scaling, used for variable crt_PT_960324_Measured_Time_3, signal Measured_Time_3" RAT_FUNC "%12" "" COEFFS 0 1 0 0 0 1 /end COMPU_METHOD
/* Measurement point for signal Measured_Time_2 of frame RT_DL1MK3_Measure_Time_2, 9830948 (0x960224) */
/begin MEASUREMENT crt_PT_960224_Measured_Time_2 "signal Measured_Time_2 of frame RT_DL1MK3_Measure_Time_2, 9830948 (0x960224)" ULONG CONV_crt_PT_960224_Measured_Time_2 1.0 100.0 0 0 ECU_ADDRESS 0x0000 /end MEASUREMENT
/begin COMPU_METHOD CONV_crt_PT_960224_Measured_Time_2 "Linear scaling, used for variable crt_PT_960224_Measured_Time_2, signal Measured_Time_2" RAT_FUNC "%12" "" COEFFS 0 1 0 0 0 1 /end COMPU_METHOD
/* Measurement point for signal Measured_Time_1 of frame RT_DL1MK3_Measure_Time_1, 9830692 (0x960124) */
/begin MEASUREMENT crt_PT_960124_Measured_Time_1 "signal Measured_Time_1 of frame RT_DL1MK3_Measure_Time_1, 9830692 (0x960124)" ULONG CONV_crt_PT_960124_Measured_Time_1 1.0 100.0 0 0 ECU_ADDRESS 0x0000 /end MEASUREMENT
/begin COMPU_METHOD CONV_crt_PT_960124_Measured_Time_1 "Linear scaling, used for variable crt_PT_960124_Measured_Time_1, signal Measured_Time_1" RAT_FUNC "%12" "" COEFFS 0 1 0 0 0 1 /end COMPU_METHOD
/* Measurement point for signal RPM of frame RT_DL1MK3_RPM, 9767972 (0x950c24) */
/begin MEASUREMENT crt_PT_950c24_RPM "signal RPM of frame RT_DL1MK3_RPM, 9767972 (0x950c24)" UWORD CONV_crt_PT_950c24_RPM 1.0 100.0 0 0 ECU_ADDRESS 0x0000 /end MEASUREMENT
/begin COMPU_METHOD CONV_crt_PT_950c24_RPM "Linear scaling, used for variable crt_PT_950c24_RPM, signal RPM" RAT_FUNC "%6" "" COEFFS 0 1 0 0 0 1 /end COMPU_METHOD
/* Measurement point for signal Frequency_4 of frame RT_DL1MK3_Freq_4, 9767716 (0x950b24) */
/begin MEASUREMENT crt_PT_950b24_Frequency_4 "signal Frequency_4 of frame RT_DL1MK3_Freq_4, 9767716 (0x950b24)" UWORD CONV_crt_PT_950b24_Frequency_4 0.1 100.0 0.0 0.0 ECU_ADDRESS 0x0000 /end MEASUREMENT
/begin COMPU_METHOD CONV_crt_PT_950b24_Frequency_4 "Linear scaling, used for variable crt_PT_950b24_Frequency_4, signal Frequency_4" RAT_FUNC "%6" "" COEFFS 0 1 -0.0 0 0 0.1 /end COMPU_METHOD
/* Measurement point for signal Frequency_3 of frame RT_DL1MK3_Freq_3, 9767460 (0x950a24) */
/begin MEASUREMENT crt_PT_950a24_Frequency_3 "signal Frequency_3 of frame RT_DL1MK3_Freq_3, 9767460 (0x950a24)" UWORD CONV_crt_PT_950a24_Frequency_3 0.1 100.0 0.0 0.0 ECU_ADDRESS 0x0000 /end MEASUREMENT
/begin COMPU_METHOD CONV_crt_PT_950a24_Frequency_3 "Linear scaling, used for variable crt_PT_950a24_Frequency_3, signal Frequency_3" RAT_FUNC "%6" "" COEFFS 0 1 -0.0 0 0 0.1 /end COMPU_METHOD
/* Measurement point for signal Frequency_2 of frame RT_DL1MK3_Freq_2, 9767204 (0x950924) */
/begin MEASUREMENT crt_PT_950924_Frequency_2 "signal Frequency_2 of frame RT_DL1MK3_Freq_2, 9767204 (0x950924)" UWORD CONV_crt_PT_950924_Frequency_2 0.1 100.0 0.0 0.0 ECU_ADDRESS 0x0000 /end MEASUREMENT
/begin COMPU_METHOD CONV_crt_PT_950924_Frequency_2 "Linear scaling, used for variable crt_PT_950924_Frequency_2, signal Frequency_2" RAT_FUNC "%6" "" COEFFS 0 1 -0.0 0 0 0.1 /end COMPU_METHOD
/* Measurement point for signal Misc_3 of frame RT_DL1MK3_Misc_3, 9896740 (0x970324) */
/begin MEASUREMENT crt_PT_970324_Misc_3 "signal Misc_3 of frame RT_DL1MK3_Misc_3, 9896740 (0x970324)" UWORD CONV_crt_PT_970324_Misc_3 0.001 100.0 0.0 0.0 ECU_ADDRESS 0x0000 /end MEASUREMENT
/begin COMPU_METHOD CONV_crt_PT_970324_Misc_3 "Linear scaling, used for variable crt_PT_970324_Misc_3, signal Misc_3" RAT_FUNC "%6" "" COEFFS 0 1 -0.0 0 0 0.001 /end COMPU_METHOD
/* Measurement point for signal Misc_2 of frame RT_DL1MK3_Misc_2, 9896484 (0x970224) */
/begin MEASUREMENT crt_PT_970224_Misc_2 "signal Misc_2 of frame RT_DL1MK3_Misc_2, 9896484 (0x970224)" UWORD CONV_crt_PT_970224_Misc_2 0.001 100.0 0.0 0.0 ECU_ADDRESS 0x0000 /end MEASUREMENT
/begin COMPU_METHOD CONV_crt_PT_970224_Misc_2 "Linear scaling, used for variable crt_PT_970224_Misc_2, signal Misc_2" RAT_FUNC "%6" "" COEFFS 0 1 -0.0 0 0 0.001 /end COMPU_METHOD
/* Measurement point for signal Misc_1 of frame RT_DL1MK3_Misc_1, 9896228 (0x970124) */
/begin MEASUREMENT crt_PT_970124_Misc_1 "signal Misc_1 of frame RT_DL1MK3_Misc_1, 9896228 (0x970124)" UWORD CONV_crt_PT_970124_Misc_1 0.001 100.0 0.0 0.0 ECU_ADDRESS 0x0000 /end MEASUREMENT
/begin COMPU_METHOD CONV_crt_PT_970124_Misc_1 "Linear scaling, used for variable crt_PT_970124_Misc_1, signal Misc_1" RAT_FUNC "%6" "" COEFFS 0 1 -0.0 0 0 0.001 /end COMPU_METHOD
/* Measurement point for signal AUX_31 of frame RT_DL1MK3_Aux_31, 9707300 (0x941f24) */
/begin MEASUREMENT crt_PT_941f24_AUX_31 "signal AUX_31 of frame RT_DL1MK3_Aux_31, 9707300 (0x941f24)" UWORD CONV_crt_PT_941f24_AUX_31 0.1 100.0 0.0 0.0 ECU_ADDRESS 0x0000 /end MEASUREMENT
/begin COMPU_METHOD CONV_crt_PT_941f24_AUX_31 "Linear scaling, used for variable crt_PT_941f24_AUX_31, signal AUX_31" RAT_FUNC "%6" "" COEFFS 0 1 -0.0 0 0 0.1 /end COMPU_METHOD
/* Measurement point for signal AUX_30 of frame RT_DL1MK3_Aux_30, 9707044 (0x941e24) */
/begin MEASUREMENT crt_PT_941e24_AUX_30 "signal AUX_30 of frame RT_DL1MK3_Aux_30, 9707044 (0x941e24)" UWORD CONV_crt_PT_941e24_AUX_30 0.1 100.0 0.0 0.0 ECU_ADDRESS 0x0000 /end MEASUREMENT
/begin COMPU_METHOD CONV_crt_PT_941e24_AUX_30 "Linear scaling, used for variable crt_PT_941e24_AUX_30, signal AUX_30" RAT_FUNC "%6" "" COEFFS 0 1 -0.0 0 0 0.1 /end COMPU_METHOD
/* Measurement point for signal AUX_29 of frame RT_DL1MK3_Aux_29, 9706788 (0x941d24) */
/begin MEASUREMENT crt_PT_941d24_AUX_29 "signal AUX_29 of frame RT_DL1MK3_Aux_29, 9706788 (0x941d24)" UWORD CONV_crt_PT_941d24_AUX_29 0.1 100.0 0.0 0.0 ECU_ADDRESS 0x0000 /end MEASUREMENT
/begin COMPU_METHOD CONV_crt_PT_941d24_AUX_29 "Linear scaling, used for variable crt_PT_941d24_AUX_29, signal AUX_29" RAT_FUNC "%6" "" COEFFS 0 1 -0.0 0 0 0.1 /end COMPU_METHOD
/* Measurement point for signal AUX_28 of frame RT_DL1MK3_Aux_28, 9706532 (0x941c24) */
/begin MEASUREMENT crt_PT_941c24_AUX_28 "signal AUX_28 of frame RT_DL1MK3_Aux_28, 9706532 (0x941c24)" UWORD CONV_crt_PT_941c24_AUX_28 0.1 100.0 0.0 0.0 ECU_ADDRESS 0x0000 /end MEASUREMENT
/begin COMPU_METHOD CONV_crt_PT_941c24_AUX_28 "Linear scaling, used for variable crt_PT_941c24_AUX_28, signal AUX_28" RAT_FUNC "%6" "" COEFFS 0 1 -0.0 0 0 0.1 /end COMPU_METHOD
/* Measurement point for signal AUX_27 of frame RT_DL1MK3_Aux_27, 9706276 (0x941b24) */
/begin MEASUREMENT crt_PT_941b24_AUX_27 "signal AUX_27 of frame RT_DL1MK3_Aux_27, 9706276 (0x941b24)" UWORD CONV_crt_PT_941b24_AUX_27 0.1 100.0 0.0 0.0 ECU_ADDRESS 0x0000 /end MEASUREMENT
/begin COMPU_METHOD CONV_crt_PT_941b24_AUX_27 "Linear scaling, used for variable crt_PT_941b24_AUX_27, signal AUX_27" RAT_FUNC "%6" "" COEFFS 0 1 -0.0 0 0 0.1 /end COMPU_METHOD
/* Measurement point for signal AUX_26 of frame RT_DL1MK3_Aux_26, 9706020 (0x941a24) */
/begin MEASUREMENT crt_PT_941a24_AUX_26 "signal AUX_26 of frame RT_DL1MK3_Aux_26, 9706020 (0x941a24)" UWORD CONV_crt_PT_941a24_AUX_26 0.1 100.0 0.0 0.0 ECU_ADDRESS 0x0000 /end MEASUREMENT
/begin COMPU_METHOD CONV_crt_PT_941a24_AUX_26 "Linear scaling, used for variable crt_PT_941a24_AUX_26, signal AUX_26" RAT_FUNC "%6" "" COEFFS 0 1 -0.0 0 0 0.1 /end COMPU_METHOD
/* Measurement point for signal AUX_25 of frame RT_DL1MK3_Aux_25, 9705764 (0x941924) */
/begin MEASUREMENT crt_PT_941924_AUX_25 "signal AUX_25 of frame RT_DL1MK3_Aux_25, 9705764 (0x941924)" UWORD CONV_crt_PT_941924_AUX_25 0.1 100.0 0.0 0.0 ECU_ADDRESS 0x0000 /end MEASUREMENT
/begin COMPU_METHOD CONV_crt_PT_941924_AUX_25 "Linear scaling, used for variable crt_PT_941924_AUX_25, signal AUX_25" RAT_FUNC "%6" "" COEFFS 0 1 -0.0 0 0 0.1 /end COMPU_METHOD
/* Measurement point for signal AUX_24 of frame RT_DL1MK3_Aux_24, 9705508 (0x941824) */
/begin MEASUREMENT crt_PT_941824_AUX_24 "signal AUX_24 of frame RT_DL1MK3_Aux_24, 9705508 (0x941824)" UWORD CONV_crt_PT_941824_AUX_24 0.1 100.0 0.0 0.0 ECU_ADDRESS 0x0000 /end MEASUREMENT
/begin COMPU_METHOD CONV_crt_PT_941824_AUX_24 "Linear scaling, used for variable crt_PT_941824_AUX_24, signal AUX_24" RAT_FUNC "%6" "" COEFFS 0 1 -0.0 0 0 0.1 /end COMPU_METHOD
/* Measurement point for signal AUX_23 of frame RT_DL1MK3_Aux_23, 9705252 (0x941724) */
/begin MEASUREMENT crt_PT_941724_AUX_23 "signal AUX_23 of frame RT_DL1MK3_Aux_23, 9705252 (0x941724)" UWORD CONV_crt_PT_941724_AUX_23 0.1 100.0 0.0 0.0 ECU_ADDRESS 0x0000 /end MEASUREMENT
/begin COMPU_METHOD CONV_crt_PT_941724_AUX_23 "Linear scaling, used for variable crt_PT_941724_AUX_23, signal AUX_23" RAT_FUNC "%6" "" COEFFS 0 1 -0.0 0 0 0.1 /end COMPU_METHOD
/* Measurement point for signal AUX_22 of frame RT_DL1MK3_Aux_22, 9704996 (0x941624) */
/begin MEASUREMENT crt_PT_941624_AUX_22 "signal AUX_22 of frame RT_DL1MK3_Aux_22, 9704996 (0x941624)" UWORD CONV_crt_PT_941624_AUX_22 10.0 100.0 0.0 0.0 ECU_ADDRESS 0x0000 /end MEASUREMENT
/begin COMPU_METHOD CONV_crt_PT_941624_AUX_22 "Linear scaling, used for variable crt_PT_941624_AUX_22, signal AUX_22" RAT_FUNC "%6" "" COEFFS 0 1 -0.0 0 0 10.0 /end COMPU_METHOD
/* Measurement point for signal AUX_21 of frame RT_DL1MK3_Aux_21, 9704740 (0x941524) */
/begin MEASUREMENT crt_PT_941524_AUX_21 "signal AUX_21 of frame RT_DL1MK3_Aux_21, 9704740 (0x941524)" UWORD CONV_crt_PT_941524_AUX_21 0.1 100.0 0.0 0.0 ECU_ADDRESS 0x0000 /end MEASUREMENT
/begin COMPU_METHOD CONV_crt_PT_941524_AUX_21 "Linear scaling, used for variable crt_PT_941524_AUX_21, signal AUX_21" RAT_FUNC "%6" "" COEFFS 0 1 -0.0 0 0 0.1 /end COMPU_METHOD
/* Measurement point for signal AUX_20 of frame RT_DL1MK3_Aux_20, 9704484 (0x941424) */
/begin MEASUREMENT crt_PT_941424_AUX_20 "signal AUX_20 of frame RT_DL1MK3_Aux_20, 9704484 (0x941424)" UWORD CONV_crt_PT_941424_AUX_20 0.1 100.0 0.0 0.0 ECU_ADDRESS 0x0000 /end MEASUREMENT
/begin COMPU_METHOD CONV_crt_PT_941424_AUX_20 "Linear scaling, used for variable crt_PT_941424_AUX_20, signal AUX_20" RAT_FUNC "%6" "" COEFFS 0 1 -0.0 0 0 0.1 /end COMPU_METHOD
/* Measurement point for signal AUX_19 of frame RT_DL1MK3_Aux_19, 9704228 (0x941324) */
/begin MEASUREMENT crt_PT_941324_AUX_19 "signal AUX_19 of frame RT_DL1MK3_Aux_19, 9704228 (0x941324)" UWORD CONV_crt_PT_941324_AUX_19 0.1 100.0 0.0 0.0 ECU_ADDRESS 0x0000 /end MEASUREMENT
/begin COMPU_METHOD CONV_crt_PT_941324_AUX_19 "Linear scaling, used for variable crt_PT_941324_AUX_19, signal AUX_19" RAT_FUNC "%6" "" COEFFS 0 1 -0.0 0 0 0.1 /end COMPU_METHOD
/* Measurement point for signal AUX_18 of frame RT_DL1MK3_Aux_18, 9703972 (0x941224) */
/begin MEASUREMENT crt_PT_941224_AUX_18 "signal AUX_18 of frame RT_DL1MK3_Aux_18, 9703972 (0x941224)" UWORD CONV_crt_PT_941224_AUX_18 0.1 100.0 0.0 0.0 ECU_ADDRESS 0x0000 /end MEASUREMENT
/begin COMPU_METHOD CONV_crt_PT_941224_AUX_18 "Linear scaling, used for variable crt_PT_941224_AUX_18, signal AUX_18" RAT_FUNC "%6" "" COEFFS 0 1 -0.0 0 0 0.1 /end COMPU_METHOD
/* Measurement point for signal AUX_17 of frame RT_DL1MK3_Aux_17, 9703716 (0x941124) */
/begin MEASUREMENT crt_PT_941124_AUX_17 "signal AUX_17 of frame RT_DL1MK3_Aux_17, 9703716 (0x941124)" UWORD CONV_crt_PT_941124_AUX_17 0.1 100.0 0.0 0.0 ECU_ADDRESS 0x0000 /end MEASUREMENT
/begin COMPU_METHOD CONV_crt_PT_941124_AUX_17 "Linear scaling, used for variable crt_PT_941124_AUX_17, signal AUX_17" RAT_FUNC "%6" "" COEFFS 0 1 -0.0 0 0 0.1 /end COMPU_METHOD
/* Measurement point for signal AUX_16 of frame RT_DL1MK3_Aux_16, 9703460 (0x941024) */
/begin MEASUREMENT crt_PT_941024_AUX_16 "signal AUX_16 of frame RT_DL1MK3_Aux_16, 9703460 (0x941024)" UWORD CONV_crt_PT_941024_AUX_16 0.1 100.0 0.0 0.0 ECU_ADDRESS 0x0000 /end MEASUREMENT
/begin COMPU_METHOD CONV_crt_PT_941024_AUX_16 "Linear scaling, used for variable crt_PT_941024_AUX_16, signal AUX_16" RAT_FUNC "%6" "" COEFFS 0 1 -0.0 0 0 0.1 /end COMPU_METHOD
/* Measurement point for signal AUX_15 of frame RT_DL1MK3_Aux_15, 9703204 (0x940f24) */
/begin MEASUREMENT crt_PT_940f24_AUX_15 "signal AUX_15 of frame RT_DL1MK3_Aux_15, 9703204 (0x940f24)" UWORD CONV_crt_PT_940f24_AUX_15 0.1 100.0 0.0 0.0 ECU_ADDRESS 0x0000 /end MEASUREMENT
/begin COMPU_METHOD CONV_crt_PT_940f24_AUX_15 "Linear scaling, used for variable crt_PT_940f24_AUX_15, signal AUX_15" RAT_FUNC "%6" "" COEFFS 0 1 -0.0 0 0 0.1 /end COMPU_METHOD
/* Measurement point for signal AUX_14 of frame RT_DL1MK3_Aux_14, 9702948 (0x940e24) */
/begin MEASUREMENT crt_PT_940e24_AUX_14 "signal AUX_14 of frame RT_DL1MK3_Aux_14, 9702948 (0x940e24)" UWORD CONV_crt_PT_940e24_AUX_14 0.1 100.0 0.0 0.0 ECU_ADDRESS 0x0000 /end MEASUREMENT
/begin COMPU_METHOD CONV_crt_PT_940e24_AUX_14 "Linear scaling, used for variable crt_PT_940e24_AUX_14, signal AUX_14" RAT_FUNC "%6" "" COEFFS 0 1 -0.0 0 0 0.1 /end COMPU_METHOD
/* Measurement point for signal AUX_13 of frame RT_DL1MK3_Aux_13, 9702692 (0x940d24) */
/begin MEASUREMENT crt_PT_940d24_AUX_13 "signal AUX_13 of frame RT_DL1MK3_Aux_13, 9702692 (0x940d24)" UWORD CONV_crt_PT_940d24_AUX_13 0.1 100.0 0.0 0.0 ECU_ADDRESS 0x0000 /end MEASUREMENT
/begin COMPU_METHOD CONV_crt_PT_940d24_AUX_13 "Linear scaling, used for variable crt_PT_940d24_AUX_13, signal AUX_13" RAT_FUNC "%6" "" COEFFS 0 1 -0.0 0 0 0.1 /end COMPU_METHOD
/* Measurement point for signal AUX_12 of frame RT_DL1MK3_Aux_12, 9702436 (0x940c24) */
/begin MEASUREMENT crt_PT_940c24_AUX_12 "signal AUX_12 of frame RT_DL1MK3_Aux_12, 9702436 (0x940c24)" UWORD CONV_crt_PT_940c24_AUX_12 0.1 100.0 0.0 0.0 ECU_ADDRESS 0x0000 /end MEASUREMENT
/begin COMPU_METHOD CONV_crt_PT_940c24_AUX_12 "Linear scaling, used for variable crt_PT_940c24_AUX_12, signal AUX_12" RAT_FUNC "%6" "" COEFFS 0 1 -0.0 0 0 0.1 /end COMPU_METHOD
/* Measurement point for signal AUX_11 of frame RT_DL1MK3_Aux_11, 9702180 (0x940b24) */
/begin MEASUREMENT crt_PT_940b24_AUX_11 "signal AUX_11 of frame RT_DL1MK3_Aux_11, 9702180 (0x940b24)" UWORD CONV_crt_PT_940b24_AUX_11 0.1 100.0 0.0 0.0 ECU_ADDRESS 0x0000 /end MEASUREMENT
/begin COMPU_METHOD CONV_crt_PT_940b24_AUX_11 "Linear scaling, used for variable crt_PT_940b24_AUX_11, signal AUX_11" RAT_FUNC "%6" "" COEFFS 0 1 -0.0 0 0 0.1 /end COMPU_METHOD
/* Measurement point for signal AUX_9 of frame RT_DL1MK3_Aux_9, 9701668 (0x940924) */
/begin MEASUREMENT crt_PT_940924_AUX_9 "signal AUX_9 of frame RT_DL1MK3_Aux_9, 9701668 (0x940924)" UWORD CONV_crt_PT_940924_AUX_9 0.1 100.0 0.0 0.0 ECU_ADDRESS 0x0000 /end MEASUREMENT
/begin COMPU_METHOD CONV_crt_PT_940924_AUX_9 "Linear scaling, used for variable crt_PT_940924_AUX_9, signal AUX_9" RAT_FUNC "%6" "" COEFFS 0 1 -0.0 0 0 0.1 /end COMPU_METHOD
/* Measurement point for signal AUX_10 of frame RT_DL1MK3_Aux_10, 9701924 (0x940a24) */
/begin MEASUREMENT crt_PT_940a24_AUX_10 "signal AUX_10 of frame RT_DL1MK3_Aux_10, 9701924 (0x940a24)" UWORD CONV_crt_PT_940a24_AUX_10 0.1 100.0 0.0 0.0 ECU_ADDRESS 0x0000 /end MEASUREMENT
/begin COMPU_METHOD CONV_crt_PT_940a24_AUX_10 "Linear scaling, used for variable crt_PT_940a24_AUX_10, signal AUX_10" RAT_FUNC "%6" "" COEFFS 0 1 -0.0 0 0 0.1 /end COMPU_METHOD
/* Measurement point for signal AUX_8 of frame RT_DL1MK3_Aux_8, 9701412 (0x940824) */
/begin MEASUREMENT crt_PT_940824_AUX_8 "signal AUX_8 of frame RT_DL1MK3_Aux_8, 9701412 (0x940824)" UWORD CONV_crt_PT_940824_AUX_8 0.1 100.0 0.0 0.0 ECU_ADDRESS 0x0000 /end MEASUREMENT
/begin COMPU_METHOD CONV_crt_PT_940824_AUX_8 "Linear scaling, used for variable crt_PT_940824_AUX_8, signal AUX_8" RAT_FUNC "%6" "" COEFFS 0 1 -0.0 0 0 0.1 /end COMPU_METHOD
/* Measurement point for signal AUX_7 of frame RT_DL1MK3_Aux_7, 9701156 (0x940724) */
/begin MEASUREMENT crt_PT_940724_AUX_7 "signal AUX_7 of frame RT_DL1MK3_Aux_7, 9701156 (0x940724)" UWORD CONV_crt_PT_940724_AUX_7 0.1 100.0 0.0 0.0 ECU_ADDRESS 0x0000 /end MEASUREMENT
/begin COMPU_METHOD CONV_crt_PT_940724_AUX_7 "Linear scaling, used for variable crt_PT_940724_AUX_7, signal AUX_7" RAT_FUNC "%6" "" COEFFS 0 1 -0.0 0 0 0.1 /end COMPU_METHOD
/* Measurement point for signal AUX_6 of frame RT_DL1MK3_Aux_6, 9700900 (0x940624) */
/begin MEASUREMENT crt_PT_940624_AUX_6 "signal AUX_6 of frame RT_DL1MK3_Aux_6, 9700900 (0x940624)" UWORD CONV_crt_PT_940624_AUX_6 0.1 100.0 0.0 0.0 ECU_ADDRESS 0x0000 /end MEASUREMENT
/begin COMPU_METHOD CONV_crt_PT_940624_AUX_6 "Linear scaling, used for variable crt_PT_940624_AUX_6, signal AUX_6" RAT_FUNC "%6" "" COEFFS 0 1 -0.0 0 0 0.1 /end COMPU_METHOD
/* Measurement point for signal AUX_5 of frame RT_DL1MK3_Aux_5, 9700644 (0x940524) */
/begin MEASUREMENT crt_PT_940524_AUX_5 "signal AUX_5 of frame RT_DL1MK3_Aux_5, 9700644 (0x940524)" UWORD CONV_crt_PT_940524_AUX_5 0.1 100.0 0.0 0.0 ECU_ADDRESS 0x0000 /end MEASUREMENT
/begin COMPU_METHOD CONV_crt_PT_940524_AUX_5 "Linear scaling, used for variable crt_PT_940524_AUX_5, signal AUX_5" RAT_FUNC "%6" "" COEFFS 0 1 -0.0 0 0 0.1 /end COMPU_METHOD
/* Measurement point for signal AUX_4 of frame RT_DL1MK3_Aux_4, 9700388 (0x940424) */
/begin MEASUREMENT crt_PT_940424_AUX_4 "signal AUX_4 of frame RT_DL1MK3_Aux_4, 9700388 (0x940424)" UWORD CONV_crt_PT_940424_AUX_4 0.1 100.0 0.0 0.0 ECU_ADDRESS 0x0000 /end MEASUREMENT
/begin COMPU_METHOD CONV_crt_PT_940424_AUX_4 "Linear scaling, used for variable crt_PT_940424_AUX_4, signal AUX_4" RAT_FUNC "%6" "" COEFFS 0 1 -0.0 0 0 0.1 /end COMPU_METHOD
/* Measurement point for signal AUX_3 of frame RT_DL1MK3_Aux_3, 9700132 (0x940324) */
/begin MEASUREMENT crt_PT_940324_AUX_3 "signal AUX_3 of frame RT_DL1MK3_Aux_3, 9700132 (0x940324)" UWORD CONV_crt_PT_940324_AUX_3 0.1 100.0 0.0 0.0 ECU_ADDRESS 0x0000 /end MEASUREMENT
/begin COMPU_METHOD CONV_crt_PT_940324_AUX_3 "Linear scaling, used for variable crt_PT_940324_AUX_3, signal AUX_3" RAT_FUNC "%6" "" COEFFS 0 1 -0.0 0 0 0.1 /end COMPU_METHOD
/* Measurement point for signal AUX_2 of frame RT_DL1MK3_Aux_2, 9699876 (0x940224) */
/begin MEASUREMENT crt_PT_940224_AUX_2 "signal AUX_2 of frame RT_DL1MK3_Aux_2, 9699876 (0x940224)" UWORD CONV_crt_PT_940224_AUX_2 0.1 100.0 0.0 0.0 ECU_ADDRESS 0x0000 /end MEASUREMENT
/begin COMPU_METHOD CONV_crt_PT_940224_AUX_2 "Linear scaling, used for variable crt_PT_940224_AUX_2, signal AUX_2" RAT_FUNC "%6" "" COEFFS 0 1 -0.0 0 0 0.1 /end COMPU_METHOD
/* Measurement point for signal AUX_1 of frame RT_DL1MK3_Aux_1, 9699620 (0x940124) */
/begin MEASUREMENT crt_PT_940124_AUX_1 "signal AUX_1 of frame RT_DL1MK3_Aux_1, 9699620 (0x940124)" UWORD CONV_crt_PT_940124_AUX_1 0.1 100.0 0.0 0.0 ECU_ADDRESS 0x0000 /end MEASUREMENT
/begin COMPU_METHOD CONV_crt_PT_940124_AUX_1 "Linear scaling, used for variable crt_PT_940124_AUX_1, signal AUX_1" RAT_FUNC "%6" "" COEFFS 0 1 -0.0 0 0 0.1 /end COMPU_METHOD
/* Measurement point for signal Pressure_5 of frame RT_DL1MK3_Pressure_5, 9438500 (0x900524) */
/begin MEASUREMENT crt_PT_900524_Pressure_5 "signal Pressure_5 of frame RT_DL1MK3_Pressure_5, 9438500 (0x900524)" ULONG CONV_crt_PT_900524_Pressure_5 0.1 100.0 0.0 0.0 ECU_ADDRESS 0x0000 /end MEASUREMENT
/begin COMPU_METHOD CONV_crt_PT_900524_Pressure_5 "Linear scaling, used for variable crt_PT_900524_Pressure_5, signal Pressure_5" RAT_FUNC "%12" "" COEFFS 0 1 -0.0 0 0 0.1 /end COMPU_METHOD
/* Measurement point for signal Pressure_4 of frame RT_DL1MK3_Pressure_4, 9438244 (0x900424) */
/begin MEASUREMENT crt_PT_900424_Pressure_4 "signal Pressure_4 of frame RT_DL1MK3_Pressure_4, 9438244 (0x900424)" ULONG CONV_crt_PT_900424_Pressure_4 0.1 100.0 0.0 0.0 ECU_ADDRESS 0x0000 /end MEASUREMENT
/begin COMPU_METHOD CONV_crt_PT_900424_Pressure_4 "Linear scaling, used for variable crt_PT_900424_Pressure_4, signal Pressure_4" RAT_FUNC "%12" "" COEFFS 0 1 -0.0 0 0 0.1 /end COMPU_METHOD
/* Measurement point for signal Pressure_3 of frame RT_DL1MK3_Pressure_3, 9437988 (0x900324) */
/begin MEASUREMENT crt_PT_900324_Pressure_3 "signal Pressure_3 of frame RT_DL1MK3_Pressure_3, 9437988 (0x900324)" ULONG CONV_crt_PT_900324_Pressure_3 0.1 100.0 0.0 0.0 ECU_ADDRESS 0x0000 /end MEASUREMENT
/begin COMPU_METHOD CONV_crt_PT_900324_Pressure_3 "Linear scaling, used for variable crt_PT_900324_Pressure_3, signal Pressure_3" RAT_FUNC "%12" "" COEFFS 0 1 -0.0 0 0 0.1 /end COMPU_METHOD
/* Measurement point for signal Pressure_2 of frame RT_DL1MK3_Pressure_2, 9437732 (0x900224) */
/begin MEASUREMENT crt_PT_900224_Pressure_2 "signal Pressure_2 of frame RT_DL1MK3_Pressure_2, 9437732 (0x900224)" ULONG CONV_crt_PT_900224_Pressure_2 0.1 100.0 0.0 0.0 ECU_ADDRESS 0x0000 /end MEASUREMENT
/begin COMPU_METHOD CONV_crt_PT_900224_Pressure_2 "Linear scaling, used for variable crt_PT_900224_Pressure_2, signal Pressure_2" RAT_FUNC "%12" "" COEFFS 0 1 -0.0 0 0 0.1 /end COMPU_METHOD
/* Measurement point for signal Pressure_1 of frame RT_DL1MK3_Pressure_1, 9437476 (0x900124) */
/begin MEASUREMENT crt_PT_900124_Pressure_1 "signal Pressure_1 of frame RT_DL1MK3_Pressure_1, 9437476 (0x900124)" ULONG CONV_crt_PT_900124_Pressure_1 0.1 100.0 0.0 0.0 ECU_ADDRESS 0x0000 /end MEASUREMENT
/begin COMPU_METHOD CONV_crt_PT_900124_Pressure_1 "Linear scaling, used for variable crt_PT_900124_Pressure_1, signal Pressure_1" RAT_FUNC "%12" "" COEFFS 0 1 -0.0 0 0 0.1 /end COMPU_METHOD
/* Measurement point for signal Angle_3 of frame RT_DL1MK3_Angle_3, 9569060 (0x920324) */
/begin MEASUREMENT crt_PT_920324_Angle_3 "signal Angle_3 of frame RT_DL1MK3_Angle_3, 9569060 (0x920324)" SWORD CONV_crt_PT_920324_Angle_3 0.1 100.0 0.0 0.0 ECU_ADDRESS 0x0000 /end MEASUREMENT
/begin COMPU_METHOD CONV_crt_PT_920324_Angle_3 "Linear scaling, used for variable crt_PT_920324_Angle_3, signal Angle_3" RAT_FUNC "%6" "" COEFFS 0 1 -0.0 0 0 0.1 /end COMPU_METHOD
/* Measurement point for signal Angle_2 of frame RT_DL1MK3_Angle_2, 9568804 (0x920224) */
/begin MEASUREMENT crt_PT_920224_Angle_2 "signal Angle_2 of frame RT_DL1MK3_Angle_2, 9568804 (0x920224)" SWORD CONV_crt_PT_920224_Angle_2 0.1 100.0 0.0 0.0 ECU_ADDRESS 0x0000 /end MEASUREMENT
/begin COMPU_METHOD CONV_crt_PT_920224_Angle_2 "Linear scaling, used for variable crt_PT_920224_Angle_2, signal Angle_2" RAT_FUNC "%6" "" COEFFS 0 1 -0.0 0 0 0.1 /end COMPU_METHOD
/* Measurement point for signal Angle_1 of frame RT_DL1MK3_Angle_1, 9568548 (0x920124) */
/begin MEASUREMENT crt_PT_920124_Angle_1 "signal Angle_1 of frame RT_DL1MK3_Angle_1, 9568548 (0x920124)" SWORD CONV_crt_PT_920124_Angle_1 0.1 100.0 0.0 0.0 ECU_ADDRESS 0x0000 /end MEASUREMENT
/begin COMPU_METHOD CONV_crt_PT_920124_Angle_1 "Linear scaling, used for variable crt_PT_920124_Angle_1, signal Angle_1" RAT_FUNC "%6" "" COEFFS 0 1 -0.0 0 0 0.1 /end COMPU_METHOD
/* Measurement point for signal Temperature_25 of frame RT_DL1MK3_Temp_25, 9509156 (0x911924) */
/begin MEASUREMENT crt_PT_911924_Temperature_25 "signal Temperature_25 of frame RT_DL1MK3_Temp_25, 9509156 (0x911924)" SWORD CONV_crt_PT_911924_Temperature_25 0.1 100.0 0.0 0.0 ECU_ADDRESS 0x0000 /end MEASUREMENT
/begin COMPU_METHOD CONV_crt_PT_911924_Temperature_25 "Linear scaling, used for variable crt_PT_911924_Temperature_25, signal Temperature_25" RAT_FUNC "%6" "" COEFFS 0 1 -0.0 0 0 0.1 /end COMPU_METHOD
/* Measurement point for signal Temperature_24 of frame RT_DL1MK3_Temp_24, 9508900 (0x911824) */
/begin MEASUREMENT crt_PT_911824_Temperature_24 "signal Temperature_24 of frame RT_DL1MK3_Temp_24, 9508900 (0x911824)" SWORD CONV_crt_PT_911824_Temperature_24 0.1 100.0 0.0 0.0 ECU_ADDRESS 0x0000 /end MEASUREMENT
/begin COMPU_METHOD CONV_crt_PT_911824_Temperature_24 "Linear scaling, used for variable crt_PT_911824_Temperature_24, signal Temperature_24" RAT_FUNC "%6" "" COEFFS 0 1 -0.0 0 0 0.1 /end COMPU_METHOD
/* Measurement point for signal Temperature_23 of frame RT_DL1MK3_Temp_23, 9508644 (0x911724) */
/begin MEASUREMENT crt_PT_911724_Temperature_23 "signal Temperature_23 of frame RT_DL1MK3_Temp_23, 9508644 (0x911724)" SWORD CONV_crt_PT_911724_Temperature_23 0.1 100.0 0.0 0.0 ECU_ADDRESS 0x0000 /end MEASUREMENT
/begin COMPU_METHOD CONV_crt_PT_911724_Temperature_23 "Linear scaling, used for variable crt_PT_911724_Temperature_23, signal Temperature_23" RAT_FUNC "%6" "" COEFFS 0 1 -0.0 0 0 0.1 /end COMPU_METHOD
/* Measurement point for signal Temperature_22 of frame RT_DL1MK3_Temp_22, 9508388 (0x911624) */
/begin MEASUREMENT crt_PT_911624_Temperature_22 "signal Temperature_22 of frame RT_DL1MK3_Temp_22, 9508388 (0x911624)" SWORD CONV_crt_PT_911624_Temperature_22 0.1 100.0 0.0 0.0 ECU_ADDRESS 0x0000 /end MEASUREMENT
/begin COMPU_METHOD CONV_crt_PT_911624_Temperature_22 "Linear scaling, used for variable crt_PT_911624_Temperature_22, signal Temperature_22" RAT_FUNC "%6" "" COEFFS 0 1 -0.0 0 0 0.1 /end COMPU_METHOD
/* Measurement point for signal Temperature_21 of frame RT_DL1MK3_Temp_21, 9508132 (0x911524) */
/begin MEASUREMENT crt_PT_911524_Temperature_21 "signal Temperature_21 of frame RT_DL1MK3_Temp_21, 9508132 (0x911524)" SWORD CONV_crt_PT_911524_Temperature_21 0.1 100.0 0.0 0.0 ECU_ADDRESS 0x0000 /end MEASUREMENT
/begin COMPU_METHOD CONV_crt_PT_911524_Temperature_21 "Linear scaling, used for variable crt_PT_911524_Temperature_21, signal Temperature_21" RAT_FUNC "%6" "" COEFFS 0 1 -0.0 0 0 0.1 /end COMPU_METHOD
/* Measurement point for signal Temperature_20 of frame RT_DL1MK3_Temp_20, 9507876 (0x911424) */
/begin MEASUREMENT crt_PT_911424_Temperature_20 "signal Temperature_20 of frame RT_DL1MK3_Temp_20, 9507876 (0x911424)" SWORD CONV_crt_PT_911424_Temperature_20 0.1 100.0 0.0 0.0 ECU_ADDRESS 0x0000 /end MEASUREMENT
/begin COMPU_METHOD CONV_crt_PT_911424_Temperature_20 "Linear scaling, used for variable crt_PT_911424_Temperature_20, signal Temperature_20" RAT_FUNC "%6" "" COEFFS 0 1 -0.0 0 0 0.1 /end COMPU_METHOD
/* Measurement point for signal Temperature_19 of frame RT_DL1MK3_Temp_19, 9507620 (0x911324) */
/begin MEASUREMENT crt_PT_911324_Temperature_19 "signal Temperature_19 of frame RT_DL1MK3_Temp_19, 9507620 (0x911324)" SWORD CONV_crt_PT_911324_Temperature_19 0.1 100.0 0.0 0.0 ECU_ADDRESS 0x0000 /end MEASUREMENT
/begin COMPU_METHOD CONV_crt_PT_911324_Temperature_19 "Linear scaling, used for variable crt_PT_911324_Temperature_19, signal Temperature_19" RAT_FUNC "%6" "" COEFFS 0 1 -0.0 0 0 0.1 /end COMPU_METHOD
/* Measurement point for signal Temperature_18 of frame RT_DL1MK3_Temp_18, 9507364 (0x911224) */
/begin MEASUREMENT crt_PT_911224_Temperature_18 "signal Temperature_18 of frame RT_DL1MK3_Temp_18, 9507364 (0x911224)" SWORD CONV_crt_PT_911224_Temperature_18 0.1 100.0 0.0 0.0 ECU_ADDRESS 0x0000 /end MEASUREMENT
/begin COMPU_METHOD CONV_crt_PT_911224_Temperature_18 "Linear scaling, used for variable crt_PT_911224_Temperature_18, signal Temperature_18" RAT_FUNC "%6" "" COEFFS 0 1 -0.0 0 0 0.1 /end COMPU_METHOD
/* Measurement point for signal Temperature_17 of frame RT_DL1MK3_Temp_17, 9507108 (0x911124) */
/begin MEASUREMENT crt_PT_911124_Temperature_17 "signal Temperature_17 of frame RT_DL1MK3_Temp_17, 9507108 (0x911124)" SWORD CONV_crt_PT_911124_Temperature_17 0.1 100.0 0.0 0.0 ECU_ADDRESS 0x0000 /end MEASUREMENT
/begin COMPU_METHOD CONV_crt_PT_911124_Temperature_17 "Linear scaling, used for variable crt_PT_911124_Temperature_17, signal Temperature_17" RAT_FUNC "%6" "" COEFFS 0 1 -0.0 0 0 0.1 /end COMPU_METHOD
/* Measurement point for signal Temperature_16 of frame RT_DL1MK3_Temp_16, 9506852 (0x911024) */
/begin MEASUREMENT crt_PT_911024_Temperature_16 "signal Temperature_16 of frame RT_DL1MK3_Temp_16, 9506852 (0x911024)" SWORD CONV_crt_PT_911024_Temperature_16 0.1 100.0 0.0 0.0 ECU_ADDRESS 0x0000 /end MEASUREMENT
/begin COMPU_METHOD CONV_crt_PT_911024_Temperature_16 "Linear scaling, used for variable crt_PT_911024_Temperature_16, signal Temperature_16" RAT_FUNC "%6" "" COEFFS 0 1 -0.0 0 0 0.1 /end COMPU_METHOD
/* Measurement point for signal Temperature_15 of frame RT_DL1MK3_Temp_15, 9506596 (0x910f24) */
/begin MEASUREMENT crt_PT_910f24_Temperature_15 "signal Temperature_15 of frame RT_DL1MK3_Temp_15, 9506596 (0x910f24)" SWORD CONV_crt_PT_910f24_Temperature_15 0.1 100.0 0.0 0.0 ECU_ADDRESS 0x0000 /end MEASUREMENT
/begin COMPU_METHOD CONV_crt_PT_910f24_Temperature_15 "Linear scaling, used for variable crt_PT_910f24_Temperature_15, signal Temperature_15" RAT_FUNC "%6" "" COEFFS 0 1 -0.0 0 0 0.1 /end COMPU_METHOD
/* Measurement point for signal Temperature_14 of frame RT_DL1MK3_Temp_14, 9506340 (0x910e24) */
/begin MEASUREMENT crt_PT_910e24_Temperature_14 "signal Temperature_14 of frame RT_DL1MK3_Temp_14, 9506340 (0x910e24)" SWORD CONV_crt_PT_910e24_Temperature_14 0.1 100.0 0.0 0.0 ECU_ADDRESS 0x0000 /end MEASUREMENT
/begin COMPU_METHOD CONV_crt_PT_910e24_Temperature_14 "Linear scaling, used for variable crt_PT_910e24_Temperature_14, signal Temperature_14" RAT_FUNC "%6" "" COEFFS 0 1 -0.0 0 0 0.1 /end COMPU_METHOD
/* Measurement point for signal Temperature_13 of frame RT_DL1MK3_Temp_13, 9506084 (0x910d24) */
/begin MEASUREMENT crt_PT_910d24_Temperature_13 "signal Temperature_13 of frame RT_DL1MK3_Temp_13, 9506084 (0x910d24)" SWORD CONV_crt_PT_910d24_Temperature_13 0.1 100.0 0.0 0.0 ECU_ADDRESS 0x0000 /end MEASUREMENT
/begin COMPU_METHOD CONV_crt_PT_910d24_Temperature_13 "Linear scaling, used for variable crt_PT_910d24_Temperature_13, signal Temperature_13" RAT_FUNC "%6" "" COEFFS 0 1 -0.0 0 0 0.1 /end COMPU_METHOD
/* Measurement point for signal Temperature_12 of frame RT_DL1MK3_Temp_12, 9505828 (0x910c24) */
/begin MEASUREMENT crt_PT_910c24_Temperature_12 "signal Temperature_12 of frame RT_DL1MK3_Temp_12, 9505828 (0x910c24)" SWORD CONV_crt_PT_910c24_Temperature_12 0.1 100.0 0.0 0.0 ECU_ADDRESS 0x0000 /end MEASUREMENT
/begin COMPU_METHOD CONV_crt_PT_910c24_Temperature_12 "Linear scaling, used for variable crt_PT_910c24_Temperature_12, signal Temperature_12" RAT_FUNC "%6" "" COEFFS 0 1 -0.0 0 0 0.1 /end COMPU_METHOD
/* Measurement point for signal Temperature_11 of frame RT_DL1MK3_Temp_11, 9505572 (0x910b24) */
/begin MEASUREMENT crt_PT_910b24_Temperature_11 "signal Temperature_11 of frame RT_DL1MK3_Temp_11, 9505572 (0x910b24)" SWORD CONV_crt_PT_910b24_Temperature_11 0.1 100.0 0.0 0.0 ECU_ADDRESS 0x0000 /end MEASUREMENT
/begin COMPU_METHOD CONV_crt_PT_910b24_Temperature_11 "Linear scaling, used for variable crt_PT_910b24_Temperature_11, signal Temperature_11" RAT_FUNC "%6" "" COEFFS 0 1 -0.0 0 0 0.1 /end COMPU_METHOD
/* Measurement point for signal Temperature_10 of frame RT_DL1MK3_Temp_10, 9505316 (0x910a24) */
/begin MEASUREMENT crt_PT_910a24_Temperature_10 "signal Temperature_10 of frame RT_DL1MK3_Temp_10, 9505316 (0x910a24)" SWORD CONV_crt_PT_910a24_Temperature_10 0.1 100.0 0.0 0.0 ECU_ADDRESS 0x0000 /end MEASUREMENT
/begin COMPU_METHOD CONV_crt_PT_910a24_Temperature_10 "Linear scaling, used for variable crt_PT_910a24_Temperature_10, signal Temperature_10" RAT_FUNC "%6" "" COEFFS 0 1 -0.0 0 0 0.1 /end COMPU_METHOD
/* Measurement point for signal Temperature_9 of frame RT_DL1MK3_Temp_9, 9505060 (0x910924) */
/begin MEASUREMENT crt_PT_910924_Temperature_9 "signal Temperature_9 of frame RT_DL1MK3_Temp_9, 9505060 (0x910924)" SWORD CONV_crt_PT_910924_Temperature_9 0.1 100.0 0.0 0.0 ECU_ADDRESS 0x0000 /end MEASUREMENT
/begin COMPU_METHOD CONV_crt_PT_910924_Temperature_9 "Linear scaling, used for variable crt_PT_910924_Temperature_9, signal Temperature_9" RAT_FUNC "%6" "" COEFFS 0 1 -0.0 0 0 0.1 /end COMPU_METHOD
/* Measurement point for signal Temperature_8 of frame RT_DL1MK3_Temp_8, 9504804 (0x910824) */
/begin MEASUREMENT crt_PT_910824_Temperature_8 "signal Temperature_8 of frame RT_DL1MK3_Temp_8, 9504804 (0x910824)" SWORD CONV_crt_PT_910824_Temperature_8 0.1 100.0 0.0 0.0 ECU_ADDRESS 0x0000 /end MEASUREMENT
/begin COMPU_METHOD CONV_crt_PT_910824_Temperature_8 "Linear scaling, used for variable crt_PT_910824_Temperature_8, signal Temperature_8" RAT_FUNC "%6" "" COEFFS 0 1 -0.0 0 0 0.1 /end COMPU_METHOD
/* Measurement point for signal Temperature_7 of frame RT_DL1MK3_Temp_7, 9504548 (0x910724) */
/begin MEASUREMENT crt_PT_910724_Temperature_7 "signal Temperature_7 of frame RT_DL1MK3_Temp_7, 9504548 (0x910724)" SWORD CONV_crt_PT_910724_Temperature_7 0.1 100.0 0.0 0.0 ECU_ADDRESS 0x0000 /end MEASUREMENT
/begin COMPU_METHOD CONV_crt_PT_910724_Temperature_7 "Linear scaling, used for variable crt_PT_910724_Temperature_7, signal Temperature_7" RAT_FUNC "%6" "" COEFFS 0 1 -0.0 0 0 0.1 /end COMPU_METHOD
/* Measurement point for signal Temperature_6 of frame RT_DL1MK3_Temp_6, 9504292 (0x910624) */
/begin MEASUREMENT crt_PT_910624_Temperature_6 "signal Temperature_6 of frame RT_DL1MK3_Temp_6, 9504292 (0x910624)" SWORD CONV_crt_PT_910624_Temperature_6 0.1 100.0 0.0 0.0 ECU_ADDRESS 0x0000 /end MEASUREMENT
/begin COMPU_METHOD CONV_crt_PT_910624_Temperature_6 "Linear scaling, used for variable crt_PT_910624_Temperature_6, signal Temperature_6" RAT_FUNC "%6" "" COEFFS 0 1 -0.0 0 0 0.1 /end COMPU_METHOD
/* Measurement point for signal Temperature_5 of frame RT_DL1MK3_Temp_5, 9504036 (0x910524) */
/begin MEASUREMENT crt_PT_910524_Temperature_5 "signal Temperature_5 of frame RT_DL1MK3_Temp_5, 9504036 (0x910524)" SWORD CONV_crt_PT_910524_Temperature_5 0.1 100.0 0.0 0.0 ECU_ADDRESS 0x0000 /end MEASUREMENT
/begin COMPU_METHOD CONV_crt_PT_910524_Temperature_5 "Linear scaling, used for variable crt_PT_910524_Temperature_5, signal Temperature_5" RAT_FUNC "%6" "" COEFFS 0 1 -0.0 0 0 0.1 /end COMPU_METHOD
/* Measurement point for signal Temperature_4 of frame RT_DL1MK3_Temp_4, 9503780 (0x910424) */
/begin MEASUREMENT crt_PT_910424_Temperature_4 "signal Temperature_4 of frame RT_DL1MK3_Temp_4, 9503780 (0x910424)" SWORD CONV_crt_PT_910424_Temperature_4 0.1 100.0 0.0 0.0 ECU_ADDRESS 0x0000 /end MEASUREMENT
/begin COMPU_METHOD CONV_crt_PT_910424_Temperature_4 "Linear scaling, used for variable crt_PT_910424_Temperature_4, signal Temperature_4" RAT_FUNC "%6" "" COEFFS 0 1 -0.0 0 0 0.1 /end COMPU_METHOD
/* Measurement point for signal Temperature_3 of frame RT_DL1MK3_Temp_3, 9503524 (0x910324) */
/begin MEASUREMENT crt_PT_910324_Temperature_3 "signal Temperature_3 of frame RT_DL1MK3_Temp_3, 9503524 (0x910324)" SWORD CONV_crt_PT_910324_Temperature_3 0.1 100.0 0.0 0.0 ECU_ADDRESS 0x0000 /end MEASUREMENT
/begin COMPU_METHOD CONV_crt_PT_910324_Temperature_3 "Linear scaling, used for variable crt_PT_910324_Temperature_3, signal Temperature_3" RAT_FUNC "%6" "" COEFFS 0 1 -0.0 0 0 0.1 /end COMPU_METHOD
/* Measurement point for signal Temperature_2 of frame RT_DL1MK3_Temp_2, 9503268 (0x910224) */
/begin MEASUREMENT crt_PT_910224_Temperature_2 "signal Temperature_2 of frame RT_DL1MK3_Temp_2, 9503268 (0x910224)" SWORD CONV_crt_PT_910224_Temperature_2 0.1 100.0 0.0 0.0 ECU_ADDRESS 0x0000 /end MEASUREMENT
/begin COMPU_METHOD CONV_crt_PT_910224_Temperature_2 "Linear scaling, used for variable crt_PT_910224_Temperature_2, signal Temperature_2" RAT_FUNC "%6" "" COEFFS 0 1 -0.0 0 0 0.1 /end COMPU_METHOD
/* Measurement point for signal Temperature_1 of frame RT_DL1MK3_Temp_1, 9503012 (0x910124) */
/begin MEASUREMENT crt_PT_910124_Temperature_1 "signal Temperature_1 of frame RT_DL1MK3_Temp_1, 9503012 (0x910124)" SWORD CONV_crt_PT_910124_Temperature_1 0.1 100.0 0.0 0.0 ECU_ADDRESS 0x0000 /end MEASUREMENT
/begin COMPU_METHOD CONV_crt_PT_910124_Temperature_1 "Linear scaling, used for variable crt_PT_910124_Temperature_1, signal Temperature_1" RAT_FUNC "%6" "" COEFFS 0 1 -0.0 0 0 0.1 /end COMPU_METHOD
/* Measurement point for signal Analog_32 of frame RT_DL1MK3_Analog_32, 8527652 (0x821f24) */
/begin MEASUREMENT crt_PT_821f24_Analog_32 "signal Analog_32 of frame RT_DL1MK3_Analog_32, 8527652 (0x821f24)" UWORD CONV_crt_PT_821f24_Analog_32 0.001 100.0 0.0 0.0 ECU_ADDRESS 0x0000 /end MEASUREMENT
/begin COMPU_METHOD CONV_crt_PT_821f24_Analog_32 "Linear scaling, used for variable crt_PT_821f24_Analog_32, signal Analog_32" RAT_FUNC "%6" "" COEFFS 0 1 -0.0 0 0 0.001 /end COMPU_METHOD
/* Measurement point for signal Analog_31 of frame RT_DL1MK3_Analog_31, 8527396 (0x821e24) */
/begin MEASUREMENT crt_PT_821e24_Analog_31 "signal Analog_31 of frame RT_DL1MK3_Analog_31, 8527396 (0x821e24)" UWORD CONV_crt_PT_821e24_Analog_31 0.001 100.0 0.0 0.0 ECU_ADDRESS 0x0000 /end MEASUREMENT
/begin COMPU_METHOD CONV_crt_PT_821e24_Analog_31 "Linear scaling, used for variable crt_PT_821e24_Analog_31, signal Analog_31" RAT_FUNC "%6" "" COEFFS 0 1 -0.0 0 0 0.001 /end COMPU_METHOD
/* Measurement point for signal Analog_30 of frame RT_DL1MK3_Analog_30, 8527140 (0x821d24) */
/begin MEASUREMENT crt_PT_821d24_Analog_30 "signal Analog_30 of frame RT_DL1MK3_Analog_30, 8527140 (0x821d24)" UWORD CONV_crt_PT_821d24_Analog_30 0.001 100.0 0.0 0.0 ECU_ADDRESS 0x0000 /end MEASUREMENT
/begin COMPU_METHOD CONV_crt_PT_821d24_Analog_30 "Linear scaling, used for variable crt_PT_821d24_Analog_30, signal Analog_30" RAT_FUNC "%6" "" COEFFS 0 1 -0.0 0 0 0.001 /end COMPU_METHOD
/* Measurement point for signal Analog_29 of frame RT_DL1MK3_Analog_29, 8526884 (0x821c24) */
/begin MEASUREMENT crt_PT_821c24_Analog_29 "signal Analog_29 of frame RT_DL1MK3_Analog_29, 8526884 (0x821c24)" UWORD CONV_crt_PT_821c24_Analog_29 0.001 100.0 0.0 0.0 ECU_ADDRESS 0x0000 /end MEASUREMENT
/begin COMPU_METHOD CONV_crt_PT_821c24_Analog_29 "Linear scaling, used for variable crt_PT_821c24_Analog_29, signal Analog_29" RAT_FUNC "%6" "" COEFFS 0 1 -0.0 0 0 0.001 /end COMPU_METHOD
/* Measurement point for signal Analog_28 of frame RT_DL1MK3_Analog_28, 8526628 (0x821b24) */
/begin MEASUREMENT crt_PT_821b24_Analog_28 "signal Analog_28 of frame RT_DL1MK3_Analog_28, 8526628 (0x821b24)" UWORD CONV_crt_PT_821b24_Analog_28 0.001 100.0 0.0 0.0 ECU_ADDRESS 0x0000 /end MEASUREMENT
/begin COMPU_METHOD CONV_crt_PT_821b24_Analog_28 "Linear scaling, used for variable crt_PT_821b24_Analog_28, signal Analog_28" RAT_FUNC "%6" "" COEFFS 0 1 -0.0 0 0 0.001 /end COMPU_METHOD
/* Measurement point for signal Analog_27 of frame RT_DL1MK3_Analog_27, 8526372 (0x821a24) */
/begin MEASUREMENT crt_PT_821a24_Analog_27 "signal Analog_27 of frame RT_DL1MK3_Analog_27, 8526372 (0x821a24)" UWORD CONV_crt_PT_821a24_Analog_27 0.001 100.0 0.0 0.0 ECU_ADDRESS 0x0000 /end MEASUREMENT
/begin COMPU_METHOD CONV_crt_PT_821a24_Analog_27 "Linear scaling, used for variable crt_PT_821a24_Analog_27, signal Analog_27" RAT_FUNC "%6" "" COEFFS 0 1 -0.0 0 0 0.001 /end COMPU_METHOD
/* Measurement point for signal Analog_26 of frame RT_DL1MK3_Analog_26, 8526116 (0x821924) */
/begin MEASUREMENT crt_PT_821924_Analog_26 "signal Analog_26 of frame RT_DL1MK3_Analog_26, 8526116 (0x821924)" UWORD CONV_crt_PT_821924_Analog_26 0.001 100.0 0.0 0.0 ECU_ADDRESS 0x0000 /end MEASUREMENT
/begin COMPU_METHOD CONV_crt_PT_821924_Analog_26 "Linear scaling, used for variable crt_PT_821924_Analog_26, signal Analog_26" RAT_FUNC "%6" "" COEFFS 0 1 -0.0 0 0 0.001 /end COMPU_METHOD
/* Measurement point for signal Analog_25 of frame RT_DL1MK3_Analog_25, 8525860 (0x821824) */
/begin MEASUREMENT crt_PT_821824_Analog_25 "signal Analog_25 of frame RT_DL1MK3_Analog_25, 8525860 (0x821824)" UWORD CONV_crt_PT_821824_Analog_25 0.001 100.0 0.0 0.0 ECU_ADDRESS 0x0000 /end MEASUREMENT
/begin COMPU_METHOD CONV_crt_PT_821824_Analog_25 "Linear scaling, used for variable crt_PT_821824_Analog_25, signal Analog_25" RAT_FUNC "%6" "" COEFFS 0 1 -0.0 0 0 0.001 /end COMPU_METHOD
/* Measurement point for signal Analog_15 of frame RT_DL1MK3_Analog_15, 8523300 (0x820e24) */
/begin MEASUREMENT crt_PT_820e24_Analog_15 "signal Analog_15 of frame RT_DL1MK3_Analog_15, 8523300 (0x820e24)" UWORD CONV_crt_PT_820e24_Analog_15 0.001 100.0 0.0 0.0 ECU_ADDRESS 0x0000 /end MEASUREMENT
/begin COMPU_METHOD CONV_crt_PT_820e24_Analog_15 "Linear scaling, used for variable crt_PT_820e24_Analog_15, signal Analog_15" RAT_FUNC "%6" "" COEFFS 0 1 -0.0 0 0 0.001 /end COMPU_METHOD
/* Measurement point for signal Analog_14 of frame RT_DL1MK3_Analog_14, 8523044 (0x820d24) */
/begin MEASUREMENT crt_PT_820d24_Analog_14 "signal Analog_14 of frame RT_DL1MK3_Analog_14, 8523044 (0x820d24)" UWORD CONV_crt_PT_820d24_Analog_14 0.001 100.0 0.0 0.0 ECU_ADDRESS 0x0000 /end MEASUREMENT
/begin COMPU_METHOD CONV_crt_PT_820d24_Analog_14 "Linear scaling, used for variable crt_PT_820d24_Analog_14, signal Analog_14" RAT_FUNC "%6" "" COEFFS 0 1 -0.0 0 0 0.001 /end COMPU_METHOD
/* Measurement point for signal Analog_17 of frame RT_DL1MK3_Analog_17, 8523812 (0x821024) */
/begin MEASUREMENT crt_PT_821024_Analog_17 "signal Analog_17 of frame RT_DL1MK3_Analog_17, 8523812 (0x821024)" UWORD CONV_crt_PT_821024_Analog_17 0.001 100.0 0.0 0.0 ECU_ADDRESS 0x0000 /end MEASUREMENT
/begin COMPU_METHOD CONV_crt_PT_821024_Analog_17 "Linear scaling, used for variable crt_PT_821024_Analog_17, signal Analog_17" RAT_FUNC "%6" "" COEFFS 0 1 -0.0 0 0 0.001 /end COMPU_METHOD
/* Measurement point for signal Analog_24 of frame RT_DL1MK3_Analog_24, 8525604 (0x821724) */
/begin MEASUREMENT crt_PT_821724_Analog_24 "signal Analog_24 of frame RT_DL1MK3_Analog_24, 8525604 (0x821724)" UWORD CONV_crt_PT_821724_Analog_24 0.001 100.0 0.0 0.0 ECU_ADDRESS 0x0000 /end MEASUREMENT
/begin COMPU_METHOD CONV_crt_PT_821724_Analog_24 "Linear scaling, used for variable crt_PT_821724_Analog_24, signal Analog_24" RAT_FUNC "%6" "" COEFFS 0 1 -0.0 0 0 0.001 /end COMPU_METHOD
/* Measurement point for signal Analog_23 of frame RT_DL1MK3_Analog_23, 8525348 (0x821624) */
/begin MEASUREMENT crt_PT_821624_Analog_23 "signal Analog_23 of frame RT_DL1MK3_Analog_23, 8525348 (0x821624)" UWORD CONV_crt_PT_821624_Analog_23 0.001 100.0 0.0 0.0 ECU_ADDRESS 0x0000 /end MEASUREMENT
/begin COMPU_METHOD CONV_crt_PT_821624_Analog_23 "Linear scaling, used for variable crt_PT_821624_Analog_23, signal Analog_23" RAT_FUNC "%6" "" COEFFS 0 1 -0.0 0 0 0.001 /end COMPU_METHOD
/* Measurement point for signal Analog_22 of frame RT_DL1MK3_Analog_22, 8525092 (0x821524) */
/begin MEASUREMENT crt_PT_821524_Analog_22 "signal Analog_22 of frame RT_DL1MK3_Analog_22, 8525092 (0x821524)" UWORD CONV_crt_PT_821524_Analog_22 0.001 100.0 0.0 0.0 ECU_ADDRESS 0x0000 /end MEASUREMENT
/begin COMPU_METHOD CONV_crt_PT_821524_Analog_22 "Linear scaling, used for variable crt_PT_821524_Analog_22, signal Analog_22" RAT_FUNC "%6" "" COEFFS 0 1 -0.0 0 0 0.001 /end COMPU_METHOD
/* Measurement point for signal Analog_21 of frame RT_DL1MK3_Analog_21, 8524836 (0x821424) */
/begin MEASUREMENT crt_PT_821424_Analog_21 "signal Analog_21 of frame RT_DL1MK3_Analog_21, 8524836 (0x821424)" UWORD CONV_crt_PT_821424_Analog_21 0.001 100.0 0.0 0.0 ECU_ADDRESS 0x0000 /end MEASUREMENT
/begin COMPU_METHOD CONV_crt_PT_821424_Analog_21 "Linear scaling, used for variable crt_PT_821424_Analog_21, signal Analog_21" RAT_FUNC "%6" "" COEFFS 0 1 -0.0 0 0 0.001 /end COMPU_METHOD
/* Measurement point for signal Analog_20 of frame RT_DL1MK3_Analog_20, 8524580 (0x821324) */
/begin MEASUREMENT crt_PT_821324_Analog_20 "signal Analog_20 of frame RT_DL1MK3_Analog_20, 8524580 (0x821324)" UWORD CONV_crt_PT_821324_Analog_20 0.001 100.0 0.0 0.0 ECU_ADDRESS 0x0000 /end MEASUREMENT
/begin COMPU_METHOD CONV_crt_PT_821324_Analog_20 "Linear scaling, used for variable crt_PT_821324_Analog_20, signal Analog_20" RAT_FUNC "%6" "" COEFFS 0 1 -0.0 0 0 0.001 /end COMPU_METHOD
/* Measurement point for signal Analog_19 of frame RT_DL1MK3_Analog_19, 8524324 (0x821224) */
/begin MEASUREMENT crt_PT_821224_Analog_19 "signal Analog_19 of frame RT_DL1MK3_Analog_19, 8524324 (0x821224)" UWORD CONV_crt_PT_821224_Analog_19 0.001 100.0 0.0 0.0 ECU_ADDRESS 0x0000 /end MEASUREMENT
/begin COMPU_METHOD CONV_crt_PT_821224_Analog_19 "Linear scaling, used for variable crt_PT_821224_Analog_19, signal Analog_19" RAT_FUNC "%6" "" COEFFS 0 1 -0.0 0 0 0.001 /end COMPU_METHOD
/* Measurement point for signal Analog_16 of frame RT_DL1MK3_Analog_16, 8523556 (0x820f24) */
/begin MEASUREMENT crt_PT_820f24_Analog_16 "signal Analog_16 of frame RT_DL1MK3_Analog_16, 8523556 (0x820f24)" UWORD CONV_crt_PT_820f24_Analog_16 0.001 100.0 0.0 0.0 ECU_ADDRESS 0x0000 /end MEASUREMENT
/begin COMPU_METHOD CONV_crt_PT_820f24_Analog_16 "Linear scaling, used for variable crt_PT_820f24_Analog_16, signal Analog_16" RAT_FUNC "%6" "" COEFFS 0 1 -0.0 0 0 0.001 /end COMPU_METHOD
/* Measurement point for signal Analog_18 of frame RT_DL1MK3_Analog_18, 8524068 (0x821124) */
/begin MEASUREMENT crt_PT_821124_Analog_18 "signal Analog_18 of frame RT_DL1MK3_Analog_18, 8524068 (0x821124)" UWORD CONV_crt_PT_821124_Analog_18 0.001 100.0 0.0 0.0 ECU_ADDRESS 0x0000 /end MEASUREMENT
/begin COMPU_METHOD CONV_crt_PT_821124_Analog_18 "Linear scaling, used for variable crt_PT_821124_Analog_18, signal Analog_18" RAT_FUNC "%6" "" COEFFS 0 1 -0.0 0 0 0.001 /end COMPU_METHOD
/* Measurement point for signal Analog_12 of frame RT_DL1MK3_Analog_12, 8522532 (0x820b24) */
/begin MEASUREMENT crt_PT_820b24_Analog_12 "signal Analog_12 of frame RT_DL1MK3_Analog_12, 8522532 (0x820b24)" UWORD CONV_crt_PT_820b24_Analog_12 0.001 100.0 0.0 0.0 ECU_ADDRESS 0x0000 /end MEASUREMENT
/begin COMPU_METHOD CONV_crt_PT_820b24_Analog_12 "Linear scaling, used for variable crt_PT_820b24_Analog_12, signal Analog_12" RAT_FUNC "%6" "" COEFFS 0 1 -0.0 0 0 0.001 /end COMPU_METHOD
/* Measurement point for signal Analog_11 of frame RT_DL1MK3_Analog_11, 8522276 (0x820a24) */
/begin MEASUREMENT crt_PT_820a24_Analog_11 "signal Analog_11 of frame RT_DL1MK3_Analog_11, 8522276 (0x820a24)" UWORD CONV_crt_PT_820a24_Analog_11 0.001 100.0 0.0 0.0 ECU_ADDRESS 0x0000 /end MEASUREMENT
/begin COMPU_METHOD CONV_crt_PT_820a24_Analog_11 "Linear scaling, used for variable crt_PT_820a24_Analog_11, signal Analog_11" RAT_FUNC "%6" "" COEFFS 0 1 -0.0 0 0 0.001 /end COMPU_METHOD
/* Measurement point for signal Analog_10 of frame RT_DL1MK3_Analog_10, 8522020 (0x820924) */
/begin MEASUREMENT crt_PT_820924_Analog_10 "signal Analog_10 of frame RT_DL1MK3_Analog_10, 8522020 (0x820924)" UWORD CONV_crt_PT_820924_Analog_10 0.001 100.0 0.0 0.0 ECU_ADDRESS 0x0000 /end MEASUREMENT
/begin COMPU_METHOD CONV_crt_PT_820924_Analog_10 "Linear scaling, used for variable crt_PT_820924_Analog_10, signal Analog_10" RAT_FUNC "%6" "" COEFFS 0 1 -0.0 0 0 0.001 /end COMPU_METHOD
/* Measurement point for signal Analog_9 of frame RT_DL1MK3_Analog_9, 8521764 (0x820824) */
/begin MEASUREMENT crt_PT_820824_Analog_9 "signal Analog_9 of frame RT_DL1MK3_Analog_9, 8521764 (0x820824)" UWORD CONV_crt_PT_820824_Analog_9 0.001 100.0 0.0 0.0 ECU_ADDRESS 0x0000 /end MEASUREMENT
/begin COMPU_METHOD CONV_crt_PT_820824_Analog_9 "Linear scaling, used for variable crt_PT_820824_Analog_9, signal Analog_9" RAT_FUNC "%6" "" COEFFS 0 1 -0.0 0 0 0.001 /end COMPU_METHOD
/* Measurement point for signal Analog_8 of frame RT_DL1MK3_Analog_8, 8521508 (0x820724) */
/begin MEASUREMENT crt_PT_820724_Analog_8 "signal Analog_8 of frame RT_DL1MK3_Analog_8, 8521508 (0x820724)" UWORD CONV_crt_PT_820724_Analog_8 0.001 100.0 0.0 0.0 ECU_ADDRESS 0x0000 /end MEASUREMENT
/begin COMPU_METHOD CONV_crt_PT_820724_Analog_8 "Linear scaling, used for variable crt_PT_820724_Analog_8, signal Analog_8" RAT_FUNC "%6" "" COEFFS 0 1 -0.0 0 0 0.001 /end COMPU_METHOD
/* Measurement point for signal Analog_7 of frame RT_DL1MK3_Analog_7, 8521252 (0x820624) */
/begin MEASUREMENT crt_PT_820624_Analog_7 "signal Analog_7 of frame RT_DL1MK3_Analog_7, 8521252 (0x820624)" UWORD CONV_crt_PT_820624_Analog_7 0.001 100.0 0.0 0.0 ECU_ADDRESS 0x0000 /end MEASUREMENT
/begin COMPU_METHOD CONV_crt_PT_820624_Analog_7 "Linear scaling, used for variable crt_PT_820624_Analog_7, signal Analog_7" RAT_FUNC "%6" "" COEFFS 0 1 -0.0 0 0 0.001 /end COMPU_METHOD
/* Measurement point for signal Analog_6 of frame RT_DL1MK3_Analog_6, 8520996 (0x820524) */
/begin MEASUREMENT crt_PT_820524_Analog_6 "signal Analog_6 of frame RT_DL1MK3_Analog_6, 8520996 (0x820524)" UWORD CONV_crt_PT_820524_Analog_6 0.001 100.0 0.0 0.0 ECU_ADDRESS 0x0000 /end MEASUREMENT
/begin COMPU_METHOD CONV_crt_PT_820524_Analog_6 "Linear scaling, used for variable crt_PT_820524_Analog_6, signal Analog_6" RAT_FUNC "%6" "" COEFFS 0 1 -0.0 0 0 0.001 /end COMPU_METHOD
/* Measurement point for signal Analog_5 of frame RT_DL1MK3_Analog_5, 8520740 (0x820424) */
/begin MEASUREMENT crt_PT_820424_Analog_5 "signal Analog_5 of frame RT_DL1MK3_Analog_5, 8520740 (0x820424)" UWORD CONV_crt_PT_820424_Analog_5 0.001 100.0 0.0 0.0 ECU_ADDRESS 0x0000 /end MEASUREMENT
/begin COMPU_METHOD CONV_crt_PT_820424_Analog_5 "Linear scaling, used for variable crt_PT_820424_Analog_5, signal Analog_5" RAT_FUNC "%6" "" COEFFS 0 1 -0.0 0 0 0.001 /end COMPU_METHOD
/* Measurement point for signal Analog_4 of frame RT_DL1MK3_Analog_4, 8520484 (0x820324) */
/begin MEASUREMENT crt_PT_820324_Analog_4 "signal Analog_4 of frame RT_DL1MK3_Analog_4, 8520484 (0x820324)" UWORD CONV_crt_PT_820324_Analog_4 0.001 100.0 0.0 0.0 ECU_ADDRESS 0x0000 /end MEASUREMENT
/begin COMPU_METHOD CONV_crt_PT_820324_Analog_4 "Linear scaling, used for variable crt_PT_820324_Analog_4, signal Analog_4" RAT_FUNC "%6" "" COEFFS 0 1 -0.0 0 0 0.001 /end COMPU_METHOD
/* Measurement point for signal Analog_3 of frame RT_DL1MK3_Analog_3, 8520228 (0x820224) */
/begin MEASUREMENT crt_PT_820224_Analog_3 "signal Analog_3 of frame RT_DL1MK3_Analog_3, 8520228 (0x820224)" UWORD CONV_crt_PT_820224_Analog_3 0.001 100.0 0.0 0.0 ECU_ADDRESS 0x0000 /end MEASUREMENT
/begin COMPU_METHOD CONV_crt_PT_820224_Analog_3 "Linear scaling, used for variable crt_PT_820224_Analog_3, signal Analog_3" RAT_FUNC "%6" "" COEFFS 0 1 -0.0 0 0 0.001 /end COMPU_METHOD
/* Measurement point for signal Analog_2 of frame RT_DL1MK3_Analog_2, 8519972 (0x820124) */
/begin MEASUREMENT crt_PT_820124_Analog_2 "signal Analog_2 of frame RT_DL1MK3_Analog_2, 8519972 (0x820124)" UWORD CONV_crt_PT_820124_Analog_2 0.001 100.0 0.0 0.0 ECU_ADDRESS 0x0000 /end MEASUREMENT
/begin COMPU_METHOD CONV_crt_PT_820124_Analog_2 "Linear scaling, used for variable crt_PT_820124_Analog_2, signal Analog_2" RAT_FUNC "%6" "" COEFFS 0 1 -0.0 0 0 0.001 /end COMPU_METHOD
/* Measurement point for signal Analog_1 of frame RT_DL1MK3_Analog_1, 8519716 (0x820024) */
/begin MEASUREMENT crt_PT_820024_Analog_1 "signal Analog_1 of frame RT_DL1MK3_Analog_1, 8519716 (0x820024)" UWORD CONV_crt_PT_820024_Analog_1 0.001 100.0 0.0 0.0 ECU_ADDRESS 0x0000 /end MEASUREMENT
/begin COMPU_METHOD CONV_crt_PT_820024_Analog_1 "Linear scaling, used for variable crt_PT_820024_Analog_1, signal Analog_1" RAT_FUNC "%6" "" COEFFS 0 1 -0.0 0 0 0.001 /end COMPU_METHOD
/* Measurement point for signal Validity_Accel_Longitudinal of frame RT_DL1MK3_Accel, 8388644 (0x800024) */
/begin MEASUREMENT crt_PT_800024_Validity_Accel_Longitudinal "signal Validity_Accel_Longitudinal of frame RT_DL1MK3_Accel, 8388644 (0x800024). Valid when bit is set, invalid when bit is clear." UBYTE CONV_crt_PT_800024_Validity_Accel_Longitudinal 1.0 100.0 0 1 ECU_ADDRESS 0x0000 /end MEASUREMENT
/begin COMPU_METHOD CONV_crt_PT_800024_Validity_Accel_Longitudinal "Linear scaling, used for variable crt_PT_800024_Validity_Accel_Longitudinal, signal Validity_Accel_Longitudinal" RAT_FUNC "%1" "" COEFFS 0 1 0 0 0 1 /end COMPU_METHOD
/* Measurement point for signal Validity_Accel_Lateral of frame RT_DL1MK3_Accel, 8388644 (0x800024) */
/begin MEASUREMENT crt_PT_800024_Validity_Accel_Lateral "signal Validity_Accel_Lateral of frame RT_DL1MK3_Accel, 8388644 (0x800024). Valid when bit is set, invalid when bit is clear." UBYTE CONV_crt_PT_800024_Validity_Accel_Lateral 1.0 100.0 0 1 ECU_ADDRESS 0x0000 /end MEASUREMENT
/begin COMPU_METHOD CONV_crt_PT_800024_Validity_Accel_Lateral "Linear scaling, used for variable crt_PT_800024_Validity_Accel_Lateral, signal Validity_Accel_Lateral" RAT_FUNC "%1" "" COEFFS 0 1 0 0 0 1 /end COMPU_METHOD
/* Measurement point for signal Validity_Accel_Vertical of frame RT_DL1MK3_Accel, 8388644 (0x800024) */
/begin MEASUREMENT crt_PT_800024_Validity_Accel_Vertical "signal Validity_Accel_Vertical of frame RT_DL1MK3_Accel, 8388644 (0x800024). Valid when bit is set, invalid when bit is clear." UBYTE CONV_crt_PT_800024_Validity_Accel_Vertical 1.0 100.0 0 1 ECU_ADDRESS 0x0000 /end MEASUREMENT
/begin COMPU_METHOD CONV_crt_PT_800024_Validity_Accel_Vertical "Linear scaling, used for variable crt_PT_800024_Validity_Accel_Vertical, signal Validity_Accel_Vertical" RAT_FUNC "%1" "" COEFFS 0 1 0 0 0 1 /end COMPU_METHOD
/* Measurement point for signal SQC of frame RT_DL1MK3_Accel, 8388644 (0x800024) */
/begin MEASUREMENT crt_PT_800024_SQC "signal SQC of frame RT_DL1MK3_Accel, 8388644 (0x800024). Sequence counter" UBYTE CONV_crt_PT_800024_SQC 1.0 100.0 0 14 ECU_ADDRESS 0x0000 /end MEASUREMENT
/begin COMPU_METHOD CONV_crt_PT_800024_SQC "Linear scaling, used for variable crt_PT_800024_SQC, signal SQC" RAT_FUNC "%4" "" COEFFS 0 1 0 0 0 1 /end COMPU_METHOD
/* Measurement point for signal Accuracy_Accel of frame RT_DL1MK3_Accel, 8388644 (0x800024) */
/begin MEASUREMENT crt_PT_800024_Accuracy_Accel "signal Accuracy_Accel of frame RT_DL1MK3_Accel, 8388644 (0x800024). Dimensionless.  Lower values imply but do not guarantee better accuracy than higher values." UBYTE CONV_crt_PT_800024_Accuracy_Accel 1.0 100.0 0 255 ECU_ADDRESS 0x0000 /end MEASUREMENT
/begin COMPU_METHOD CONV_crt_PT_800024_Accuracy_Accel "Linear scaling, used for variable crt_PT_800024_Accuracy_Accel, signal Accuracy_Accel" RAT_FUNC "%4" "" COEFFS 0 1 0 0 0 1 /end COMPU_METHOD
/* Measurement point for signal Accel_Longitudinal of frame RT_DL1MK3_Accel, 8388644 (0x800024) */
/begin MEASUREMENT crt_PT_800024_Accel_Longitudinal "signal Accel_Longitudinal of frame RT_DL1MK3_Accel, 8388644 (0x800024). Longitudinal acceleration.  This is positive when the vehicle accelerates in a forwards direction." SWORD CONV_crt_PT_800024_Accel_Longitudinal 0.001 100.0 -65.0 65.0 ECU_ADDRESS 0x0000 /end MEASUREMENT
/begin COMPU_METHOD CONV_crt_PT_800024_Accel_Longitudinal "Linear scaling, used for variable crt_PT_800024_Accel_Longitudinal, signal Accel_Longitudinal" RAT_FUNC "%6" "g" COEFFS 0 1 -0.0 0 0 0.001 /end COMPU_METHOD
/* Measurement point for signal Accel_Lateral of frame RT_DL1MK3_Accel, 8388644 (0x800024) */
/begin MEASUREMENT crt_PT_800024_Accel_Lateral "signal Accel_Lateral of frame RT_DL1MK3_Accel, 8388644 (0x800024). Lateral acceleration.  This is positive when the vehicle accelerates towards the right, e.g. when cornering around a right-hand bend." SWORD CONV_crt_PT_800024_Accel_Lateral 0.001 100.0 -65.0 65.0 ECU_ADDRESS 0x0000 /end MEASUREMENT
/begin COMPU_METHOD CONV_crt_PT_800024_Accel_Lateral "Linear scaling, used for variable crt_PT_800024_Accel_Lateral, signal Accel_Lateral" RAT_FUNC "%6" "g" COEFFS 0 1 -0.0 0 0 0.001 /end COMPU_METHOD
/* Measurement point for signal Accel_Vertical of frame RT_DL1MK3_Accel, 8388644 (0x800024) */
/begin MEASUREMENT crt_PT_800024_Accel_Vertical "signal Accel_Vertical of frame RT_DL1MK3_Accel, 8388644 (0x800024). Vertical acceleration.  This is positive when the vehicle accelerates in an upwards direction, e.g. when travelling through a dip." SWORD CONV_crt_PT_800024_Accel_Vertical 0.001 100.0 -65.0 65.0 ECU_ADDRESS 0x0000 /end MEASUREMENT
/begin COMPU_METHOD CONV_crt_PT_800024_Accel_Vertical "Linear scaling, used for variable crt_PT_800024_Accel_Vertical, signal Accel_Vertical" RAT_FUNC "%6" "g" COEFFS 0 1 -0.0 0 0 0.001 /end COMPU_METHOD
/* Measurement point for signal Virtual_4_Vel_NED_D of frame RT_SB_INS_Vpt_4_Vel_NED_2, 9384482 (0x8f3222) */
/begin MEASUREMENT crt_PT_8f3222_Virtual_4_Vel_NED_D "signal Virtual_4_Vel_NED_D of frame RT_SB_INS_Vpt_4_Vel_NED_2, 9384482 (0x8f3222). VELNED D velocity.  This is the velocity vector directly downwards towards the Earth centre at the current local Earth surface position." SLONG CONV_crt_PT_8f3222_Virtual_4_Vel_NED_D 1.0E-4 100.0 -838.0 838.0 ECU_ADDRESS 0x0000 /end MEASUREMENT
/begin COMPU_METHOD CONV_crt_PT_8f3222_Virtual_4_Vel_NED_D "Linear scaling, used for variable crt_PT_8f3222_Virtual_4_Vel_NED_D, signal Virtual_4_Vel_NED_D" RAT_FUNC "%12" "m/s" COEFFS 0 1 -0.0 0 0 1.0E-4 /end COMPU_METHOD
/* Measurement point for signal Virtual_4_Heading of frame RT_SB_INS_Vpt_4_Vel_NED_2, 9384482 (0x8f3222) */
/begin MEASUREMENT crt_PT_8f3222_Virtual_4_Heading "signal Virtual_4_Heading of frame RT_SB_INS_Vpt_4_Vel_NED_2, 9384482 (0x8f3222). This is GPS heading, the direction that the vehicle is travelling in the local horizontal plane." SWORD CONV_crt_PT_8f3222_Virtual_4_Heading 0.01 100.0 -180.0 180.0 ECU_ADDRESS 0x0000 /end MEASUREMENT
/begin COMPU_METHOD CONV_crt_PT_8f3222_Virtual_4_Heading "Linear scaling, used for variable crt_PT_8f3222_Virtual_4_Heading, signal Virtual_4_Heading" RAT_FUNC "%6" "degrees" COEFFS 0 1 -0.0 0 0 0.01 /end COMPU_METHOD
/* Measurement point for signal Virtual_4_Slip of frame RT_SB_INS_Vpt_4_Vel_NED_2, 9384482 (0x8f3222) */
/begin MEASUREMENT crt_PT_8f3222_Virtual_4_Slip "signal Virtual_4_Slip of frame RT_SB_INS_Vpt_4_Vel_NED_2, 9384482 (0x8f3222). Slip is defined as the difference between yaw and heading." SWORD CONV_crt_PT_8f3222_Virtual_4_Slip 0.01 100.0 -180.0 180.0 ECU_ADDRESS 0x0000 /end MEASUREMENT
/begin COMPU_METHOD CONV_crt_PT_8f3222_Virtual_4_Slip "Linear scaling, used for variable crt_PT_8f3222_Virtual_4_Slip, signal Virtual_4_Slip" RAT_FUNC "%6" "degrees" COEFFS 0 1 -0.0 0 0 0.01 /end COMPU_METHOD
/* Measurement point for signal Virtual_4_Vel_NED_N of frame RT_SB_INS_Vpt_4_Vel_NED_1, 9384226 (0x8f3122) */
/begin MEASUREMENT crt_PT_8f3122_Virtual_4_Vel_NED_N "signal Virtual_4_Vel_NED_N of frame RT_SB_INS_Vpt_4_Vel_NED_1, 9384226 (0x8f3122). VELNED N velocity.  This is the velocity vector directly North at the current local Earth surface position." SLONG CONV_crt_PT_8f3122_Virtual_4_Vel_NED_N 1.0E-4 100.0 -838.0 838.0 ECU_ADDRESS 0x0000 /end MEASUREMENT
/begin COMPU_METHOD CONV_crt_PT_8f3122_Virtual_4_Vel_NED_N "Linear scaling, used for variable crt_PT_8f3122_Virtual_4_Vel_NED_N, signal Virtual_4_Vel_NED_N" RAT_FUNC "%12" "m/s" COEFFS 0 1 -0.0 0 0 1.0E-4 /end COMPU_METHOD
/* Measurement point for signal Virtual_4_Vel_NED_E of frame RT_SB_INS_Vpt_4_Vel_NED_1, 9384226 (0x8f3122) */
/begin MEASUREMENT crt_PT_8f3122_Virtual_4_Vel_NED_E "signal Virtual_4_Vel_NED_E of frame RT_SB_INS_Vpt_4_Vel_NED_1, 9384226 (0x8f3122). VELNED E velocity.  This is the velocity vector directly East at the current local Earth surface position." SLONG CONV_crt_PT_8f3122_Virtual_4_Vel_NED_E 1.0E-4 100.0 -838.0 838.0 ECU_ADDRESS 0x0000 /end MEASUREMENT
/begin COMPU_METHOD CONV_crt_PT_8f3122_Virtual_4_Vel_NED_E "Linear scaling, used for variable crt_PT_8f3122_Virtual_4_Vel_NED_E, signal Virtual_4_Vel_NED_E" RAT_FUNC "%12" "m/s" COEFFS 0 1 -0.0 0 0 1.0E-4 /end COMPU_METHOD
/* Measurement point for signal Virtual_4_Offset_X of frame RT_SB_INS_Vpt_4_Offset, 9383970 (0x8f3022) */
/begin MEASUREMENT crt_PT_8f3022_Virtual_4_Offset_X "signal Virtual_4_Offset_X of frame RT_SB_INS_Vpt_4_Offset, 9383970 (0x8f3022). X offset of the virtual point in the vehicle body frame." SWORD CONV_crt_PT_8f3022_Virtual_4_Offset_X 0.001 100.0 -32.768 32.767 ECU_ADDRESS 0x0000 /end MEASUREMENT
/begin COMPU_METHOD CONV_crt_PT_8f3022_Virtual_4_Offset_X "Linear scaling, used for variable crt_PT_8f3022_Virtual_4_Offset_X, signal Virtual_4_Offset_X" RAT_FUNC "%6" "m" COEFFS 0 1 -0.0 0 0 0.001 /end COMPU_METHOD
/* Measurement point for signal Virtual_4_Offset_Y of frame RT_SB_INS_Vpt_4_Offset, 9383970 (0x8f3022) */
/begin MEASUREMENT crt_PT_8f3022_Virtual_4_Offset_Y "signal Virtual_4_Offset_Y of frame RT_SB_INS_Vpt_4_Offset, 9383970 (0x8f3022). Y offset of the virtual point in the vehicle body frame." SWORD CONV_crt_PT_8f3022_Virtual_4_Offset_Y 0.001 100.0 -32.768 32.767 ECU_ADDRESS 0x0000 /end MEASUREMENT
/begin COMPU_METHOD CONV_crt_PT_8f3022_Virtual_4_Offset_Y "Linear scaling, used for variable crt_PT_8f3022_Virtual_4_Offset_Y, signal Virtual_4_Offset_Y" RAT_FUNC "%6" "m" COEFFS 0 1 -0.0 0 0 0.001 /end COMPU_METHOD
/* Measurement point for signal Virtual_4_Offset_Z of frame RT_SB_INS_Vpt_4_Offset, 9383970 (0x8f3022) */
/begin MEASUREMENT crt_PT_8f3022_Virtual_4_Offset_Z "signal Virtual_4_Offset_Z of frame RT_SB_INS_Vpt_4_Offset, 9383970 (0x8f3022). Z offset (+ve downwards) of the virtual point in the vehicle body frame." SWORD CONV_crt_PT_8f3022_Virtual_4_Offset_Z 0.001 100.0 -32.768 32.767 ECU_ADDRESS 0x0000 /end MEASUREMENT
/begin COMPU_METHOD CONV_crt_PT_8f3022_Virtual_4_Offset_Z "Linear scaling, used for variable crt_PT_8f3022_Virtual_4_Offset_Z, signal Virtual_4_Offset_Z" RAT_FUNC "%6" "m" COEFFS 0 1 -0.0 0 0 0.001 /end COMPU_METHOD
/* Measurement point for signal Virtual_3_Vel_NED_D of frame RT_SB_INS_Vpt_3_Vel_NED_2, 9380386 (0x8f2222) */
/begin MEASUREMENT crt_PT_8f2222_Virtual_3_Vel_NED_D "signal Virtual_3_Vel_NED_D of frame RT_SB_INS_Vpt_3_Vel_NED_2, 9380386 (0x8f2222). VELNED D velocity.  This is the velocity vector directly downwards towards the Earth centre at the current local Earth surface position." SLONG CONV_crt_PT_8f2222_Virtual_3_Vel_NED_D 1.0E-4 100.0 -838.0 838.0 ECU_ADDRESS 0x0000 /end MEASUREMENT
/begin COMPU_METHOD CONV_crt_PT_8f2222_Virtual_3_Vel_NED_D "Linear scaling, used for variable crt_PT_8f2222_Virtual_3_Vel_NED_D, signal Virtual_3_Vel_NED_D" RAT_FUNC "%12" "m/s" COEFFS 0 1 -0.0 0 0 1.0E-4 /end COMPU_METHOD
/* Measurement point for signal Virtual_3_Heading of frame RT_SB_INS_Vpt_3_Vel_NED_2, 9380386 (0x8f2222) */
/begin MEASUREMENT crt_PT_8f2222_Virtual_3_Heading "signal Virtual_3_Heading of frame RT_SB_INS_Vpt_3_Vel_NED_2, 9380386 (0x8f2222). This is GPS heading, the direction that the vehicle is travelling in the local horizontal plane." SWORD CONV_crt_PT_8f2222_Virtual_3_Heading 0.01 100.0 -180.0 180.0 ECU_ADDRESS 0x0000 /end MEASUREMENT
/begin COMPU_METHOD CONV_crt_PT_8f2222_Virtual_3_Heading "Linear scaling, used for variable crt_PT_8f2222_Virtual_3_Heading, signal Virtual_3_Heading" RAT_FUNC "%6" "degrees" COEFFS 0 1 -0.0 0 0 0.01 /end COMPU_METHOD
/* Measurement point for signal Virtual_3_Slip of frame RT_SB_INS_Vpt_3_Vel_NED_2, 9380386 (0x8f2222) */
/begin MEASUREMENT crt_PT_8f2222_Virtual_3_Slip "signal Virtual_3_Slip of frame RT_SB_INS_Vpt_3_Vel_NED_2, 9380386 (0x8f2222). Slip is defined as the difference between yaw and heading." SWORD CONV_crt_PT_8f2222_Virtual_3_Slip 0.01 100.0 -180.0 180.0 ECU_ADDRESS 0x0000 /end MEASUREMENT
/begin COMPU_METHOD CONV_crt_PT_8f2222_Virtual_3_Slip "Linear scaling, used for variable crt_PT_8f2222_Virtual_3_Slip, signal Virtual_3_Slip" RAT_FUNC "%6" "degrees" COEFFS 0 1 -0.0 0 0 0.01 /end COMPU_METHOD
/* Measurement point for signal Virtual_3_Vel_NED_N of frame RT_SB_INS_Vpt_3_Vel_NED_1, 9380130 (0x8f2122) */
/begin MEASUREMENT crt_PT_8f2122_Virtual_3_Vel_NED_N "signal Virtual_3_Vel_NED_N of frame RT_SB_INS_Vpt_3_Vel_NED_1, 9380130 (0x8f2122). VELNED N velocity.  This is the velocity vector directly North at the current local Earth surface position." SLONG CONV_crt_PT_8f2122_Virtual_3_Vel_NED_N 1.0E-4 100.0 -838.0 838.0 ECU_ADDRESS 0x0000 /end MEASUREMENT
/begin COMPU_METHOD CONV_crt_PT_8f2122_Virtual_3_Vel_NED_N "Linear scaling, used for variable crt_PT_8f2122_Virtual_3_Vel_NED_N, signal Virtual_3_Vel_NED_N" RAT_FUNC "%12" "m/s" COEFFS 0 1 -0.0 0 0 1.0E-4 /end COMPU_METHOD
/end MODULE
/end PROJECT
